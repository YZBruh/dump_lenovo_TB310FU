/dts-v1/;

/ {
	#address-cells = <0x2>;
	#size-cells = <0x2>;
	compatible = "mediatek,MT6768";
	interrupt-parent = <0x1>;
	model = "MT6768";

	__symbols__ {
		MCDI_CLUSTER = "/cpus/idle-states/mcdi-cluster";
		MCDI_CPU = "/cpus/idle-states/mcdi-cpu";
		STANDBY = "/cpus/idle-states/standby";
		SUSPEND = "/cpus/idle-states/suspend";
		accdet = "/accdet";
		afe = "/mt6768-afe-pcm@11220000";
		ant_det = "/ant_det";
		apdma = "/dma-controller@11000980";
		apmixed = "/apmixed@1000c000";
		apuart0 = "/serial@11002000";
		apuart1 = "/serial@11003000";
		aud_clk_miso_off = "/pinctrl/aud_clk_miso_off";
		aud_clk_miso_on = "/pinctrl/aud_clk_miso_on";
		aud_clk_mosi_off = "/pinctrl/aud_clk_mosi_off";
		aud_clk_mosi_on = "/pinctrl/aud_clk_mosi_on";
		aud_dat_miso_off = "/pinctrl/aud_dat_miso_off";
		aud_dat_miso_on = "/pinctrl/aud_dat_miso_on";
		aud_dat_mosi_off = "/pinctrl/aud_dat_mosi_off";
		aud_dat_mosi_on = "/pinctrl/aud_dat_mosi_on";
		aud_gpio_i2s0_off = "/pinctrl/aud_gpio_i2s0_off";
		aud_gpio_i2s0_on = "/pinctrl/aud_gpio_i2s0_on";
		aud_gpio_i2s1_off = "/pinctrl/aud_gpio_i2s1_off";
		aud_gpio_i2s1_on = "/pinctrl/aud_gpio_i2s1_on";
		aud_gpio_i2s2_off = "/pinctrl/aud_gpio_i2s2_off";
		aud_gpio_i2s2_on = "/pinctrl/aud_gpio_i2s2_on";
		aud_gpio_i2s3_off = "/pinctrl/aud_gpio_i2s3_off";
		aud_gpio_i2s3_on = "/pinctrl/aud_gpio_i2s3_on";
		audio = "/audio@11220000";
		auxadc = "/auxadc@11001000";
		aw883xx_smartpa_0 = "/i2c6@1100d000/aw883xx_smartpa@34";
		aw883xx_smartpa_1 = "/i2c6@1100d000/aw883xx_smartpa@35";
		bat_gm30 = "/battery";
		camera_af_hw_node = "/camera_af_hw_node";
		camsys = "/camsys@1a000000";
		camsys1 = "/camsysisp@1a000000";
		ccifdriver = "/ccifdriver@10209000";
		charger = "/charger";
		chosen = "/chosen";
		cldmadriver = "/cldmadriver@10014000";
		clk13m = "/clocks/clk13m";
		clk26m = "/clocks/clk26m";
		clk32k = "/clocks/clk32k";
		cluster0_opp = "/opp_table0";
		cluster1_opp = "/opp_table1";
		consys = "/consys@18002000";
		consys_mem = "/reserved-memory/consys-reserve-memory";
		cpu0 = "/cpus/cpu@000";
		cpu1 = "/cpus/cpu@001";
		cpu2 = "/cpus/cpu@002";
		cpu3 = "/cpus/cpu@003";
		cpu4 = "/cpus/cpu@100";
		cpu5 = "/cpus/cpu@101";
		cpu6 = "/cpus/cpu@102";
		cpu7 = "/cpus/cpu@103";
		cpu_dbgapb = "/cpu_dbgapb@0e010000";
		dcm = "/dcm";
		dfd_cache = "/dfd_cache";
		disp_color0 = "/disp_color0@1400f000";
		disp_mutex0 = "/disp_mutex0@14001000";
		doe_dvfs_cl0 = "/cpus/cpu-map/cluster0/doe";
		doe_dvfs_cl1 = "/cpus/cpu-map/cluster1/doe";
		drcc = "/drcc";
		dsi_te = "/dsi_te";
		dvfsp = "/dvfsp@00110c00";
		dvfsrc = "/dvfsrc@10012000";
		eem_fsm = "/eem_fsm@1100b000";
		efuse = "/efuse@11c10000";
		efuse_segment = "/efuse@11c10000/segment@78";
		eint = "/eint@1000b000";
		extcon_usb = "/extcon_usb";
		flashlight_core = "/flashlight_core";
		flashlights_mt6370 = "/flashlights_mt6370";
		gce = "/gce@10238000";
		gce_mbox = "/gce_mbox@10238000";
		gce_mbox_bdg = "/gce_mbox_bdg";
		gce_mbox_svp = "/gce_mbox_svp@10238000";
		ged = "/ged";
		gic = "/interrupt-controller";
		goodix_fp = "/fingerprint";
		gpio = "/gpio@10005000";
		gpio_usage_mapping = "/gpio";
		gpufreq = "/gpufreq";
		hwrng = "/hwrng";
		i2c0 = "/i2c0@11007000";
		i2c1 = "/i2c1@11008000";
		i2c2 = "/i2c2@11009000";
		i2c3 = "/i2c3@1100f000";
		i2c4 = "/i2c4@11011000";
		i2c5 = "/i2c5@11016000";
		i2c6 = "/i2c6@1100d000";
		i2c7 = "/i2c7@11004000";
		i2c8 = "/i2c8@11005000";
		i2c_common = "/i2c_common";
		idlebus26m = "/cpus/idle-states/idlebus26m";
		idledram = "/cpus/idle-states/idledram";
		idlesyspll = "/cpus/idle-states/idlesyspll";
		imgsys = "/syscon@15020000";
		imgsys_config = "/imgsys_config@15020000";
		infracfg_ao = "/infracfg_ao@10001000";
		io_cfg_bl = "/io_cfg_bl@10002600";
		io_cfg_lb = "/io_cfg_lb@10002400";
		io_cfg_lm = "/io_cfg_lm@10002200";
		io_cfg_lt = "/io_cfg_lt@10002000";
		io_cfg_rb = "/io_cfg_rb@10002a00";
		io_cfg_rm = "/io_cfg_rm@10002800";
		io_cfg_rt = "/io_cfg_rt@10002c00";
		io_cfg_tl = "/io_cfg_tl@10002e00";
		irq_nfc = "/irq_nfc";
		irtx_pwm = "/irtx_pwm";
		kd_camera_hw1 = "/kd_camera_hw1@1a040000";
		keypad = "/kp@10010000";
		lk_charger = "/lk_charger";
		main_pmic = "/pwrap@1000d000/mt6358-pmic";
		mcdi = "/mcdi@00110100";
		mcucfg = "/mcucfg@0c530000";
		md1_sim1_hot_plug_eint = "/md1_sim1_hot_plug_eint";
		md1_sim2_hot_plug_eint = "/md1_sim2_hot_plug_eint";
		md_auxadc = "/md_auxadc";
		mddriver = "/mddriver@10014000";
		mdp_ccorr = "/mdp_ccorr0@14005000";
		mdp_rdma0 = "/mdp_rdma0@14004000";
		mdp_rsz0 = "/mdp_rsz0@14006000";
		mdp_rsz1 = "/mdp_rsz1@14007000";
		mdp_tdshp0 = "/mdp_tdshp0@1400a000";
		mdp_wdma0 = "/mdp_wdma0@14008000";
		mdp_wrot0 = "/mdp_wrot0@14009000";
		memory_ssmr_features = "/memory-ssmr-features";
		mfg_cfg = "/mfg_cfg@13000000";
		mipi_rx_ana_csi0a = "/mipi_rx_ana_csi0a@11c10000";
		mipi_rx_ana_csi0b = "/mipi_rx_ana_csi0b@11c11000";
		mipi_rx_ana_csi1a = "/mipi_rx_ana_csi1a@11c12000";
		mipi_rx_ana_csi1b = "/mipi_rx_ana_csi1b@11c13000";
		mipi_rx_ana_csi2a = "/mipi_rx_ana_csi2a@11c14000";
		mipi_rx_ana_csi2b = "/mipi_rx_ana_csi2b@11c15000";
		mmc0 = "/mmc@11230000";
		mmc0_pins_default = "/pinctrl/mmc0default";
		mmc0_pins_uhs = "/pinctrl/mmc0@0";
		mmc1 = "/mmc@11240000";
		mmc1_pins_default = "/pinctrl/mmc1default";
		mmc1_pins_pull_down = "/pinctrl/mmc1@1";
		mmc1_pins_uhs = "/pinctrl/mmc1@0";
		mmsys_config = "/mmsys_config@14000000";
		mrdump_ext_rst = "/mrdump_ext_rst";
		msdc0 = "/msdc@11230000";
		msdc1 = "/msdc@11240000";
		msdc1_ins = "/msdc1_ins";
		mt6358_misc = "/pwrap@1000d000/mt6358-pmic/mt6358_misc";
		mt6358_rtc = "/pwrap@1000d000/mt6358-pmic/mt6358_rtc";
		mt6358_snd = "/mt6358_snd";
		mt6358_vmch_eint_high = "/pwrap@1000d000/mt6358-pmic/mt6358regulator/VMCH_EINT_HIGH";
		mt6358_vmch_eint_low = "/pwrap@1000d000/mt6358-pmic/mt6358regulator/VMCH_EINT_LOW";
		mt6358regulator = "/pwrap@1000d000/mt6358-pmic/mt6358regulator";
		mt6370_chg = "/mt6370_pmu_dts/charger";
		mt6370_pmu = "/mt6370_pmu_dts";
		mt6370_typec = "/type_c_port0";
		mt_charger = "/mt_charger";
		mt_cpufreq = "/mt_cpufreq";
		mt_pmic_va09_ldo_reg = "/pwrap@1000d000/mt6358-pmic/mt6358regulator/ldo_va09";
		mt_pmic_va12_ldo_reg = "/pwrap@1000d000/mt6358-pmic/mt6358regulator/ldo_va12";
		mt_pmic_vaud28_ldo_reg = "/pwrap@1000d000/mt6358-pmic/mt6358regulator/ldo_vaud28";
		mt_pmic_vaux18_ldo_reg = "/pwrap@1000d000/mt6358-pmic/mt6358regulator/ldo_vaux18";
		mt_pmic_vbif28_ldo_reg = "/pwrap@1000d000/mt6358-pmic/mt6358regulator/ldo_vbif28";
		mt_pmic_vcama1_ldo_reg = "/pwrap@1000d000/mt6358-pmic/mt6358regulator/ldo_vcama1";
		mt_pmic_vcama2_ldo_reg = "/pwrap@1000d000/mt6358-pmic/mt6358regulator/ldo_vcama2";
		mt_pmic_vcamd_ldo_reg = "/pwrap@1000d000/mt6358-pmic/mt6358regulator/ldo_vcamd";
		mt_pmic_vcamio_ldo_reg = "/pwrap@1000d000/mt6358-pmic/mt6358regulator/ldo_vcamio";
		mt_pmic_vcn18_ldo_reg = "/pwrap@1000d000/mt6358-pmic/mt6358regulator/ldo_vcn18";
		mt_pmic_vcn28_ldo_reg = "/pwrap@1000d000/mt6358-pmic/mt6358regulator/ldo_vcn28";
		mt_pmic_vcn33_bt_ldo_reg = "/pwrap@1000d000/mt6358-pmic/mt6358regulator/ldo_vcn33_bt";
		mt_pmic_vcn33_wifi_ldo_reg = "/pwrap@1000d000/mt6358-pmic/mt6358regulator/ldo_vcn33_wifi";
		mt_pmic_vcore_buck_reg = "/pwrap@1000d000/mt6358-pmic/mt6358regulator/buck_vcore";
		mt_pmic_vdram1_buck_reg = "/pwrap@1000d000/mt6358-pmic/mt6358regulator/buck_vdram1";
		mt_pmic_vdram2_ldo_reg = "/pwrap@1000d000/mt6358-pmic/mt6358regulator/ldo_vdram2";
		mt_pmic_vefuse_ldo_reg = "/pwrap@1000d000/mt6358-pmic/mt6358regulator/ldo_vefuse";
		mt_pmic_vemc_ldo_reg = "/pwrap@1000d000/mt6358-pmic/mt6358regulator/ldo_vemc";
		mt_pmic_vfe28_ldo_reg = "/pwrap@1000d000/mt6358-pmic/mt6358regulator/ldo_vfe28";
		mt_pmic_vgpu_buck_reg = "/pwrap@1000d000/mt6358-pmic/mt6358regulator/buck_vgpu";
		mt_pmic_vibr_ldo_reg = "/pwrap@1000d000/mt6358-pmic/mt6358regulator/ldo_vibr";
		mt_pmic_vio18_ldo_reg = "/pwrap@1000d000/mt6358-pmic/mt6358regulator/ldo_vio18";
		mt_pmic_vio28_ldo_reg = "/pwrap@1000d000/mt6358-pmic/mt6358regulator/ldo_vio28";
		mt_pmic_vldo28_ldo_reg = "/pwrap@1000d000/mt6358-pmic/mt6358regulator/ldo_vldo28";
		mt_pmic_vmc_ldo_reg = "/pwrap@1000d000/mt6358-pmic/mt6358regulator/ldo_vmc";
		mt_pmic_vmch_ldo_reg = "/pwrap@1000d000/mt6358-pmic/mt6358regulator/ldo_vmch";
		mt_pmic_vmodem_buck_reg = "/pwrap@1000d000/mt6358-pmic/mt6358regulator/buck_vmodem";
		mt_pmic_vpa_buck_reg = "/pwrap@1000d000/mt6358-pmic/mt6358regulator/buck_vpa";
		mt_pmic_vproc11_buck_reg = "/pwrap@1000d000/mt6358-pmic/mt6358regulator/buck_vproc11";
		mt_pmic_vproc12_buck_reg = "/pwrap@1000d000/mt6358-pmic/mt6358regulator/buck_vproc12";
		mt_pmic_vrf12_ldo_reg = "/pwrap@1000d000/mt6358-pmic/mt6358regulator/ldo_vrf12";
		mt_pmic_vrf18_ldo_reg = "/pwrap@1000d000/mt6358-pmic/mt6358regulator/ldo_vrf18";
		mt_pmic_vs1_buck_reg = "/pwrap@1000d000/mt6358-pmic/mt6358regulator/buck_vs1";
		mt_pmic_vs2_buck_reg = "/pwrap@1000d000/mt6358-pmic/mt6358regulator/buck_vs2";
		mt_pmic_vsim1_ldo_reg = "/pwrap@1000d000/mt6358-pmic/mt6358regulator/ldo_vsim1";
		mt_pmic_vsim2_ldo_reg = "/pwrap@1000d000/mt6358-pmic/mt6358regulator/ldo_vsim2";
		mt_pmic_vsram_gpu_ldo_reg = "/pwrap@1000d000/mt6358-pmic/mt6358regulator/ldo_vsram_gpu";
		mt_pmic_vsram_others_ldo_reg = "/pwrap@1000d000/mt6358-pmic/mt6358regulator/ldo_vsram_others";
		mt_pmic_vsram_proc11_ldo_reg = "/pwrap@1000d000/mt6358-pmic/mt6358regulator/ldo_vsram_proc11";
		mt_pmic_vsram_proc12_ldo_reg = "/pwrap@1000d000/mt6358-pmic/mt6358regulator/ldo_vsram_proc12";
		mt_pmic_vusb_ldo_reg = "/pwrap@1000d000/mt6358-pmic/mt6358regulator/ldo_vusb";
		mt_pmic_vxo22_ldo_reg = "/pwrap@1000d000/mt6358-pmic/mt6358regulator/ldo_vxo22";
		mtk_ts_pmic = "/pwrap@1000d000/mt6358-pmic/mtk_ts_pmic";
		mtkfb = "/mtkfb@0";
		nfc = "/nfc";
		odm = "/odm";
		otg_vbus = "/mt6370_pmu_dts/charger/usb-otg-vbus";
		pd_adapter = "/pd_adapter";
		pericfg = "/pericfg@10003000";
		pio = "/pinctrl";
		pmic = "/pwrap@1000d000/mt6358-pmic/mt-pmic";
		pmic_auxadc = "/pwrap@1000d000/mt6358-pmic/mt635x-auxadc";
		pmic_clock_buffer_ctrl = "/pmic_clock_buffer_ctrl";
		pwrap = "/pwrap@1000d000";
		pwraph = "/pwraphal@";
		radio_md_cfg = "/radio_md_cfg";
		reserved_memory = "/reserved-memory";
		rt1711_typec = "/rt1711_type_c_port0";
		rt9465_slave_chr = "/rt9465_slave_chr";
		scp_infra = "/scp_infra@10001000";
		scpsys = "/scpsys@10001000";
		sleep = "/sleep@10006000";
		smart_pa = "/smart_pa";
		smi_larb0 = "/smi_larb0@14003000";
		smi_larb1 = "/smi_larb1@16010000";
		smi_larb2 = "/smi_larb2@15021000";
		smi_larb3 = "/smi_larb3@1a002000";
		smi_larb4 = "/smi_larb4@17010000";
		snd_scp_spk = "/snd_scp_spk";
		sound = "/sound";
		spi0 = "/spi0@1100a000";
		spi1 = "/spi1@11010000";
		spi2 = "/spi2@11012000";
		spi3 = "/spi3@11013000";
		spi4 = "/spi4@11014000";
		spi5 = "/spi5@11015000";
		ssmr_cma_mem = "/reserved-memory/ssmr-reserved-cma_memory";
		subpmic_pmu_eint = "/mt6370_pmu_eint";
		sysirq = "/intpol-controller@0";
		systimer = "/systimer@10017000";
		tboard_thermistor1 = "/thermal-sensor1";
		tboard_thermistor2 = "/thermal-sensor2";
		tboard_thermistor3 = "/thermal-sensor3";
		tboard_thermistor4 = "/thermal-sensor4";
		tcpc_pd = "/tcpc_pd_eint";
		timer = "/timer";
		topckgen = "/topckgen@10000000";
		toprgu = "/toprgu@10007000";
		touch = "/touch";
		u2phy0 = "/usb-phy@11210000";
		u2port0 = "/usb-phy@11210000/usb-phy@11210000";
		usb = "/usb0@11200000";
		vcodec_dec = "/vcodec_dec@16000000";
		vcodec_enc = "/vcodec_enc@17000000";
		vcu = "/vcu@16000000";
		vdec_gcon = "/vdec_gcon@16000000";
		venc_gcon = "/venc_gcon@17000000";
		vow_clk_miso_off = "/pinctrl/vow_clk_miso_off";
		vow_clk_miso_on = "/pinctrl/vow_clk_miso_on";
		vow_dat_miso_off = "/pinctrl/vow_dat_miso_off";
		vow_dat_miso_on = "/pinctrl/vow_dat_miso_on";
		wifi = "/wifi@18000000";
		wifi_mem = "/reserved-memory/wifi-reserve-memory";
	};

	accdet {
		compatible = "mediatek,pmic-accdet";
		phandle = <0xba>;
	};

	aes_top0@10016000 {
		compatible = "mediatek,aes_top0";
		reg = <0x0 0x10016000 0x0 0x1000>;
	};

	amms_control {
		compatible = "mediatek,amms";
		interrupts = <0x0 0x131 0x1>;
	};

	ant_det {
		compatible = "tinno,ant_det";
		phandle = <0xfa>;
		status = "okay";
		tinno,ant-det-gpio = <0x20 0x3 0x0>;
	};

	ap_ccif0@10209000 {
		compatible = "mediatek,ap_ccif0";
		interrupts = <0x0 0xa4 0x8>;
		reg = <0x0 0x10209000 0x0 0x1000>;
	};

	ap_ccif1@1020b000 {
		compatible = "mediatek,ap_ccif1";
		interrupts = <0x0 0xa6 0x8>;
		reg = <0x0 0x1020b000 0x0 0x1000>;
	};

	ap_ccif2@1023c000 {
		compatible = "mediatek,ap_ccif2";
		interrupts = <0x0 0xa0 0x8>;
		reg = <0x0 0x1023c000 0x0 0x1000>;
	};

	ap_ccif3@1023e000 {
		compatible = "mediatek,ap_ccif3";
		interrupts = <0x0 0xa3 0x8>;
		reg = <0x0 0x1023e000 0x0 0x1000>;
	};

	ap_dma@11000000 {
		compatible = "mediatek,ap_dma";
		interrupts = <0x0 0x66 0x8>;
		reg = <0x0 0x11000000 0x0 0x1000>;
	};

	apcldmain@1021b000 {
		compatible = "mediatek,apcldmain";
		reg = <0x0 0x1021b000 0x0 0x100>;
	};

	apcldmain@1021b100 {
		compatible = "mediatek,apcldmain";
		reg = <0x0 0x1021b100 0x0 0x100>;
	};

	apcldmain_ao@10014000 {
		compatible = "mediatek,apcldmain_ao";
		reg = <0x0 0x10014000 0x0 0x400>;
	};

	apcldmamisc@1021b800 {
		compatible = "mediatek,apcldmamisc";
		interrupts = <0x0 0xb4 0x4>;
		reg = <0x0 0x1021b800 0x0 0x100>;
	};

	apcldmamisc@1021b900 {
		compatible = "mediatek,apcldmamisc";
		reg = <0x0 0x1021b900 0x0 0x400>;
	};

	apcldmamisc_ao@10014800 {
		compatible = "mediatek,apcldmamisc_ao";
		reg = <0x0 0x10014800 0x0 0x400>;
	};

	apcldmamisc_ao@10014c00 {
		compatible = "mediatek,apcldmamisc_ao";
		reg = <0x0 0x10014c00 0x0 0x400>;
	};

	apcldmaout@1021b400 {
		compatible = "mediatek,apcldmaout";
		reg = <0x0 0x1021b400 0x0 0x100>;
	};

	apcldmaout@1021b500 {
		compatible = "mediatek,apcldmaout";
		reg = <0x0 0x1021b500 0x0 0x100>;
	};

	apcldmaout_ao@10014400 {
		compatible = "mediatek,apcldmaout_ao";
		reg = <0x0 0x10014400 0x0 0x400>;
	};

	apmixed@1000c000 {
		#clock-cells = <0x1>;
		compatible = "mediatek,apmixed", "syscon";
		phandle = <0x45>;
		reg = <0x0 0x1000c000 0x0 0x1000>;
	};

	atf_logger {
		compatible = "mediatek,atf_logger";
		interrupts = <0x0 0x128 0x1>;
	};

	audio@11220000 {
		#clock-cells = <0x1>;
		compatible = "mediatek,audio", "syscon";
		phandle = <0x46>;
		reg = <0x0 0x11220000 0x0 0x1000>;
	};

	audio_sram@11221000 {
		block_size = <0x1000>;
		compatible = "mediatek,audio_sram";
		mode_size = <0x6c00 0x9000>;
		prefer_mode = <0x1>;
		reg = <0x0 0x11221000 0x0 0x9000>;
	};

	auxadc@11001000 {
		#interconnect-cells = <0x1>;
		#io-channel-cells = <0x1>;
		clock-names = "main";
		clocks = <0x26 0x21>;
		compatible = "mediatek,mt6768-auxadc";
		interrupts = <0x0 0x42 0x2>;
		mediatek,cali-efuse-reg-offset = <0x1a8>;
		mediatek,cali-en-bit = <0x14>;
		mediatek,cali-ge-bit = <0xa>;
		mediatek,cali-oe-bit = <0x0>;
		nvmem = <0x38>;
		nvmem-names = "mtk_efuse";
		phandle = <0x2a>;
		reg = <0x0 0x11001000 0x0 0x1000>;
	};

	battery {
		ACTIVE_TABLE = <0x6>;
		CAR_TUNE_VALUE = <0x64>;
		COM_FG_METER_RESISTANCE = <0x64>;
		COM_R_FG_VALUE = <0x0>;
		DIFFERENCE_FULLOCV_ITH = <0xc8>;
		EMBEDDED_SEL = <0x1>;
		FG_METER_RESISTANCE = <0x77>;
		KEEP_100_PERCENT = <0x1>;
		MULTI_TEMP_GAUGE0 = <0x1>;
		PMIC_MIN_VOL = <0x82dc>;
		PMIC_SHUTDOWN_CURRENT = <0x14>;
		POWERON_SYSTEM_IBOOT = <0x1f4>;
		Q_MAX_SYS_VOLTAGE_BAT0 = <0xdc0>;
		Q_MAX_SYS_VOLTAGE_BAT1 = <0xdc0>;
		Q_MAX_SYS_VOLTAGE_BAT2 = <0xdc0>;
		Q_MAX_SYS_VOLTAGE_BAT3 = <0xdc0>;
		Q_MAX_SYS_VOLTAGE_BAT4 = <0xdc0>;
		R_FG_VALUE = <0xa>;
		SHUTDOWN_1_TIME = <0x1e>;
		SHUTDOWN_GAUGE0_VOLTAGE = <0x84d0>;
		TEMPERATURE_T0 = <0x32>;
		TEMPERATURE_T1 = <0x2d>;
		TEMPERATURE_T2 = <0x19>;
		TEMPERATURE_T3 = <0xa>;
		TEMPERATURE_T4 = <0x0>;
		TEMPERATURE_T5 = <0xfffffff6>;
		battery0_profile_t0 = <0x0 0xac6a 0x472 0x1f9 0xabd5 0x472 0x3f3 0xab4d 0x469 0x5ec 0xaad7 0x473 0x7e5 0xaa67 0x47c 0x9de 0xa9f6 0x47c 0xbd8 0xa981 0x471 0xdd1 0xa917 0x47c 0xfca 0xa8a0 0x472 0x11c3 0xa82a 0x469 0x13bd 0xa7b4 0x472 0x15b6 0xa73e 0x472 0x17af 0xa6c8 0x472 0x19a8 0xa652 0x47b 0x1ba2 0xa5d5 0x471 0x1d9b 0xa55f 0x472 0x1f94 0xa4e4 0x472 0x218d 0xa46e 0x474 0x2387 0xa3f7 0x47c 0x2580 0xa381 0x47c 0x2779 0xa30c 0x47e 0x2972 0xa29b 0x486 0x2b6c 0xa226 0x489 0x2d65 0xa1b7 0x494 0x2f5e 0xa145 0x498 0x3157 0xa0d1 0x490 0x3351 0xa062 0x493 0x354a 0x9ff7 0x49c 0x3743 0x9f8b 0x49e 0x393c 0x9f24 0x4a6 0x3b36 0x9eba 0x4a6 0x3d2f 0x9e59 0x4a6 0x3f28 0x9df3 0x4ad 0x4121 0x9d94 0x4ba 0x431b 0x9d30 0x4ba 0x4514 0x9cd1 0x4c1 0x470d 0x9c78 0x4ca 0x4906 0x9c1d 0x4c8 0x4b00 0x9bc6 0x4d2 0x4cf9 0x9b71 0x4e4 0x4ef2 0x9b1e 0x4f7 0x50eb 0x9ac7 0x4fc 0x52e5 0x9a6d 0x50a 0x54de 0x9a06 0x50d 0x56d7 0x997c 0x4e1 0x58d1 0x98e9 0x4ac 0x5aca 0x9874 0x492 0x5cc3 0x981a 0x486 0x5ebc 0x97cc 0x487 0x60b6 0x9788 0x487 0x62af 0x974a 0x487 0x64a8 0x970c 0x487 0x66a1 0x96d1 0x48d 0x689b 0x9699 0x48c 0x6a94 0x9661 0x486 0x6c8d 0x9630 0x48c 0x6e86 0x95fd 0x48c 0x7080 0x95cc 0x48d 0x7279 0x95a0 0x490 0x7472 0x9571 0x490 0x766b 0x9547 0x496 0x7865 0x9522 0x4a1 0x7a5e 0x94f9 0x4a4 0x7c57 0x94d1 0x4a4 0x7e50 0x94b0 0x4ac 0x804a 0x9489 0x4b0 0x8243 0x9466 0x4b0 0x843c 0x944b 0x4be 0x8635 0x942d 0x4c4 0x882f 0x940b 0x4c4 0x8a28 0x93ea 0x4cb 0x8c21 0x93bd 0x4bf 0x8e1a 0x9370 0x49b 0x9014 0x931d 0x490 0x920d 0x92e4 0x498 0x9406 0x92b2 0x493 0x95ff 0x9286 0x498 0x97f9 0x925a 0x49a 0x99f2 0x9225 0x49c 0x9beb 0x91fc 0x49c 0x9de4 0x91d7 0x49c 0x9fde 0x91ac 0x4a4 0xa1d7 0x9186 0x4ae 0xa3d0 0x9150 0x4a6 0xa5c9 0x910e 0x49d 0xa7c3 0x90d4 0x4a3 0xa9bc 0x9097 0x4af 0xabb5 0x9049 0x4a7 0xadae 0x8ff8 0x489 0xafa8 0x8fd4 0x47d 0xb1a1 0x8fcb 0x4a3 0xb39a 0x8fc0 0x4af 0xb594 0x8fb3 0x4c3 0xb78d 0x8fa7 0x4ec 0xb986 0x8f82 0x514 0xbb7f 0x8efe 0x4f9 0xbd79 0x8d9b 0x4c5 0xbf72 0x8bad 0x4e3 0xc16b 0x891b 0x4f8 0xc364 0x859b 0x535>;
		battery0_profile_t0_col = <0x3>;
		battery0_profile_t0_num = <0x64>;
		battery0_profile_t1 = <0x0 0xaca7 0x43f 0x1f9 0xac0c 0x43f 0x3f3 0xab84 0x43e 0x5ec 0xab08 0x435 0x7e5 0xaa97 0x43f 0x9de 0xaa27 0x43f 0xbd8 0xa9b8 0x43f 0xdd1 0xa948 0x43f 0xfca 0xa8d2 0x43f 0x11c3 0xa861 0x43f 0x13bd 0xa7eb 0x440 0x15b6 0xa76f 0x43f 0x17af 0xa6fa 0x440 0x19a8 0xa683 0x449 0x1ba2 0xa607 0x440 0x1d9b 0xa590 0x447 0x1f94 0xa515 0x440 0x218d 0xa49e 0x447 0x2387 0xa423 0x440 0x2580 0xa3ad 0x449 0x2779 0xa338 0x44b 0x2972 0xa2c6 0x453 0x2b6c 0xa252 0x455 0x2d65 0xa1e1 0x45c 0x2f5e 0xa16c 0x455 0x3157 0xa0fc 0x45d 0x3351 0xa08c 0x45d 0x354a 0xa01d 0x45e 0x3743 0x9fae 0x461 0x393c 0x9f45 0x464 0x3b36 0x9edb 0x45e 0x3d2f 0x9e75 0x463 0x3f28 0x9e14 0x472 0x4121 0x9dae 0x475 0x431b 0x9d4f 0x47c 0x4514 0x9cee 0x480 0x470d 0x9c93 0x48a 0x4906 0x9c3a 0x494 0x4b00 0x9bdf 0x49f 0x4cf9 0x9b88 0x4aa 0x4ef2 0x9b34 0x4b8 0x50eb 0x9ade 0x4c5 0x52e5 0x9a81 0x4cd 0x54de 0x9a18 0x4cb 0x56d7 0x9995 0x4a3 0x58d1 0x9905 0x473 0x5aca 0x9888 0x44f 0x5cc3 0x9827 0x43f 0x5ebc 0x97d9 0x43f 0x60b6 0x9791 0x43f 0x62af 0x9750 0x43f 0x64a8 0x9712 0x43a 0x66a1 0x96d7 0x43a 0x689b 0x969f 0x43f 0x6a94 0x966a 0x444 0x6c8d 0x9635 0x443 0x6e86 0x9601 0x43f 0x7080 0x95d3 0x445 0x7279 0x95a4 0x444 0x7472 0x9579 0x445 0x766b 0x954c 0x449 0x7865 0x9522 0x449 0x7a5e 0x94fd 0x44f 0x7c57 0x94dc 0x460 0x7e50 0x94b5 0x45b 0x804a 0x9492 0x461 0x8243 0x9472 0x46f 0x843c 0x944f 0x46a 0x8635 0x942e 0x46e 0x882f 0x9413 0x480 0x8a28 0x93f6 0x486 0x8c21 0x93ca 0x478 0x8e1a 0x938b 0x45b 0x9014 0x933d 0x43d 0x920d 0x9303 0x444 0x9406 0x92d2 0x441 0x95ff 0x92a5 0x446 0x97f9 0x9275 0x442 0x99f2 0x9243 0x43f 0x9beb 0x921b 0x447 0x9de4 0x91f0 0x441 0x9fde 0x91cf 0x448 0xa1d7 0x91ab 0x45b 0xa3d0 0x9171 0x44c 0xa5c9 0x9133 0x44a 0xa7c3 0x90f5 0x449 0xa9bc 0x90bc 0x453 0xabb5 0x9079 0x453 0xadae 0x901f 0x438 0xafa8 0x8ff4 0x435 0xb1a1 0x8fe5 0x43e 0xb39a 0x8fd8 0x451 0xb594 0x8fd1 0x470 0xb78d 0x8fc0 0x485 0xb986 0x8f9c 0x4a4 0xbb7f 0x8f42 0x4b0 0xbd79 0x8dfb 0x469 0xbf72 0x8c22 0x47c 0xc16b 0x89b0 0x49a 0xc364 0x8653 0x4d8>;
		battery0_profile_t1_col = <0x3>;
		battery0_profile_t1_num = <0x64>;
		battery0_profile_t2 = <0x0 0xacc0 0x5b9 0x1f9 0xac31 0x5b9 0x3f3 0xabc1 0x5a5 0x5ec 0xab58 0x59b 0x7e5 0xaaee 0x59b 0x9de 0xaa90 0x5a4 0xbd8 0xaa26 0x59c 0xdd1 0xa9bd 0x5a5 0xfca 0xa953 0x5a6 0x11c3 0xa8e3 0x5af 0x13bd 0xa86d 0x59a 0x15b6 0xa7f7 0x588 0x17af 0xa785 0x590 0x19a8 0xa70a 0x588 0x1ba2 0xa694 0x58e 0x1d9b 0xa61d 0x57a 0x1f94 0xa5a3 0x575 0x218d 0xa531 0x583 0x2387 0xa4b6 0x573 0x2580 0xa440 0x573 0x2779 0xa3c9 0x575 0x2972 0xa353 0x57d 0x2b6c 0xa2de 0x57d 0x2d65 0xa26d 0x57d 0x2f5e 0xa1f7 0x57b 0x3157 0xa182 0x57c 0x3351 0xa113 0x57d 0x354a 0xa0a3 0x580 0x3743 0xa035 0x58a 0x393c 0x9fcd 0x591 0x3b36 0x9f67 0x594 0x3d2f 0x9efe 0x59e 0x3f28 0x9e94 0x5a2 0x4121 0x9e2d 0x5a3 0x431b 0x9dc9 0x5b0 0x4514 0x9d6b 0x5bc 0x470d 0x9d0f 0x5cf 0x4906 0x9cad 0x5d3 0x4b00 0x9c55 0x5dd 0x4cf9 0x9bff 0x5f0 0x4ef2 0x9ba5 0x5fa 0x50eb 0x9b4b 0x5fb 0x52e5 0x9aed 0x60c 0x54de 0x9a85 0x5fe 0x56d7 0x9a0a 0x5da 0x58d1 0x997e 0x599 0x5aca 0x98f5 0x554 0x5cc3 0x9888 0x53a 0x5ebc 0x982e 0x530 0x60b6 0x97dd 0x52b 0x62af 0x9795 0x52a 0x64a8 0x9751 0x52b 0x66a1 0x9713 0x52a 0x689b 0x96d8 0x51f 0x6a94 0x96a1 0x522 0x6c8d 0x966c 0x52a 0x6e86 0x9637 0x52b 0x7080 0x9609 0x531 0x7279 0x95da 0x52f 0x7472 0x95ac 0x532 0x766b 0x9585 0x53c 0x7865 0x9558 0x539 0x7a5e 0x952e 0x53c 0x7c57 0x9509 0x53f 0x7e50 0x94e3 0x53f 0x804a 0x94c2 0x54d 0x8243 0x94a3 0x561 0x843c 0x9484 0x569 0x8635 0x9461 0x562 0x882f 0x9440 0x566 0x8a28 0x9420 0x568 0x8c21 0x9406 0x569 0x8e1a 0x93e4 0x561 0x9014 0x93bf 0x556 0x920d 0x9399 0x55b 0x9406 0x936b 0x54e 0x95ff 0x9343 0x549 0x97f9 0x9318 0x549 0x99f2 0x92e7 0x540 0x9beb 0x92ba 0x53e 0x9de4 0x9294 0x550 0x9fde 0x926f 0x542 0xa1d7 0x924f 0x55b 0xa3d0 0x9226 0x55f 0xa5c9 0x91ef 0x555 0xa7c3 0x91b2 0x553 0xa9bc 0x916e 0x54a 0xabb5 0x913a 0x55c 0xadae 0x90f2 0x55d 0xafa8 0x9096 0x54b 0xb1a1 0x905c 0x554 0xb39a 0x904d 0x566 0xb594 0x9040 0x573 0xb78d 0x9034 0x586 0xb986 0x901b 0x59b 0xbb7f 0x9009 0x5c4 0xbd79 0x8fca 0x602 0xbf72 0x8ee8 0x5ee 0xc16b 0x8d1f 0x5fa 0xc364 0x8ad8 0x62c>;
		battery0_profile_t2_col = <0x3>;
		battery0_profile_t2_num = <0x64>;
		battery0_profile_t3 = <0x0 0xacd8 0x9c6 0x1f9 0xac31 0x9c5 0x3f3 0xabaf 0x990 0x5ec 0xab45 0x932 0x7e5 0xaadc 0x8e4 0x9de 0xaa77 0x8d8 0xbd8 0xaa0e 0x8c4 0xdd1 0xa9a5 0x8b1 0xfca 0xa941 0x8af 0x11c3 0xa8d0 0x898 0x13bd 0xa860 0x87c 0x15b6 0xa7f0 0x873 0x17af 0xa77a 0x871 0x19a8 0xa703 0x85d 0x1ba2 0xa688 0x84b 0x1d9b 0xa611 0x846 0x1f94 0xa59b 0x834 0x218d 0xa524 0x82a 0x2387 0xa4aa 0x81f 0x2580 0xa438 0x814 0x2779 0xa3c3 0x809 0x2972 0xa34d 0x7f6 0x2b6c 0xa2d6 0x7ec 0x2d65 0xa262 0x7e4 0x2f5e 0xa1f1 0x7e4 0x3157 0xa181 0x7e3 0x3351 0xa114 0x7e1 0x354a 0xa0a8 0x7da 0x3743 0xa038 0x7d9 0x393c 0x9fca 0x7da 0x3b36 0x9f62 0x7d4 0x3d2f 0x9efd 0x7d0 0x3f28 0x9e95 0x7ef 0x4121 0x9e32 0x80a 0x431b 0x9dcc 0x817 0x4514 0x9d65 0x813 0x470d 0x9d01 0x80d 0x4906 0x9c9e 0x809 0x4b00 0x9c41 0x80a 0x4cf9 0x9beb 0x812 0x4ef2 0x9b8e 0x811 0x50eb 0x9b2f 0x813 0x52e5 0x9ac9 0x804 0x54de 0x9a59 0x7ea 0x56d7 0x99e6 0x7cb 0x58d1 0x996d 0x79d 0x5aca 0x98f7 0x76e 0x5cc3 0x988d 0x74a 0x5ebc 0x982d 0x730 0x60b6 0x97d6 0x726 0x62af 0x9788 0x71c 0x64a8 0x9744 0x716 0x66a1 0x9706 0x71c 0x689b 0x96cb 0x728 0x6a94 0x9690 0x726 0x6c8d 0x9658 0x727 0x6e86 0x9624 0x732 0x7080 0x95f7 0x743 0x7279 0x95c3 0x73d 0x7472 0x9593 0x735 0x766b 0x9567 0x743 0x7865 0x9540 0x751 0x7a5e 0x9516 0x75b 0x7c57 0x94ef 0x75f 0x7e50 0x94ca 0x766 0x804a 0x94a8 0x777 0x8243 0x9485 0x77e 0x843c 0x9465 0x77e 0x8635 0x9445 0x78d 0x882f 0x9426 0x791 0x8a28 0x940c 0x799 0x8c21 0x93ee 0x7a4 0x8e1a 0x93d4 0x7ae 0x9014 0x93bb 0x7b9 0x920d 0x93a7 0x7c3 0x9406 0x9394 0x7d6 0x95ff 0x9378 0x7da 0x97f9 0x935d 0x7e1 0x99f2 0x9340 0x7ec 0x9beb 0x931c 0x800 0x9de4 0x92ec 0x804 0x9fde 0x92c5 0x80c 0xa1d7 0x929f 0x831 0xa3d0 0x9275 0x840 0xa5c9 0x9249 0x86f 0xa7c3 0x9207 0x886 0xa9bc 0x91c2 0x89a 0xabb5 0x9184 0x8c2 0xadae 0x9145 0x8ff 0xafa8 0x90f5 0x91f 0xb1a1 0x909f 0x93f 0xb39a 0x906c 0x973 0xb594 0x9052 0x9b9 0xb78d 0x9040 0xa03 0xb986 0x9027 0xa75 0xbb7f 0x900e 0xb08 0xbd79 0x8fe7 0xbb8 0xbf72 0x8f8f 0xc85 0xc16b 0x8e8b 0xd1c 0xc364 0x8cd0 0xdfa>;
		battery0_profile_t3_col = <0x3>;
		battery0_profile_t3_num = <0x64>;
		battery0_profile_t4 = <0x0 0xacd2 0x101a 0x1f9 0xac11 0x101a 0x3f3 0xab7d 0x1019 0x5ec 0xaafb 0x100e 0x7e5 0xaa7f 0xfe8 0x9de 0xaa0f 0xfe4 0xbd8 0xa999 0xfbc 0xdd1 0xa929 0xf9f 0xfca 0xa8b9 0xfa5 0x11c3 0xa844 0xf68 0x13bd 0xa7d9 0xf43 0x15b6 0xa763 0xf3e 0x17af 0xa6ed 0xf15 0x19a8 0xa67d 0xef7 0x1ba2 0xa607 0xeda 0x1d9b 0xa591 0xebf 0x1f94 0xa51b 0xe90 0x218d 0xa4a5 0xe7e 0x2387 0xa42f 0xe6c 0x2580 0xa3bf 0xe42 0x2779 0xa34f 0xe3e 0x2972 0xa2da 0xe29 0x2b6c 0xa26a 0xe14 0x2d65 0xa1fa 0xe00 0x2f5e 0xa18b 0xdee 0x3157 0xa11a 0xde1 0x3351 0xa0ac 0xdd4 0x354a 0xa043 0xdd6 0x3743 0x9fd9 0xdca 0x393c 0x9f73 0xdd4 0x3b36 0x9f12 0xddb 0x3d2f 0x9ea7 0xdd9 0x3f28 0x9e34 0xdd1 0x4121 0x9dc0 0xdc6 0x431b 0x9d4e 0xda4 0x4514 0x9cdd 0xd85 0x470d 0x9c73 0xd73 0x4906 0x9c09 0xd55 0x4b00 0x9ba5 0xd42 0x4cf9 0x9b45 0xd2d 0x4ef2 0x9adc 0xd01 0x50eb 0x9a6d 0xceb 0x52e5 0x9a00 0xce1 0x54de 0x9996 0xcce 0x56d7 0x992c 0xcb3 0x58d1 0x98c5 0xc9e 0x5aca 0x9864 0xc8e 0x5cc3 0x980d 0xc83 0x5ebc 0x97bd 0xc7e 0x60b6 0x976c 0xc79 0x62af 0x9725 0xc7f 0x64a8 0x96e3 0xc8f 0x66a1 0x96a2 0xc93 0x689b 0x9664 0xc9e 0x6a94 0x962d 0xcbf 0x6c8d 0x95f4 0xccb 0x6e86 0x95c0 0xcde 0x7080 0x958e 0xcf0 0x7279 0x955d 0xd08 0x7472 0x9532 0xd1f 0x766b 0x9507 0xd37 0x7865 0x94db 0xd49 0x7a5e 0x94b3 0xd53 0x7c57 0x948e 0xd71 0x7e50 0x9469 0xd86 0x804a 0x9447 0xd9e 0x8243 0x942c 0xdb6 0x843c 0x940f 0xdc4 0x8635 0x93fd 0xdeb 0x882f 0x93e8 0xe09 0x8a28 0x93d8 0xe32 0x8c21 0x93c7 0xe67 0x8e1a 0x93b5 0xe94 0x9014 0x939d 0xec5 0x920d 0x9389 0xf18 0x9406 0x9372 0xf6e 0x95ff 0x9358 0xfd0 0x97f9 0x933b 0x1038 0x99f2 0x9317 0x10a0 0x9beb 0x92f2 0x111f 0x9de4 0x92c8 0x11af 0x9fde 0x9296 0x1237 0xa1d7 0x9265 0x12e0 0xa3d0 0x922e 0x139a 0xa5c9 0x91f7 0x1466 0xa7c3 0x91b4 0x153e 0xa9bc 0x916f 0x1604 0xabb5 0x9125 0x16c0 0xadae 0x90e6 0x17b2 0xafa8 0x90a2 0x18aa 0xb1a1 0x9064 0x19d3 0xb39a 0x9025 0x1aff 0xb594 0x8ff8 0x1ca0 0xb78d 0x8fc7 0x1e3f 0xb986 0x8f96 0x205e 0xbb7f 0x8f52 0x22c9 0xbd79 0x8efb 0x256a 0xbf72 0x8e61 0x2809 0xc16b 0x8d61 0x2ae0 0xc364 0x8bbb 0x2e60>;
		battery0_profile_t4_col = <0x3>;
		battery0_profile_t4_num = <0x64>;
		battery0_profile_t5 = <0x0 0xacfd 0x2492 0x1f9 0xabf3 0x2493 0x3f3 0xab13 0x24f7 0x5ec 0xaa4c 0x24d5 0x7e5 0xa98d 0x247b 0x9de 0xa8d8 0x2455 0xbd8 0xa825 0x23c8 0xdd1 0xa784 0x235f 0xfca 0xa6e2 0x22ee 0x11c3 0xa648 0x2287 0x13bd 0xa5b9 0x221e 0x15b6 0xa52b 0x21a2 0x17af 0xa4a4 0x213a 0x19a8 0xa427 0x20d0 0x1ba2 0xa3a6 0x209d 0x1d9b 0xa32f 0x2061 0x1f94 0xa2b4 0x2000 0x218d 0xa23e 0x1fbe 0x2387 0xa1c7 0x1f75 0x2580 0xa152 0x1f4e 0x2779 0xa0e4 0x1f0b 0x2972 0xa07c 0x1ee4 0x2b6c 0xa018 0x1ec5 0x2d65 0x9fb2 0x1ea1 0x2f5e 0x9f42 0x1e6d 0x3157 0x9ece 0x1e3d 0x3351 0x9e4c 0x1e0e 0x354a 0x9dd2 0x1dcd 0x3743 0x9d5e 0x1d8a 0x393c 0x9cf2 0x1d63 0x3b36 0x9c8c 0x1d06 0x3d2f 0x9c27 0x1c7d 0x3f28 0x9bcb 0x1cea 0x4121 0x9b76 0x1cd6 0x431b 0x9b21 0x1ccb 0x4514 0x9ac2 0x1ca5 0x470d 0x9a5f 0x1c80 0x4906 0x99fd 0x1c76 0x4b00 0x999e 0x1c60 0x4cf9 0x993b 0x1c43 0x4ef2 0x98d9 0x1c34 0x50eb 0x987c 0x1c1c 0x52e5 0x9825 0x1c0a 0x54de 0x97d1 0x1c0a 0x56d7 0x977c 0x1bff 0x58d1 0x9731 0x1c0c 0x5aca 0x96ea 0x1c1e 0x5cc3 0x96a5 0x1c17 0x5ebc 0x9667 0x1c27 0x60b6 0x9629 0x1c3c 0x62af 0x95ee 0x1c51 0x64a8 0x95b9 0x1c60 0x66a1 0x9584 0x1c6a 0x689b 0x9553 0x1c90 0x6a94 0x9527 0x1cbe 0x6c8d 0x94ff 0x1ce8 0x6e86 0x94de 0x1d10 0x7080 0x94bf 0x1d47 0x7279 0x94a3 0x1d84 0x7472 0x948a 0x1dbe 0x766b 0x9472 0x1e0f 0x7865 0x945d 0x1e60 0x7a5e 0x944e 0x1ecf 0x7c57 0x9439 0x1f3b 0x7e50 0x9425 0x1fac 0x804a 0x940e 0x2029 0x8243 0x93f5 0x20ac 0x843c 0x93e1 0x213a 0x8635 0x93ca 0x21c3 0x882f 0x93b0 0x226e 0x8a28 0x9393 0x2314 0x8c21 0x9379 0x23dc 0x8e1a 0x935b 0x24a5 0x9014 0x933d 0x256b 0x920d 0x9319 0x2638 0x9406 0x92f4 0x26ef 0x95ff 0x92d3 0x27a7 0x97f9 0x92aa 0x2839 0x99f2 0x9283 0x28e0 0x9beb 0x9259 0x2976 0x9de4 0x922e 0x2a11 0x9fde 0x9202 0x2a81 0xa1d7 0x91d2 0x2b15 0xa3d0 0x919a 0x2b71 0xa5c9 0x9168 0x2bf2 0xa7c3 0x912c 0x2c70 0xa9bc 0x90f3 0x2cfd 0xabb5 0x90b6 0x2d74 0xadae 0x9077 0x2e09 0xafa8 0x9039 0x2eaf 0xb1a1 0x9000 0x2f83 0xb39a 0x8fce 0x3071 0xb594 0x8fa2 0x31a2 0xb78d 0x8f77 0x3300 0xb986 0x8f40 0x34f5 0xbb7f 0x8ef6 0x3791 0xbd79 0x8e8d 0x374b 0xbf72 0x8e19 0x368a 0xc16b 0x8e19 0x368a 0xc364 0x8e19 0x368a>;
		battery0_profile_t5_col = <0x3>;
		battery0_profile_t5_num = <0x64>;
		battery1_profile_t0 = <0x0 0xac53 0x3d4 0x1f9 0xabe3 0x3d6 0x3f2 0xab7f 0x3e1 0x5eb 0xab14 0x3d6 0x7e4 0xaaab 0x3d6 0x9dd 0xaa4d 0x3d6 0xbd6 0xa9e2 0x3d6 0xdcf 0xa978 0x3d6 0xfc8 0xa914 0x3d6 0x11c1 0xa8a9 0x3d6 0x13bb 0xa839 0x3d5 0x15b4 0xa7c9 0x3cd 0x17ad 0xa75e 0x3d7 0x19a6 0xa6ed 0x3e1 0x1b9f 0xa67c 0x3e7 0x1d98 0xa607 0x3d8 0x1f91 0xa59a 0x3e8 0x218a 0xa51f 0x3e1 0x2383 0xa4ae 0x3eb 0x257c 0xa439 0x3ed 0x2775 0xa3cc 0x3f4 0x296e 0xa357 0x3f5 0x2b67 0xa2e6 0x3f7 0x2d60 0xa275 0x3fc 0x2f59 0xa206 0x3f7 0x3152 0xa19b 0x3fe 0x334b 0xa12d 0x402 0x3544 0xa0c8 0x40d 0x373d 0xa05c 0x411 0x3936 0x9fef 0x40f 0x3b30 0x9f8a 0x41d 0x3d29 0x9f26 0x420 0x3f22 0x9ec2 0x42c 0x411b 0x9e60 0x433 0x4314 0x9e01 0x436 0x450d 0x9d9e 0x440 0x4706 0x9d40 0x447 0x48ff 0x9ce2 0x447 0x4af8 0x9c87 0x44e 0x4cf1 0x9c2e 0x45d 0x4eea 0x9bce 0x45c 0x50e3 0x9b63 0x455 0x52dc 0x9ae2 0x433 0x54d5 0x9a4e 0x3fe 0x56ce 0x99ca 0x3e7 0x58c7 0x9962 0x3dd 0x5ac0 0x990d 0x3d9 0x5cb9 0x98c0 0x3dc 0x5eb2 0x9879 0x3d6 0x60ab 0x9833 0x3d6 0x62a5 0x97f5 0x3da 0x649e 0x97b6 0x3dd 0x6697 0x9778 0x3d6 0x6890 0x973f 0x3de 0x6a89 0x970a 0x3e5 0x6c82 0x96d1 0x3e0 0x6e7b 0x969c 0x3e5 0x7074 0x966d 0x3ef 0x726d 0x963e 0x3f9 0x7466 0x960f 0x3ff 0x765f 0x95e3 0x403 0x7858 0x95b8 0x40f 0x7a51 0x958c 0x414 0x7c4a 0x9563 0x413 0x7e43 0x953b 0x414 0x803c 0x9516 0x425 0x8235 0x94f0 0x42e 0x842e 0x94c7 0x42e 0x8627 0x949e 0x42e 0x8820 0x9465 0x417 0x8a1a 0x941c 0x3f8 0x8c13 0x93ca 0x3ea 0x8e0c 0x9381 0x3ea 0x9005 0x9346 0x3f0 0x91fe 0x9312 0x3f5 0x93f7 0x92dc 0x3ef 0x95f0 0x92a4 0x3ea 0x97e9 0x926f 0x3ea 0x99e2 0x9241 0x3ea 0x9bdb 0x9211 0x3f0 0x9dd4 0x91e3 0x3fb 0x9fcd 0x91af 0x3f8 0xa1c6 0x9167 0x3ee 0xa3bf 0x911e 0x3e4 0xa5b8 0x90dd 0x3e0 0xa7b1 0x9096 0x3e0 0xa9aa 0x9047 0x3d1 0xaba3 0x9010 0x3cb 0xad9c 0x8ffa 0x3db 0xaf95 0x8fee 0x3e7 0xb18f 0x8fe1 0x3f9 0xb388 0x8fd0 0x415 0xb581 0x8fa7 0x42d 0xb77a 0x8f41 0x424 0xb973 0x8e34 0x3ff 0xbb6c 0x8c91 0x3fd 0xbd65 0x8a78 0x40f 0xbf5e 0x87be 0x435 0xc157 0x83f0 0x487 0xc350 0x831a 0x49a>;
		battery1_profile_t0_col = <0x3>;
		battery1_profile_t0_num = <0x64>;
		battery1_profile_t1 = <0x0 0xacd2 0x40d 0x1f9 0xac4a 0x40d 0x3f2 0xabce 0x401 0x5eb 0xab5e 0x401 0x7e4 0xaaee 0x3f7 0x9dd 0xaa85 0x3f7 0xbd6 0xaa1b 0x3f8 0xdcf 0xa9b2 0x403 0xfc8 0xa948 0x402 0x11c1 0xa8dd 0x40a 0x13bb 0xa86e 0x401 0x15b4 0xa7fd 0x401 0x17ad 0xa788 0x401 0x19a6 0xa717 0x402 0x1b9f 0xa6a1 0x40a 0x1d98 0xa62c 0x404 0x1f91 0xa5bb 0x40b 0x218a 0xa545 0x40b 0x2383 0xa4cf 0x40d 0x257c 0xa45a 0x415 0x2775 0xa3e9 0x415 0x296e 0xa373 0x417 0x2b67 0xa2fe 0x419 0x2d60 0xa28e 0x420 0x2f59 0xa21e 0x422 0x3152 0xa1b0 0x42d 0x334b 0xa145 0x435 0x3544 0xa0d8 0x43a 0x373d 0xa073 0x449 0x3936 0xa00a 0x449 0x3b30 0x9fa0 0x44a 0x3d29 0x9f38 0x44f 0x3f22 0x9ed5 0x45e 0x411b 0x9e71 0x45d 0x4314 0x9e10 0x465 0x450d 0x9db3 0x472 0x4706 0x9d56 0x476 0x48ff 0x9cf9 0x480 0x4af8 0x9c9e 0x487 0x4cf1 0x9c47 0x48f 0x4eea 0x9bed 0x49a 0x50e3 0x9b8d 0x49b 0x52dc 0x9b25 0x493 0x54d5 0x9aa2 0x470 0x56ce 0x9a0a 0x43c 0x58c7 0x9988 0x421 0x5ac0 0x9924 0x417 0x5cb9 0x98cd 0x407 0x5eb2 0x9882 0x401 0x60ab 0x983d 0x401 0x62a5 0x97fc 0x406 0x649e 0x97be 0x40b 0x6697 0x9783 0x410 0x6890 0x9748 0x411 0x6a89 0x9711 0x417 0x6c82 0x96db 0x419 0x6e7b 0x96a7 0x416 0x7074 0x9672 0x416 0x726d 0x9641 0x41b 0x7466 0x9615 0x42c 0x765f 0x95e6 0x42f 0x7858 0x95bc 0x43d 0x7a51 0x9597 0x449 0x7c4a 0x956a 0x442 0x7e43 0x9540 0x44c 0x803c 0x951f 0x459 0x8235 0x94f7 0x456 0x842e 0x94d5 0x461 0x8627 0x94b2 0x468 0x8820 0x9488 0x461 0x8a1a 0x9453 0x44f 0x8c13 0x9405 0x424 0x8e0c 0x93b7 0x415 0x9005 0x9376 0x416 0x91fe 0x9341 0x426 0x93f7 0x930b 0x422 0x95f0 0x92d7 0x428 0x97e9 0x92a1 0x423 0x99e2 0x9273 0x429 0x9bdb 0x9242 0x421 0x9dd4 0x921a 0x427 0x9fcd 0x91eb 0x433 0xa1c6 0x91af 0x42c 0xa3bf 0x916c 0x42b 0xa5b8 0x9122 0x418 0xa7b1 0x90e8 0x428 0xa9aa 0x90a0 0x422 0xaba3 0x904a 0x405 0xad9c 0x901f 0x3f8 0xaf95 0x9010 0x413 0xb18f 0x9003 0x427 0xb388 0x8ff7 0x43d 0xb581 0x8fdf 0x451 0xb77a 0x8faf 0x470 0xb973 0x8f1a 0x44b 0xbb6c 0x8dc2 0x42c 0xbd65 0x8bee 0x43e 0xbf5e 0x8998 0x454 0xc157 0x867a 0x47c 0xc350 0x8672 0x47c>;
		battery1_profile_t1_col = <0x3>;
		battery1_profile_t1_num = <0x64>;
		battery1_profile_t2 = <0x0 0xacc9 0x45d 0x1f9 0xac5f 0x45d 0x3f2 0xabf4 0x45b 0x5eb 0xab90 0x45c 0x7e4 0xab26 0x449 0x9dd 0xaac8 0x45c 0xbd6 0xaa5d 0x447 0xdcf 0xa9f3 0x448 0xfc8 0xa98f 0x455 0x11c1 0xa930 0x471 0x13bb 0xa8bf 0x46e 0x15b4 0xa84e 0x45b 0x17ad 0xa7dd 0x45c 0x19a6 0xa76c 0x45d 0x1b9f 0xa6fb 0x465 0x1d98 0xa683 0x45b 0x1f91 0xa607 0x454 0x218a 0xa591 0x45e 0x2383 0xa520 0x469 0x257c 0xa4b0 0x47d 0x2775 0xa43d 0x481 0x296e 0xa3c7 0x473 0x2b67 0xa356 0x478 0x2d60 0xa2e0 0x473 0x2f59 0xa271 0x480 0x3152 0xa203 0x48b 0x334b 0xa18e 0x47b 0x3544 0xa11f 0x482 0x373d 0xa0b6 0x496 0x3936 0xa052 0x4ae 0x3b30 0x9fec 0x4ba 0x3d29 0x9f83 0x4ab 0x3f22 0x9f1f 0x4bc 0x411b 0x9ebb 0x4c4 0x4314 0x9e59 0x4c7 0x450d 0x9df7 0x4ce 0x4706 0x9d90 0x4d2 0x48ff 0x9d32 0x4dc 0x4af8 0x9cd7 0x4ea 0x4cf1 0x9c7c 0x4ff 0x4eea 0x9c1c 0x508 0x50e3 0x9bb0 0x4f9 0x52dc 0x9b2f 0x4d2 0x54d5 0x9a9f 0x498 0x56ce 0x9a14 0x468 0x58c7 0x999f 0x44c 0x5ac0 0x993e 0x43e 0x5cb9 0x98e6 0x42d 0x5eb2 0x98a0 0x437 0x60ab 0x985e 0x447 0x62a5 0x981d 0x447 0x649e 0x97e1 0x442 0x6697 0x97a6 0x442 0x6890 0x976a 0x43b 0x6a89 0x9732 0x43d 0x6c82 0x9700 0x447 0x6e7b 0x96c7 0x441 0x7074 0x9690 0x444 0x726d 0x9665 0x459 0x7466 0x963b 0x46c 0x765f 0x9610 0x46b 0x7858 0x95e4 0x467 0x7a51 0x95b8 0x467 0x7c4a 0x9590 0x46d 0x7e43 0x956f 0x47f 0x803c 0x9547 0x47f 0x8235 0x9523 0x481 0x842e 0x9500 0x486 0x8627 0x94df 0x48d 0x8820 0x94b7 0x489 0x8a1a 0x948f 0x485 0x8c13 0x9461 0x476 0x8e0c 0x942a 0x469 0x9005 0x93f6 0x45e 0x91fe 0x93c4 0x45c 0x93f7 0x938e 0x455 0x95f0 0x935a 0x451 0x97e9 0x9323 0x44b 0x99e2 0x92f9 0x457 0x9bdb 0x92cf 0x45c 0x9dd4 0x92a8 0x465 0x9fcd 0x9273 0x467 0xa1c6 0x9236 0x45e 0xa3bf 0x91ec 0x453 0xa5b8 0x91b1 0x46c 0xa7b1 0x9179 0x479 0xa9aa 0x9130 0x47b 0xaba3 0x90d4 0x456 0xad9c 0x90a8 0x451 0xaf95 0x9099 0x45b 0xb18f 0x908c 0x478 0xb388 0x9080 0x48f 0xb581 0x9068 0x4a3 0xb77a 0x904f 0x4c1 0xb973 0x8ffb 0x4cd 0xbb6c 0x8edf 0x47e 0xbd65 0x8d2e 0x471 0xbf5e 0x8b04 0x484 0xc157 0x8825 0x49a 0xc350 0x881e 0x49a>;
		battery1_profile_t2_col = <0x3>;
		battery1_profile_t2_num = <0x64>;
		battery1_profile_t3 = <0x0 0xac9e 0x62e 0x1f9 0xac2d 0x62e 0x3f2 0xabc9 0x62d 0x5eb 0xab6b 0x624 0x7e4 0xab07 0x624 0x9dd 0xaaa9 0x623 0xbd6 0xaa44 0x617 0xdcf 0xa9da 0x60f 0xfc8 0xa97c 0x617 0x11c1 0xa911 0x60d 0x13bb 0xa8a0 0x604 0x15b4 0xa82f 0x603 0x17ad 0xa7c4 0x603 0x19a6 0xa74d 0x5f9 0x1b9f 0xa6dc 0x5fa 0x1d98 0xa665 0x5f7 0x1f91 0xa5ef 0x5e4 0x218a 0xa57d 0x5e5 0x2383 0xa507 0x5e6 0x257c 0xa491 0x5e4 0x2775 0xa420 0x5e5 0x296e 0xa3ae 0x5e4 0x2b67 0xa338 0x5da 0x2d60 0xa2c7 0x5da 0x2f59 0xa257 0x5dd 0x3152 0xa1e7 0x5e5 0x334b 0xa17d 0x5e6 0x3544 0xa111 0x5e8 0x373d 0xa0a2 0x5f3 0x3936 0xa037 0x5fa 0x3b30 0x9fcf 0x5fd 0x3d29 0x9f69 0x604 0x3f22 0x9f00 0x607 0x411b 0x9e9e 0x615 0x4314 0x9e3c 0x623 0x450d 0x9dd5 0x626 0x4706 0x9d75 0x62c 0x48ff 0x9d11 0x62d 0x4af8 0x9caf 0x635 0x4cf1 0x9c4f 0x63e 0x4eea 0x9be3 0x62f 0x50e3 0x9b6a 0x611 0x52dc 0x9aea 0x5e8 0x54d5 0x9a67 0x5be 0x56ce 0x99e9 0x599 0x58c7 0x997a 0x57a 0x5ac0 0x991c 0x564 0x5cb9 0x98c9 0x559 0x5eb2 0x987e 0x553 0x60ab 0x9836 0x54e 0x62a5 0x97f5 0x544 0x649e 0x97b6 0x544 0x6697 0x977b 0x549 0x6890 0x9742 0x54f 0x6a89 0x9706 0x54e 0x6c82 0x96cf 0x54a 0x6e7b 0x969d 0x556 0x7074 0x966a 0x55e 0x726d 0x963c 0x55e 0x7466 0x9610 0x56b 0x765f 0x95e1 0x573 0x7858 0x95b3 0x56d 0x7a51 0x958a 0x57c 0x7c4a 0x9564 0x587 0x7e43 0x953b 0x588 0x803c 0x9514 0x589 0x8235 0x94ee 0x58e 0x842e 0x94cc 0x599 0x8627 0x94a9 0x59d 0x8820 0x9483 0x5a4 0x8a1a 0x9462 0x5a7 0x8c13 0x943e 0x5a7 0x8e0c 0x9414 0x597 0x9005 0x93ed 0x592 0x91fe 0x93be 0x593 0x93f7 0x938c 0x58b 0x95f0 0x9355 0x578 0x97e9 0x9322 0x574 0x99e2 0x92f4 0x57b 0x9bdb 0x92c9 0x57e 0x9dd4 0x929c 0x585 0x9fcd 0x926c 0x588 0xa1c6 0x9230 0x580 0xa3bf 0x91eb 0x57d 0xa5b8 0x91b1 0x57e 0xa7b1 0x9174 0x57f 0xa9aa 0x912a 0x586 0xaba3 0x90d4 0x56b 0xad9c 0x90a8 0x572 0xaf95 0x9094 0x57d 0xb18f 0x907b 0x57d 0xb388 0x906d 0x599 0xb581 0x905b 0x5cd 0xb77a 0x9037 0x5f7 0xb973 0x8fdd 0x618 0xbb6c 0x8ec0 0x5d3 0xbd65 0x8d09 0x5da 0xbf5e 0x8ac7 0x5f8 0xc157 0x87bc 0x622 0xc350 0x833f 0x675>;
		battery1_profile_t3_col = <0x3>;
		battery1_profile_t3_num = <0x64>;
		battery1_profile_t4 = <0x0 0xacab 0xac7 0x1f9 0xac2d 0xac7 0x3f2 0xabbd 0xac7 0x5eb 0xab58 0xabc 0x7e4 0xaaf4 0xaa8 0x9dd 0xaa96 0xa9d 0xbd6 0xaa31 0xa92 0xdcf 0xa9c7 0xa7d 0xfc8 0xa962 0xa68 0x11c1 0xa8f7 0xa54 0x13bb 0xa88c 0xa4b 0x15b4 0xa820 0xa47 0x17ad 0xa7a9 0xa29 0x19a6 0xa732 0xa16 0x1b9f 0xa6c1 0xa0b 0x1d98 0xa64e 0x9ff 0x1f91 0xa5d3 0x9ee 0x218a 0xa561 0x9ec 0x2383 0xa4eb 0x9e2 0x257c 0xa479 0x9d7 0x2775 0xa401 0x9cf 0x296e 0xa38c 0x9cf 0x2b67 0xa319 0x9ca 0x2d60 0xa2a4 0x9ba 0x2f59 0xa231 0x9b7 0x3152 0xa1bd 0x9b3 0x334b 0xa151 0x9ba 0x3544 0xa0e2 0x9bb 0x373d 0xa077 0x9bb 0x3936 0xa00a 0x9be 0x3b30 0x9f9b 0x9c5 0x3d29 0x9f31 0x9c5 0x3f22 0x9ec6 0x9c5 0x411b 0x9e5b 0x9c9 0x4314 0x9df1 0x9cf 0x450d 0x9d86 0x9cb 0x4706 0x9d1b 0x9c5 0x48ff 0x9cb1 0x9c5 0x4af8 0x9c3d 0x9b7 0x4cf1 0x9bc3 0x997 0x4eea 0x9b4c 0x978 0x50e3 0x9ad4 0x95d 0x52dc 0x9a5a 0x939 0x54d5 0x99e6 0x920 0x56ce 0x997f 0x914 0x58c7 0x991e 0x905 0x5ac0 0x98c7 0x901 0x5cb9 0x9875 0x8fb 0x5eb2 0x9827 0x8f6 0x60ab 0x97df 0x8f6 0x62a5 0x979e 0x8fc 0x649e 0x9763 0x907 0x6697 0x9727 0x90b 0x6890 0x96ec 0x911 0x6a89 0x96b4 0x91c 0x6c82 0x967f 0x926 0x6e7b 0x9649 0x92a 0x7074 0x9615 0x92a 0x726d 0x95e7 0x940 0x7466 0x95b6 0x949 0x765f 0x9589 0x950 0x7858 0x955d 0x962 0x7a51 0x9535 0x970 0x7c4a 0x9510 0x982 0x7e43 0x94e5 0x987 0x803c 0x94be 0x98f 0x8235 0x949e 0x9a2 0x842e 0x9479 0x9ae 0x8627 0x9454 0x9c1 0x8820 0x942e 0x9cd 0x8a1a 0x940d 0x9d8 0x8c13 0x93ee 0x9e2 0x8e0c 0x93cf 0x9ed 0x9005 0x93af 0x9f7 0x91fe 0x9390 0xa02 0x93f7 0x936b 0xa0c 0x95f0 0x9345 0xa17 0x97e9 0x9320 0xa2b 0x99e2 0x92f4 0xa36 0x9bdb 0x92c2 0xa4a 0x9dd4 0x9290 0xa69 0x9fcd 0x9258 0xa7e 0xa1c6 0x9213 0xa9e 0xa3bf 0x91d4 0xabd 0xa5b8 0x9195 0xaf1 0xa7b1 0x914a 0xb26 0xa9aa 0x90f8 0xb5a 0xaba3 0x90af 0xb8f 0xad9c 0x9083 0xbd9 0xaf95 0x905e 0xc30 0xb18f 0x903f 0xca6 0xb388 0x901e 0xd48 0xb581 0x8fef 0xe12 0xb77a 0x8fa2 0xf04 0xb973 0x8efe 0x1044 0xbb6c 0x8da4 0x118e 0xbd65 0x8b9a 0x1403 0xbf5e 0x88dc 0x1944 0xc157 0x85fd 0x21bf 0xc350 0x85fd 0x21bf>;
		battery1_profile_t4_col = <0x3>;
		battery1_profile_t4_num = <0x64>;
		battery1_profile_t5 = <0x0 0xacc3 0x1374 0x1f9 0xac1a 0x1375 0x3f2 0xab97 0x137f 0x5eb 0xab1a 0x137f 0x7e4 0xaaa3 0x136a 0x9dd 0xaa38 0x1355 0xbd6 0xa9ce 0x1340 0xdcf 0xa962 0x1329 0xfc8 0xa8ec 0x1300 0x11c1 0xa881 0x12e1 0x13bb 0xa816 0x12c2 0x15b4 0xa7a4 0x12a2 0x17ad 0xa72d 0x1284 0x19a6 0xa6bd 0x126f 0x1b9f 0xa651 0x1259 0x1d98 0xa5db 0x123b 0x1f91 0xa568 0x1226 0x218a 0xa4f2 0x120f 0x2383 0xa482 0x11f2 0x257c 0xa40f 0x11dd 0x2775 0xa399 0x11c6 0x296e 0xa328 0x11ae 0x2b67 0xa2b8 0x11a9 0x2d60 0xa247 0x1194 0x2f59 0xa1d4 0x117f 0x3152 0xa160 0x116a 0x334b 0xa0f4 0x115c 0x3544 0xa083 0x1155 0x373d 0xa012 0x1140 0x3936 0x9fa3 0x1132 0x3b30 0x9f36 0x112f 0x3d29 0x9ec7 0x1124 0x3f22 0x9e5d 0x111e 0x411b 0x9ded 0x1111 0x4314 0x9d78 0x10f6 0x450d 0x9d07 0x10e6 0x4706 0x9c94 0x10d2 0x48ff 0x9c1d 0x10b3 0x4af8 0x9ba8 0x1098 0x4cf1 0x9b37 0x107e 0x4eea 0x9ac9 0x1069 0x50e3 0x9a5b 0x1059 0x52dc 0x99f1 0x1044 0x54d5 0x998c 0x1035 0x56ce 0x992f 0x1030 0x58c7 0x98d7 0x1030 0x5ac0 0x987f 0x102a 0x5cb9 0x982e 0x1026 0x5eb2 0x97e3 0x1026 0x60ab 0x979b 0x1032 0x62a5 0x975a 0x103a 0x649e 0x971b 0x1047 0x6697 0x96dc 0x1056 0x6890 0x96a2 0x1059 0x6a89 0x9669 0x1067 0x6c82 0x9631 0x106e 0x6e7b 0x95fc 0x107c 0x7074 0x95ce 0x1091 0x726d 0x959e 0x109e 0x7466 0x9570 0x10b0 0x765f 0x9544 0x10c5 0x7858 0x951d 0x10e2 0x7a51 0x94f3 0x10f2 0x7c4a 0x94c7 0x10fc 0x7e43 0x94a0 0x110f 0x803c 0x947a 0x1123 0x8235 0x9459 0x1138 0x842e 0x943a 0x114d 0x8627 0x9420 0x117c 0x8820 0x9407 0x119f 0x8a1a 0x93ee 0x11be 0x8c13 0x93d4 0x11ef 0x8e0c 0x93b6 0x1212 0x9005 0x939c 0x123a 0x91fe 0x937d 0x1264 0x93f7 0x935e 0x1297 0x95f0 0x933f 0x12d5 0x97e9 0x9319 0x131e 0x99e2 0x92e8 0x1353 0x9bdb 0x92bc 0x139b 0x9dd4 0x928a 0x13ef 0x9fcd 0x9252 0x144c 0xa1c6 0x9219 0x14bf 0xa3bf 0x91d4 0x1528 0xa5b8 0x918f 0x15a6 0xa7b1 0x914a 0x1642 0xa9aa 0x90f8 0x16cc 0xaba3 0x90ae 0x1780 0xad9c 0x9070 0x1853 0xaf95 0x9044 0x1948 0xb18f 0x9018 0x1a7e 0xb388 0x8fe5 0x1c01 0xb581 0x8faa 0x1df9 0xb77a 0x8f4f 0x20c6 0xb973 0x8ea9 0x24ee 0xbb6c 0x8d89 0x2b9a 0xbd65 0x8c24 0x329f 0xbf5e 0x8c24 0x329f 0xc157 0x8c24 0x329f 0xc350 0x8c24 0x329f>;
		battery1_profile_t5_col = <0x3>;
		battery1_profile_t5_num = <0x64>;
		compatible = "mediatek,bat_gm30";
		enable_tmp_intr_suspend = <0x0>;
		g_FG_PSEUDO100_T0 = <0x5f>;
		g_FG_PSEUDO100_T1 = <0x5f>;
		g_FG_PSEUDO100_T2 = <0x5f>;
		g_FG_PSEUDO100_T3 = <0x5f>;
		g_FG_PSEUDO100_T4 = <0x5f>;
		g_FG_PSEUDO100_T5 = <0x5f>;
		phandle = <0xbb>;
	};

	bpi_bsi_slv0@1021e000 {
		compatible = "mediatek,bpi_bsi_slv0";
		reg = <0x0 0x1021e000 0x0 0x1000>;
	};

	bpi_bsi_slv1@1021f000 {
		compatible = "mediatek,bpi_bsi_slv1";
		reg = <0x0 0x1021f000 0x0 0x6000>;
	};

	bpi_bsi_slv2@10225000 {
		compatible = "mediatek,bpi_bsi_slv2";
		reg = <0x0 0x10225000 0x0 0x1000>;
	};

	btif@1100c000 {
		clock-names = "btifc", "apdmac";
		clocks = <0x26 0x1a 0x26 0x26>;
		compatible = "mediatek,btif";
		interrupts = <0x0 0x85 0x8 0x0 0x73 0x8 0x0 0x8d 0x8>;
		reg = <0x0 0x1100c000 0x0 0x1000 0x0 0x11000b80 0x0 0x80 0x0 0x11000c00 0x0 0x80>;
	};

	bus_dbg@10208000 {
		compatible = "mediatek,bus_dbg-v2";
		interrupts = <0x0 0x9e 0x8>;
		mediatek,bus_dbg_con_offset = <0x2fc>;
		reg = <0x0 0x10208000 0x0 0x1000 0x0 0x10001000 0x0 0x1000>;
	};

	cache_parity {
		compatible = "mediatek,mt6785-cache-parity";
		interrupts = <0x0 0x16 0x4 0x0 0x17 0x4 0x0 0x18 0x4 0x0 0x19 0x4 0x0 0x1a 0x4 0x0 0x1b 0x4 0x0 0x1c 0x4 0x0 0x1d 0x4 0x0 0x13 0x4>;
		irq_config = <0x0 0x8090 0xff00 0x8090 0x44 0x8090 0xff 0x1 0x8090 0xff00 0x8090 0x44 0x8090 0xff 0x2 0x8090 0xff00 0x8090 0x44 0x8090 0xff 0x3 0x8090 0xff00 0x8090 0x44 0x8090 0xff 0x4 0x8090 0xff00 0x8090 0x44 0x8090 0xff 0x5 0x8090 0xff00 0x8090 0x44 0x8090 0xff 0x6 0x8090 0xff00 0x8090 0x44 0x8090 0xff 0x7 0x8090 0xff00 0x8090 0x44 0x8090 0xff 0x400 0xc8c0 0x1000000 0xc8c0 0xc 0xc8c8 0x1>;
		reg = <0x0 0xc530000 0x0 0x10000>;
	};

	cam1@1a003000 {
		compatible = "mediatek,cam1";
		interrupts = <0x0 0xfa 0x8>;
		reg = <0x0 0x1a003000 0x0 0x1000>;
	};

	cam2@1a004000 {
		compatible = "mediatek,cam2";
		interrupts = <0x0 0xfb 0x8>;
		reg = <0x0 0x1a004000 0x0 0x1000>;
	};

	cam3@1a005000 {
		compatible = "mediatek,cam3";
		interrupts = <0x0 0xfc 0x8>;
		reg = <0x0 0x1a005000 0x0 0x1000>;
	};

	cam_clear@1a01b000 {
		compatible = "mediatek,cam_clear";
		reg = <0x0 0x1a01b000 0x0 0x1000>;
	};

	cam_inner@1a013000 {
		compatible = "mediatek,cam_inner";
		reg = <0x0 0x1a013000 0x0 0x1000>;
	};

	cam_set@1a00b000 {
		compatible = "mediatek,cam_set";
		reg = <0x0 0x1a00b000 0x0 0x1000>;
	};

	cama_clear@1a01c000 {
		compatible = "mediatek,cama_clear";
		reg = <0x0 0x1a01c000 0x0 0x1000>;
	};

	cama_ext@1a024000 {
		compatible = "mediatek,cama_ext";
		reg = <0x0 0x1a024000 0x0 0x1000>;
	};

	cama_inner@1a014000 {
		compatible = "mediatek,cama_inner";
		reg = <0x0 0x1a014000 0x0 0x1000>;
	};

	cama_set@1a00c000 {
		compatible = "mediatek,cama_set";
		reg = <0x0 0x1a00c000 0x0 0x1000>;
	};

	camb_clear@1a01d000 {
		compatible = "mediatek,camb_clear";
		reg = <0x0 0x1a01d000 0x0 0x1000>;
	};

	camb_ext@1a025000 {
		compatible = "mediatek,camb_ext";
		reg = <0x0 0x1a025000 0x0 0x1000>;
	};

	camb_inner@1a015000 {
		compatible = "mediatek,camb_inner";
		reg = <0x0 0x1a015000 0x0 0x1000>;
	};

	camb_set@1a00d000 {
		compatible = "mediatek,camb_set";
		reg = <0x0 0x1a00d000 0x0 0x1000>;
	};

	camera_af_hw_node {
		compatible = "mediatek,camera_af_lens";
		phandle = <0xe8>;
	};

	camsv1@1a050000 {
		compatible = "mediatek,camsv1";
		interrupts = <0x0 0x102 0x8>;
		reg = <0x0 0x1a050000 0x0 0x1000>;
	};

	camsv2@1a051000 {
		compatible = "mediatek,camsv2";
		interrupts = <0x0 0x103 0x8>;
		reg = <0x0 0x1a051000 0x0 0x1000>;
	};

	camsv3@1a052000 {
		compatible = "mediatek,camsv3";
		interrupts = <0x0 0x100 0x8>;
		reg = <0x0 0x1a052000 0x0 0x1000>;
	};

	camsv4@1a053000 {
		compatible = "mediatek,camsv4";
		interrupts = <0x0 0x101 0x8>;
		reg = <0x0 0x1a053000 0x0 0x1000>;
	};

	camsys@1a000000 {
		#clock-cells = <0x1>;
		compatible = "mediatek,mt6768-camsys", "syscon";
		phandle = <0x64>;
		reg = <0x0 0x1a000000 0x0 0x1000>;
	};

	camsysisp@1a000000 {
		#clock-cells = <0x1>;
		compatible = "mediatek,camsys", "syscon";
		phandle = <0xe5>;
		reg = <0x0 0x1a000000 0x0 0x1000>;
	};

	ccifdriver@10209000 {
		clock-names = "infra-ccif-ap", "infra-ccif-md", "infra-ccif1-ap", "infra-ccif1-md", "infra-ccif2-ap", "infra-ccif2-md";
		clocks = <0x26 0x29 0x26 0x2c 0x26 0x23 0x26 0x24 0x26 0x51 0x26 0x52>;
		compatible = "mediatek,ccci_ccif";
		interrupts = <0x0 0xa4 0x8 0x0 0xa5 0x8>;
		mediatek,sram_size = <0x200>;
		phandle = <0xb2>;
		reg = <0x0 0x10209000 0x0 0x1000 0x0 0x1020a000 0x0 0x1000>;
	};

	ccu@1a0b1000 {
		clock-names = "CCU_CLK_CAM_CCU", "CAM_PWR";
		clocks = <0x64 0x8 0x27 0xa>;
		compatible = "mediatek,ccu";
		interrupts = <0x0 0x105 0x8>;
		reg = <0x0 0x1a0b1000 0x0 0x10000>;
	};

	charger {
		ac_charger_current = <0x1f47d0>;
		ac_charger_input_current = <0x30d400>;
		algorithm_name = "SwitchCharging";
		apple_1_0a_charger_current = <0x9eb10>;
		apple_2_1a_charger_current = <0xc3500>;
		battery_cv = <0x426030>;
		bif_cv_under_threshold2 = <0x43e6d0>;
		bif_threshold1 = <0x40d990>;
		bif_threshold2 = <0x419ce0>;
		bootmode = <0x22>;
		cable_imp_threshold = <0x2bb>;
		charging_host_charger_current = <0x16e360>;
		chg1_ta_ac_charger_current = <0x16e360>;
		chg2_ta_ac_charger_current = <0x16e360>;
		compatible = "mediatek,charger";
		disable_pd_dual;
		dual_polling_ieoc = <0x6ddd0>;
		enable_dynamic_mivr;
		enable_min_charge_temp;
		enable_type_c;
		high_temp_to_enter_pe40 = <0x27>;
		high_temp_to_leave_pe40 = <0x2e>;
		ibus_err = <0xe>;
		jeita_temp_above_t4_cv = <0x40b280>;
		jeita_temp_below_t0_cv = <0x3da540>;
		jeita_temp_t0_to_t1_cv = <0x3da540>;
		jeita_temp_t1_to_t2_cv = <0x40b280>;
		jeita_temp_t2_to_t3_cv = <0x423920>;
		jeita_temp_t3_to_t4_cv = <0x40b280>;
		low_temp_to_enter_pe40 = <0x10>;
		low_temp_to_leave_pe40 = <0xa>;
		max_charge_temp = <0x32>;
		max_charge_temp_minus_x_degree = <0x2f>;
		max_charger_voltage = <0x632ea0>;
		max_dmivr_charger_current = <0x155cc0>;
		min_charge_temp = <0x0>;
		min_charge_temp_plus_x_degree = <0x6>;
		min_charger_voltage = <0x4630c0>;
		min_charger_voltage_1 = <0x432380>;
		min_charger_voltage_2 = <0x401640>;
		non_std_ac_charger_current = <0x7a120>;
		pd_ichg_level_threshold = <0xf4240>;
		pd_stop_battery_soc = <0x50>;
		pd_vbus_low_bound = <0x4c4b40>;
		pd_vbus_upper_bound = <0x4c4b40>;
		pe20_ichg_level_threshold = <0xf4240>;
		pe40_dual_charger_chg1_current = <0x1e8480>;
		pe40_dual_charger_chg2_current = <0x1e8480>;
		pe40_dual_charger_input_current = <0x2dc6c0>;
		pe40_r_cable_1a_lower = <0x206>;
		pe40_r_cable_2a_lower = <0x17f>;
		pe40_r_cable_3a_lower = <0xf5>;
		pe40_single_charger_current = <0x2dc6c0>;
		pe40_single_charger_input_current = <0x2dc6c0>;
		pe40_stop_battery_soc = <0x50>;
		pe_ichg_level_threshold = <0xf4240>;
		phandle = <0xf1>;
		power_path_support;
		slave_mivr_diff = <0x186a0>;
		ta_12v_support;
		ta_9v_support;
		ta_ac_12v_input_current = <0x30d400>;
		ta_ac_7v_input_current = <0x30d400>;
		ta_ac_9v_input_current = <0x30d400>;
		ta_ac_charger_current = <0x2dc6c0>;
		ta_start_battery_soc = <0x0>;
		ta_stop_battery_soc = <0x55>;
		temp_neg_10_thres = <0x0>;
		temp_t0_thres = <0x0>;
		temp_t0_thres_plus_x_degree = <0x0>;
		temp_t1_thres = <0x0>;
		temp_t1_thres_plus_x_degree = <0x6>;
		temp_t2_thres = <0xa>;
		temp_t2_thres_plus_x_degree = <0x10>;
		temp_t3_thres = <0x2d>;
		temp_t3_thres_minus_x_degree = <0x27>;
		temp_t4_thres = <0x32>;
		temp_t4_thres_minus_x_degree = <0x2f>;
		usb_charger_current = <0x7a120>;
		usb_charger_current_configured = <0x7a120>;
		usb_charger_current_suspend = <0x0>;
		usb_charger_current_unconfigured = <0x11170>;
		vbat_cable_imp_threshold = <0x3b8260>;
		vsys_watt = <0x4c4b40>;
	};

	chipid@08000000 {
		compatible = "mediatek,chipid";
		reg = <0x0 0x8000000 0x0 0x4 0x0 0x8000004 0x0 0x4 0x0 0x8000008 0x0 0x4 0x0 0x800000c 0x0 0x4>;
	};

	chn_emi@1021a000 {
		compatible = "mediatek,chn_emi";
		reg = <0x0 0x1021a000 0x0 0x1000>;
	};

	chosen {
		bootargs = "console=tty0 console=ttyS0,921600n1 root=/dev/ram vmalloc=400M slub_debug=OFZPU swiotlb=noforce cgroup.memory=nosocket,nokmem firmware_class.path=/vendor/firmware page_owner=on loop.max_part=7";
		kaslr-seed = <0x0 0x0>;
		phandle = <0x22>;
	};

	cldmadriver@10014000 {
		cldma-infracfg = <0x26>;
		clock-names = "infra-cldma-bclk";
		clocks = <0x26 0x32>;
		compatible = "mediatek,ccci_cldma";
		interrupts = <0x0 0xb4 0x4>;
		mediatek,cldma_capability = <0x6>;
		mediatek,md_generation = <0x1895>;
		mediatek,platform = <0x1a53>;
		phandle = <0xb3>;
		reg = <0x0 0x10014000 0x0 0x1000 0x0 0x1021b000 0x0 0x1000>;
	};

	clocks {

		clk13m {
			#clock-cells = <0x0>;
			clock-frequency = <0xc65d40>;
			compatible = "fixed-clock";
			phandle = <0x24>;
		};

		clk26m {
			#clock-cells = <0x0>;
			clock-frequency = <0x18cba80>;
			compatible = "fixed-clock";
			phandle = <0x15>;
		};

		clk32k {
			#clock-cells = <0x0>;
			clock-frequency = <0x7d00>;
			compatible = "fixed-clock";
			phandle = <0x7c>;
		};
	};

	cmdq-bdg-test {
		compatible = "mediatek,cmdq-bdg-test";
		mboxes = <0x37 0x16 0x0 0x2 0x37 0x17 0x0 0x1>;
		mediatek,gce = <0x37>;
		token_gpr_set4 = [02 c0];
		token_user0 = [02 89];
	};

	consys@18002000 {
		#address-cells = <0x2>;
		#size-cells = <0x2>;
		clock-names = "conn";
		clocks = <0x27 0x1>;
		compatible = "mediatek,mt6768-consys";
		interrupts = <0x0 0x11c 0x8 0x0 0x4e 0x8 0x0 0x11f 0x1>;
		memory-region = <0x42>;
		phandle = <0xd3>;
		reg = <0x0 0x18002000 0x0 0x1000 0x0 0x10007000 0x0 0x100 0x0 0x10001000 0x0 0x1000 0x0 0x10006000 0x0 0x1000 0x0 0x18007000 0x0 0x1000 0x0 0x180b1000 0x0 0x1000 0x0 0x180a3000 0x0 0x1000 0x0 0x180a5000 0x0 0x800 0x0 0x180c1000 0x0 0x1000 0x0 0x18004000 0x0 0x1000>;
		wifi_ant_swap_gpio = <0x20 0x6c 0x0>;
	};

	cpu_dbgapb@0e010000 {
		compatible = "mediatek,hw_dbg";
		num = <0x8>;
		phandle = <0x77>;
		reg = <0x0 0xe010000 0x0 0x1000 0x0 0xe110000 0x0 0x1000 0x0 0xe210000 0x0 0x1000 0x0 0xe310000 0x0 0x1000 0x0 0xe410000 0x0 0x1000 0x0 0xe510000 0x0 0x1000 0x0 0xe610000 0x0 0x1000 0x0 0xe710000 0x0 0x1000>;
	};

	cpus {
		#address-cells = <0x1>;
		#size-cells = <0x0>;

		cpu-map {

			cluster0 {

				core0 {
					cpu = <0xb>;
				};

				core1 {
					cpu = <0xc>;
				};

				core2 {
					cpu = <0xd>;
				};

				core3 {
					cpu = <0xe>;
				};

				core4 {
					cpu = <0xf>;
				};

				core5 {
					cpu = <0x10>;
				};

				doe {
					phandle = <0x74>;
				};
			};

			cluster1 {

				core0 {
					cpu = <0x11>;
				};

				core1 {
					cpu = <0x12>;
				};

				doe {
					phandle = <0x75>;
				};
			};
		};

		cpu@000 {
			capacity-dmips-mhz = <0x1ef>;
			clock-frequency = <0x65633340>;
			compatible = "arm,cortex-a55";
			cpu-idle-states = <0x3 0x4 0x5 0x6 0x7 0x8 0x9>;
			device_type = "cpu";
			dynamic-power-coefficient = <0x55>;
			enable-method = "psci";
			operating-points-v2 = <0x2>;
			phandle = <0xb>;
			reg = <0x0>;
		};

		cpu@001 {
			capacity-dmips-mhz = <0x1ef>;
			clock-frequency = <0x65633340>;
			compatible = "arm,cortex-a55";
			cpu-idle-states = <0x3 0x4 0x5 0x6 0x7 0x8 0x9>;
			device_type = "cpu";
			dynamic-power-coefficient = <0x55>;
			enable-method = "psci";
			operating-points-v2 = <0x2>;
			phandle = <0xc>;
			reg = <0x100>;
		};

		cpu@002 {
			capacity-dmips-mhz = <0x1ef>;
			clock-frequency = <0x65633340>;
			compatible = "arm,cortex-a55";
			cpu-idle-states = <0x3 0x4 0x5 0x6 0x7 0x8 0x9>;
			device_type = "cpu";
			dynamic-power-coefficient = <0x55>;
			enable-method = "psci";
			operating-points-v2 = <0x2>;
			phandle = <0xd>;
			reg = <0x200>;
		};

		cpu@003 {
			capacity-dmips-mhz = <0x1ef>;
			clock-frequency = <0x65633340>;
			compatible = "arm,cortex-a55";
			cpu-idle-states = <0x3 0x4 0x5 0x6 0x7 0x8 0x9>;
			device_type = "cpu";
			dynamic-power-coefficient = <0x55>;
			enable-method = "psci";
			operating-points-v2 = <0x2>;
			phandle = <0xe>;
			reg = <0x300>;
		};

		cpu@100 {
			capacity-dmips-mhz = <0x1ef>;
			clock-frequency = <0x65633340>;
			compatible = "arm,cortex-a55";
			cpu-idle-states = <0x3 0x4 0x5 0x6 0x7 0x8 0x9>;
			device_type = "cpu";
			dynamic-power-coefficient = <0x55>;
			enable-method = "psci";
			operating-points-v2 = <0x2>;
			phandle = <0xf>;
			reg = <0x400>;
		};

		cpu@101 {
			capacity-dmips-mhz = <0x1ef>;
			clock-frequency = <0x65633340>;
			compatible = "arm,cortex-a55";
			cpu-idle-states = <0x3 0x4 0x5 0x6 0x7 0x8 0x9>;
			device_type = "cpu";
			dynamic-power-coefficient = <0x55>;
			enable-method = "psci";
			operating-points-v2 = <0x2>;
			phandle = <0x10>;
			reg = <0x500>;
		};

		cpu@102 {
			capacity-dmips-mhz = <0x400>;
			clock-frequency = <0x8166d4c0>;
			compatible = "arm,cortex-a75";
			cpu-idle-states = <0x3 0x4 0x5 0x6 0x7 0x8 0x9>;
			device_type = "cpu";
			dynamic-power-coefficient = <0x113>;
			enable-method = "psci";
			operating-points-v2 = <0xa>;
			phandle = <0x11>;
			reg = <0x600>;
		};

		cpu@103 {
			capacity-dmips-mhz = <0x400>;
			clock-frequency = <0x8166d4c0>;
			compatible = "arm,cortex-a75";
			cpu-idle-states = <0x3 0x4 0x5 0x6 0x7 0x8 0x9>;
			device_type = "cpu";
			dynamic-power-coefficient = <0x113>;
			enable-method = "psci";
			operating-points-v2 = <0xa>;
			phandle = <0x12>;
			reg = <0x700>;
		};

		idle-states {
			entry-method = "arm,psci";

			idlebus26m {
				arm,psci-suspend-param = <0x1010004>;
				compatible = "arm,idle-state";
				entry-latency-us = <0x320>;
				exit-latency-us = <0x3e8>;
				min-residency-us = <0x7d0>;
				phandle = <0x8>;
				status = "okay";
			};

			idledram {
				arm,psci-suspend-param = <0x1010002>;
				compatible = "arm,idle-state";
				entry-latency-us = <0x320>;
				exit-latency-us = <0x3e8>;
				min-residency-us = <0x7d0>;
				phandle = <0x6>;
				status = "okay";
			};

			idlesyspll {
				arm,psci-suspend-param = <0x1010003>;
				compatible = "arm,idle-state";
				entry-latency-us = <0x320>;
				exit-latency-us = <0x3e8>;
				min-residency-us = <0x7d0>;
				phandle = <0x7>;
				status = "okay";
			};

			mcdi-cluster {
				arm,psci-suspend-param = <0x1010001>;
				compatible = "arm,idle-state";
				entry-latency-us = <0x258>;
				exit-latency-us = <0x258>;
				min-residency-us = <0x4b0>;
				phandle = <0x5>;
			};

			mcdi-cpu {
				arm,psci-suspend-param = <0x10001>;
				compatible = "arm,idle-state";
				entry-latency-us = <0x258>;
				exit-latency-us = <0x258>;
				min-residency-us = <0x4b0>;
				phandle = <0x4>;
			};

			standby {
				arm,psci-suspend-param = <0x1>;
				compatible = "arm,idle-state";
				entry-latency-us = <0x258>;
				exit-latency-us = <0x258>;
				min-residency-us = <0x4b0>;
				phandle = <0x3>;
			};

			suspend {
				arm,psci-suspend-param = <0x1010005>;
				compatible = "arm,idle-state";
				entry-latency-us = <0x320>;
				exit-latency-us = <0x3e8>;
				min-residency-us = <0x7d0>;
				phandle = <0x9>;
			};
		};
	};

	cq_dma@10212000 {
		clock-names = "cqdma";
		clocks = <0x26 0x43>;
		compatible = "mediatek,mt-cqdma-v1";
		interrupts = <0x0 0x86 0x8 0x0 0x87 0x8 0x0 0x88 0x8>;
		nr_channel = <0x3>;
		reg = <0x0 0x10212000 0x0 0x80 0x0 0x10212080 0x0 0x80 0x0 0x10212100 0x0 0x80>;
	};

	dbg_apmcu_mp0@0d400000 {
		compatible = "mediatek,dbg_apmcu_mp0";
		reg = <0x0 0xd400000 0x0 0x1000>;
	};

	dbg_apmcu_mp0@0d410000 {
		compatible = "mediatek,dbg_apmcu_mp0";
		reg = <0x0 0xd410000 0x0 0x1000>;
	};

	dbg_apmcu_mp0@0d420000 {
		compatible = "mediatek,dbg_apmcu_mp0";
		reg = <0x0 0xd420000 0x0 0x1000>;
	};

	dbg_apmcu_mp0@0d430000 {
		compatible = "mediatek,dbg_apmcu_mp0";
		reg = <0x0 0xd430000 0x0 0x1000>;
	};

	dbg_apmcu_mp0@0d440000 {
		compatible = "mediatek,dbg_apmcu_mp0";
		reg = <0x0 0xd440000 0x0 0x1000>;
	};

	dbg_apmcu_mp0@0d510000 {
		compatible = "mediatek,dbg_apmcu_mp0";
		reg = <0x0 0xd510000 0x0 0x1000>;
	};

	dbg_apmcu_mp0@0d520000 {
		compatible = "mediatek,dbg_apmcu_mp0";
		reg = <0x0 0xd520000 0x0 0x1000>;
	};

	dbg_apmcu_mp0@0d530000 {
		compatible = "mediatek,dbg_apmcu_mp0";
		reg = <0x0 0xd530000 0x0 0x1000>;
	};

	dbg_apmcu_mp0@0d540000 {
		compatible = "mediatek,dbg_apmcu_mp0";
		reg = <0x0 0xd540000 0x0 0x1000>;
	};

	dbg_apmcu_mp0@0d610000 {
		compatible = "mediatek,dbg_apmcu_mp0";
		reg = <0x0 0xd610000 0x0 0x1000>;
	};

	dbg_apmcu_mp0@0d620000 {
		compatible = "mediatek,dbg_apmcu_mp0";
		reg = <0x0 0xd620000 0x0 0x1000>;
	};

	dbg_apmcu_mp0@0d630000 {
		compatible = "mediatek,dbg_apmcu_mp0";
		reg = <0x0 0xd630000 0x0 0x1000>;
	};

	dbg_apmcu_mp0@0d640000 {
		compatible = "mediatek,dbg_apmcu_mp0";
		reg = <0x0 0xd640000 0x0 0x1000>;
	};

	dbg_apmcu_mp0@0d710000 {
		compatible = "mediatek,dbg_apmcu_mp0";
		reg = <0x0 0xd710000 0x0 0x1000>;
	};

	dbg_apmcu_mp0@0d720000 {
		compatible = "mediatek,dbg_apmcu_mp0";
		reg = <0x0 0xd720000 0x0 0x1000>;
	};

	dbg_apmcu_mp0@0d730000 {
		compatible = "mediatek,dbg_apmcu_mp0";
		reg = <0x0 0xd730000 0x0 0x1000>;
	};

	dbg_apmcu_mp0@0d740000 {
		compatible = "mediatek,dbg_apmcu_mp0";
		reg = <0x0 0xd740000 0x0 0x1000>;
	};

	dbg_apmcu_mp1@0d800000 {
		compatible = "mediatek,dbg_apmcu_mp1";
		reg = <0x0 0xd800000 0x0 0x1000>;
	};

	dbg_apmcu_mp1@0d810000 {
		compatible = "mediatek,dbg_apmcu_mp1";
		reg = <0x0 0xd810000 0x0 0x1000>;
	};

	dbg_apmcu_mp1@0d820000 {
		compatible = "mediatek,dbg_apmcu_mp1";
		reg = <0x0 0xd820000 0x0 0x1000>;
	};

	dbg_apmcu_mp1@0d830000 {
		compatible = "mediatek,dbg_apmcu_mp1";
		reg = <0x0 0xd830000 0x0 0x1000>;
	};

	dbg_apmcu_mp1@0d840000 {
		compatible = "mediatek,dbg_apmcu_mp1";
		reg = <0x0 0xd840000 0x0 0x1000>;
	};

	dbg_apmcu_mp1@0d910000 {
		compatible = "mediatek,dbg_apmcu_mp1";
		reg = <0x0 0xd910000 0x0 0x1000>;
	};

	dbg_apmcu_mp1@0d920000 {
		compatible = "mediatek,dbg_apmcu_mp1";
		reg = <0x0 0xd920000 0x0 0x1000>;
	};

	dbg_apmcu_mp1@0d930000 {
		compatible = "mediatek,dbg_apmcu_mp1";
		reg = <0x0 0xd930000 0x0 0x1000>;
	};

	dbg_apmcu_mp1@0d940000 {
		compatible = "mediatek,dbg_apmcu_mp1";
		reg = <0x0 0xd940000 0x0 0x1000>;
	};

	dbg_apmcu_mp1@0da10000 {
		compatible = "mediatek,dbg_apmcu_mp1";
		reg = <0x0 0xda10000 0x0 0x1000>;
	};

	dbg_apmcu_mp1@0da20000 {
		compatible = "mediatek,dbg_apmcu_mp1";
		reg = <0x0 0xda20000 0x0 0x1000>;
	};

	dbg_apmcu_mp1@0da30000 {
		compatible = "mediatek,dbg_apmcu_mp1";
		reg = <0x0 0xda30000 0x0 0x1000>;
	};

	dbg_apmcu_mp1@0da40000 {
		compatible = "mediatek,dbg_apmcu_mp1";
		reg = <0x0 0xda40000 0x0 0x1000>;
	};

	dbg_apmcu_mp1@0db10000 {
		compatible = "mediatek,dbg_apmcu_mp1";
		reg = <0x0 0xdb10000 0x0 0x1000>;
	};

	dbg_apmcu_mp1@0db20000 {
		compatible = "mediatek,dbg_apmcu_mp1";
		reg = <0x0 0xdb20000 0x0 0x1000>;
	};

	dbg_apmcu_mp1@0db30000 {
		compatible = "mediatek,dbg_apmcu_mp1";
		reg = <0x0 0xdb30000 0x0 0x1000>;
	};

	dbg_apmcu_mp1@0db40000 {
		compatible = "mediatek,dbg_apmcu_mp1";
		reg = <0x0 0xdb40000 0x0 0x1000>;
	};

	dbg_cti@0d020000 {
		compatible = "mediatek,dbg_cti";
		reg = <0x0 0xd020000 0x0 0x10000>;
	};

	dbg_dem@0d0a0000 {
		compatible = "mediatek,dbg_dem";
		interrupts = <0x0 0x9d 0x8>;
		reg = <0x0 0xd0a0000 0x0 0x10000>;
	};

	dbg_etr@0d030000 {
		compatible = "mediatek,dbg_etr";
		reg = <0x0 0xd030000 0x0 0x10000>;
	};

	dbg_funnel@0d040000 {
		compatible = "mediatek,dbg_funnel";
		reg = <0x0 0xd040000 0x0 0x10000>;
	};

	dbg_mdsys1@0d0c0000 {
		compatible = "mediatek,dbg_mdsys1";
		reg = <0x0 0xd0c0000 0x0 0x40000>;
	};

	dcm {
		compatible = "mediatek,dcm";
		phandle = <0x7d>;
	};

	ddrphy@10015000 {
		compatible = "mediatek,ddrphy";
		reg = <0x0 0x10015000 0x0 0x1000>;
	};

	devapc@10207000 {
		clock-names = "devapc-infra-clock";
		clocks = <0x26 0x28>;
		compatible = "mediatek,mt6768-devapc";
		interrupts = <0x0 0x9f 0x8>;
		reg = <0x0 0x10207000 0x0 0x1000 0x0 0x1000e000 0x0 0x1000 0x0 0x10033000 0x0 0x1000 0x0 0x10c000 0x0 0x1000>;
	};

	dfd@10200b00 {
		compatible = "mediatek,dfd";
		mediatek,chain_length = <0xa7f8>;
		mediatek,check_dfd_support = <0x1>;
		mediatek,dfd_ap_addr_offset = <0x18>;
		mediatek,dfd_infra_base = <0x390>;
		mediatek,dfd_latch_offset = <0x48>;
		mediatek,enabled = <0x1>;
		mediatek,rg_dfd_timeout = <0xa0>;
		reg = <0x0 0x10200b00 0x0 0x10000>;
	};

	dfd_cache {
		compatible = "mediatek,dfd_cache";
		mediatek,enabled = <0x0>;
		mediatek,rg_dfd_timeout = <0x3e80>;
		phandle = <0xbd>;
	};

	dip1@15022000 {
		compatible = "mediatek,dip1";
		interrupts = <0x0 0x10e 0x8>;
		reg = <0x0 0x15022000 0x0 0x3000>;
	};

	disp_aal0@14011000 {
		compatible = "mediatek,disp_aal0";
		interrupts = <0x0 0xeb 0x8>;
		reg = <0x0 0x14011000 0x0 0x1000>;
	};

	disp_ccorr0@14010000 {
		compatible = "mediatek,disp_ccorr0";
		interrupts = <0x0 0xea 0x8>;
		reg = <0x0 0x14010000 0x0 0x1000>;
	};

	disp_color0@1400f000 {
		clock-names = "MDP_COLOR";
		clocks = <0x2b 0xc>;
		compatible = "mediatek,disp_color0";
		interrupts = <0x0 0xe9 0x8>;
		phandle = <0x32>;
		reg = <0x0 0x1400f000 0x0 0x1000>;
	};

	disp_dither0@14013000 {
		compatible = "mediatek,disp_dither0";
		interrupts = <0x0 0xed 0x8>;
		reg = <0x0 0x14013000 0x0 0x1000>;
	};

	disp_gamma0@14012000 {
		compatible = "mediatek,disp_gamma0";
		interrupts = <0x0 0xec 0x8>;
		reg = <0x0 0x14012000 0x0 0x1000>;
	};

	disp_mutex0@14001000 {
		compatible = "mediatek,disp_mutex0";
		interrupts = <0x0 0xdf 0x8>;
		phandle = <0x34>;
		reg = <0x0 0x14001000 0x0 0x1000>;
	};

	disp_ovl0@1400b000 {
		compatible = "mediatek,disp_ovl0";
		interrupts = <0x0 0xe6 0x8>;
		reg = <0x0 0x1400b000 0x0 0x1000>;
	};

	disp_ovl0_2l@1400c000 {
		compatible = "mediatek,disp_ovl0_2l";
		interrupts = <0x0 0xf2 0x8>;
		reg = <0x0 0x1400c000 0x0 0x1000>;
	};

	disp_pwm@1100e000 {
		compatible = "mediatek,disp_pwm";
		reg = <0x0 0x1100e000 0x0 0x1000>;
	};

	disp_rdma0@1400d000 {
		compatible = "mediatek,disp_rdma0";
		interrupts = <0x0 0xe7 0x8>;
		reg = <0x0 0x1400d000 0x0 0x1000>;
	};

	disp_rsz0@14015000 {
		compatible = "mediatek,disp_rsz0";
		interrupts = <0x0 0x125 0x8>;
		reg = <0x0 0x14015000 0x0 0x1000>;
	};

	disp_wdma0@1400e000 {
		compatible = "mediatek,disp_wdma0";
		interrupts = <0x0 0xe8 0x8>;
		reg = <0x0 0x1400e000 0x0 0x1000>;
	};

	dispsys {
		clock-names = "MMSYS_MTCMOS", "MMSYS_SMI_COMMON", "MMSYS_SMI_LARB0", "MMSYS_GALS_COMM0", "MMSYS_GALS_COMM1", "MMSYS_DISP_OVL0", "MMSYS_DISP_OVL0_2L", "MMSYS_DISP_RDMA0", "MMSYS_DISP_WDMA0", "MMSYS_DISP_COLOR0", "MMSYS_DISP_CCORR0", "MMSYS_DISP_AAL0", "MMSYS_DISP_GAMMA0", "MMSYS_DISP_DITHER0", "MMSYS_DSI0_MM_CK", "MMSYS_DSI0_IF_CK", "MMSYS_IMG_DL_RELAY", "MMSYS_26M", "MMSYS_DISP_RSZ0", "APMIXED_MIPI_26M", "TOP_MUX_DISP_PWM", "DISP_PWM", "TOP_26M", "TOP_UNIVPLL2_D4", "TOP_ULPOSC1_D2", "TOP_ULPOSC1_D8";
		clocks = <0x27 0x3 0x2b 0x13 0x2b 0x14 0x2b 0x15 0x2b 0x16 0x2b 0x7 0x2b 0x8 0x2b 0xa 0x2b 0xb 0x2b 0xc 0x2b 0xd 0x2b 0xe 0x2b 0xf 0x2b 0x10 0x2b 0x11 0x2b 0x1e 0x2b 0x1c 0x2b 0x1f 0x2b 0x9 0x45 0x15 0x14 0x63 0x26 0x31 0x15 0x14 0x1b 0x14 0x2e 0x14 0x30>;
		compatible = "mediatek,dispsys";
		mediatek,larb = <0x63>;
	};

	dma-controller@11000980 {
		#dma-cells = <0x1>;
		clock-names = "apdma";
		clocks = <0x26 0x26>;
		compatible = "mediatek,mt6577-uart-dma";
		dma-bits = <0x22>;
		dma-requests = <0x4>;
		interrupts = <0x0 0x66 0x8 0x0 0x67 0x8 0x0 0x68 0x8 0x0 0x72 0x8>;
		phandle = <0x39>;
		reg = <0x0 0x11000980 0x0 0x80 0x0 0x11000a00 0x0 0x80 0x0 0x11000a80 0x0 0x80 0x0 0x11000b00 0x0 0x80>;
	};

	dpe@15028000 {
		clock-names = "DPE_CG_IMG_DPE";
		clocks = <0x25 0x3>;
		compatible = "mediatek,dpe";
		interrupts = <0x0 0x10f 0x8>;
		reg = <0x0 0x15028000 0x0 0x1000>;
	};

	dramc@1022a000 {
		compatible = "mediatek,dramc";
		reg = <0x0 0x1022a000 0x0 0x2000 0x0 0x10232000 0x0 0x2000 0x0 0x1022c000 0x0 0x1000 0x0 0x10234000 0x0 0x1000 0x0 0x10228000 0x0 0x2000 0x0 0x10230000 0x0 0x2000 0x0 0x1022e000 0x0 0x1000 0x0 0x10236000 0x0 0x1000>;
	};

	drcc {
		compatible = "mediatek,drcc";
		drcc0_Code = <0xff>;
		drcc0_Hwgatepct = <0xff>;
		drcc0_Vref = <0xff>;
		drcc1_Code = <0xff>;
		drcc1_Hwgatepct = <0xff>;
		drcc1_Vref = <0xff>;
		drcc2_Code = <0xff>;
		drcc2_Hwgatepct = <0xff>;
		drcc2_Vref = <0xff>;
		drcc3_Code = <0xff>;
		drcc3_Hwgatepct = <0xff>;
		drcc3_Vref = <0xff>;
		drcc4_Code = <0xff>;
		drcc4_Hwgatepct = <0xff>;
		drcc4_Vref = <0xff>;
		drcc5_Code = <0xff>;
		drcc5_Hwgatepct = <0xff>;
		drcc5_Vref = <0xff>;
		drcc6_Code = <0xff>;
		drcc6_Hwgatepct = <0xff>;
		drcc6_Vref = <0xff>;
		drcc7_Code = <0xff>;
		drcc7_Hwgatepct = <0xff>;
		drcc7_Vref = <0xff>;
		phandle = <0xd0>;
		state = <0xff>;
	};

	dsi0@14014000 {
		compatible = "mediatek,dsi0";
		interrupts = <0x0 0xee 0x8>;
		reg = <0x0 0x14014000 0x0 0x1000>;
	};

	dsi_te {
		compatible = "mediatek, dsi_te-eint";
		phandle = <0xdf>;
		status = "disabled";
	};

	dsu-pmu-0 {
		compatible = "arm,dsu-pmu";
		cpus = <0xb 0xc 0xd 0xe 0xf 0x10 0x11 0x12>;
		interrupts = <0x0 0x12 0x4>;
	};

	dvfsp@00110c00 {
		B-table = <0x7d0 0x48 0x1 0x1 0x79e 0x45 0x1 0x1 0x76c 0x41 0x1 0x1 0x73a 0x3d 0x1 0x1 0x708 0x3a 0x1 0x1 0x6ae 0x36 0x1 0x1 0x655 0x32 0x1 0x1 0x60c 0x30 0x2 0x1 0x5a3 0x2b 0x2 0x1 0x54a 0x27 0x2 0x1 0x4f1 0x24 0x2 0x1 0x498 0x20 0x2 0x1 0x43f 0x1d 0x2 0x1 0x3e6 0x19 0x2 0x1 0x38d 0x16 0x2 0x1 0x352 0x13 0x2 0x1>;
		CCI-table = <0x4a3 0x38 0x2 0x1 0x460 0x34 0x2 0x1 0x419 0x30 0x2 0x1 0x3f6 0x2e 0x2 0x1 0x3c1 0x2b 0x2 0x1 0x38d 0x28 0x2 0x1 0x358 0x24 0x2 0x1 0x335 0x22 0x2 0x1 0x300 0x1f 0x2 0x1 0x2dd 0x1d 0x4 0x1 0x2ba 0x1b 0x4 0x1 0x297 0x19 0x4 0x1 0x274 0x17 0x4 0x1 0x251 0x15 0x4 0x1 0x3a 0x13 0x4 0x1 0x1f4 0x10 0x4 0x1>;
		L-table = <0x6a4 0x38 0x2 0x1 0x659 0x35 0x2 0x1 0x5dc 0x30 0x2 0x1 0x5aa 0x2e 0x2 0x1 0x55f 0x2b 0x2 0x1 0x52d 0x29 0x2 0x1 0x4fb 0x27 0x2 0x1 0x497 0x22 0x2 0x1 0x44c 0x29 0x2 0x1 0x41a 0x1d 0x2 0x1 0x3e7 0x1b 0x2 0x1 0x3b6 0x19 0x2 0x1 0x384 0x17 0x2 0x1 0x352 0x15 0x4 0x1 0x306 0x13 0x4 0x1 0x1f4 0x10 0x4 0x1>;
		big-down-time = <0x2ee>;
		big-rise-time = <0x3e8>;
		change_flag = <0x0>;
		compatible = "mediatek,mt6768-dvfsp";
		little-down-time = <0x2ee>;
		little-rise-time = <0x3e8>;
		phandle = <0xb6>;
		reg = <0x0 0x110c00 0x0 0x1400 0x0 0x110c00 0x0 0x1400>;
		state = <0x1>;
	};

	dvfsp@10227000 {
		compatible = "mediatek,dvfsp";
		reg = <0x0 0x10227000 0x0 0x1000>;
	};

	dvfsrc@10012000 {
		compatible = "mediatek,dvfsrc";
		phandle = <0xae>;
		reg = <0x0 0x10012000 0x0 0x1000 0x0 0x110b80 0x0 0x80>;
	};

	dxcc_sec@10210000 {
		compatible = "mediatek,dxcc_sec";
		interrupts = <0x0 0xb1 0x4>;
		reg = <0x0 0x10210000 0x0 0x1000>;
	};

	eem_fsm@1100b000 {
		compatible = "mediatek,eem_fsm";
		eem-clamp-big = <0x0>;
		eem-clamp-cci = <0x0>;
		eem-clamp-gpu = <0x0>;
		eem-clamp-little = <0x0>;
		eem-initmon-big = <0xf>;
		eem-initmon-cci = <0xf>;
		eem-initmon-gpu = <0xf>;
		eem-initmon-little = <0xf>;
		eem-offset-big = <0xff>;
		eem-offset-cci = <0xff>;
		eem-offset-gpu = <0xff>;
		eem-offset-little = <0xff>;
		eem-status = <0x1>;
		interrupts = <0x0 0x8e 0x8>;
		phandle = <0xcb>;
		reg = <0x0 0x1100b000 0x0 0x1000>;
	};

	efuse@11c10000 {
		#address-cells = <0x1>;
		#size-cells = <0x1>;
		compatible = "mediatek,devinfo";
		phandle = <0x38>;
		reg = <0x0 0x11c10000 0x0 0x10000>;

		segment@78 {
			phandle = <0x61>;
			reg = <0x78 0x4>;
		};
	};

	efuse_dbg@10004000 {
		compatible = "mediatek,efuse_dbg";
		reg = <0x0 0x10004000 0x0 0x1000>;
	};

	efusec@11ce0000 {
		compatible = "mediatek,efusec";
		reg = <0x0 0x11ce0000 0x0 0x10000>;
	};

	eint@1000b000 {
		compatible = "mediatek,eint";
		interrupts = <0x0 0xba 0x4>;
		phandle = <0x1f>;
		reg = <0x0 0x1000b000 0x0 0x1000>;
	};

	emi@10219000 {
		compatible = "mediatek,emi";
		interrupts = <0x0 0xa1 0x8>;
		reg = <0x0 0x10219000 0x0 0x1000 0x0 0x10226000 0x0 0x1000 0x0 0x1022d000 0x0 0x1000 0x0 0x10235000 0x0 0x1000 0x0 0x1020e000 0x0 0x1000>;
	};

	emi_mpu@10226000 {
		compatible = "mediatek,emi_mpu";
		reg = <0x0 0x10226000 0x0 0x1000>;
	};

	extcon_usb {
		charger = <0x72>;
		compatible = "mediatek,extcon-usb";
		dev-conn = <0x73>;
		mediatek,bypss-typec-sink = <0x1>;
		phandle = <0xf3>;
	};

	fdvt@1502b000 {
		clock-names = "FD_CLK_IMG_FDVT";
		clocks = <0x25 0x2>;
		compatible = "mediatek,fdvt";
		interrupts = <0x0 0x111 0x8>;
		reg = <0x0 0x1502b000 0x0 0x1000>;
	};

	fhctl@1000ce00 {
		compatible = "mediatek,fhctl";
		reg = <0x0 0x1000ce00 0x0 0x200>;
	};

	fingerprint {
		compatible = "mediatek,goodix-fp";
		phandle = <0xb9>;
	};

	flashlight_core {
		compatible = "mediatek,flashlight_core";
		phandle = <0xe9>;
	};

	flashlights_mt6370 {
		compatible = "mediatek,flashlights_mt6370";
		decouple = <0x0>;
		phandle = <0xea>;

		channel@1 {
			ct = <0x0>;
			part = <0x0>;
			type = <0x0>;
		};

		channel@2 {
			ct = <0x1>;
			part = <0x0>;
			type = <0x0>;
		};
	};

	gauge_timer {
		compatible = "mediatek,gauge_timer_service";
	};

	gce@10238000 {
		#clock-cells = <0x1>;
		ap_dma_base = <0x18010000 0x17 0xffff0000>;
		audio_base = <0x17000000 0x12 0xffff0000>;
		buf_underrun_event_0 = <0x8c>;
		camsv_0_pass1_done = <0x143>;
		camsv_1_pass1_done = <0x144>;
		camsv_2_pass1_done = <0x145>;
		camsys1_base = <0x180a0000 0x1c 0xffff0000>;
		camsys2_base = <0x180b0000 0x1d 0xffff0000>;
		camsys_base = <0x18080000 0x1b 0xffff0000>;
		clock-names = "GCE", "GCE_TIMER", "MMSYS_MTCMOS";
		clocks = <0x26 0x9 0x26 0x18 0x27 0x3>;
		compatible = "mediatek,gce", "syscon";
		conn_peri_base = <0x18820000 0x7 0xffff0000>;
		dip_cq_thread0_frame_done = <0x101>;
		dip_cq_thread10_frame_done = <0x10b>;
		dip_cq_thread11_frame_done = <0x10c>;
		dip_cq_thread12_frame_done = <0x10d>;
		dip_cq_thread13_frame_done = <0x10e>;
		dip_cq_thread14_frame_done = <0x10f>;
		dip_cq_thread15_frame_done = <0x110>;
		dip_cq_thread16_frame_done = <0x111>;
		dip_cq_thread17_frame_done = <0x112>;
		dip_cq_thread18_frame_done = <0x113>;
		dip_cq_thread1_frame_done = <0x102>;
		dip_cq_thread2_frame_done = <0x103>;
		dip_cq_thread3_frame_done = <0x104>;
		dip_cq_thread4_frame_done = <0x105>;
		dip_cq_thread5_frame_done = <0x106>;
		dip_cq_thread6_frame_done = <0x107>;
		dip_cq_thread7_frame_done = <0x108>;
		dip_cq_thread8_frame_done = <0x109>;
		dip_cq_thread9_frame_done = <0x10a>;
		disp_2l_ovl0_frame_done = <0x1c>;
		disp_2l_ovl0_sof = <0x8>;
		disp_aal0_frame_done = <0x22>;
		disp_aal0_sof = <0xd>;
		disp_ccorr0_frame_done = <0x21>;
		disp_ccorr0_sof = <0xc>;
		disp_color0_frame_done = <0x20>;
		disp_color0_sof = <0xb>;
		disp_dither0_frame_done = <0x24>;
		disp_dither0_sof = <0xf>;
		disp_dither_base = <0x14010000 0x2 0xffff0000>;
		disp_dsi0_frame_done = <0x25>;
		disp_dsi0_sof = <0x10>;
		disp_gamma0_frame_done = <0x23>;
		disp_gamma0_sof = <0xe>;
		disp_mutex_reg = <0x14016000 0x1000>;
		disp_ovl0_frame_done = <0x1b>;
		disp_ovl0_frame_rst_done_pusle = <0x98>;
		disp_ovl0_sof = <0x7>;
		disp_pwm0_sof = <0x13>;
		disp_rdma0_frame_done = <0x1e>;
		disp_rdma0_sof = <0x9>;
		disp_rsz0_frame_done = <0x1d>;
		disp_rsz0_sof = <0x11>;
		disp_wdma0_frame_done = <0x1f>;
		disp_wdma0_rst_done = <0x93>;
		disp_wdma0_sof = <0xa>;
		dsi0_done_event = <0x8f>;
		dsi0_irq_event = <0x8e>;
		dsi0_te_event = <0x8d>;
		dsi0_te_from_infra = <0x382>;
		dve_frame_done = <0x114>;
		g3d_config_base = <0x13000000 0x0 0xffff0000>;
		gce_base = <0x18020000 0x18 0xffff0000>;
		gce_mbox_bdg = <0x37>;
		gcpu_base = <0x10050000 0xf 0xffff0000>;
		img_dl_relay_sof = <0x12>;
		imgsys_base = <0x15020000 0x4 0xffff0000>;
		infra_na3_base = <0x10010000 0xb 0xffff0000>;
		infra_na4_base = <0x10020000 0xc 0xffff0000>;
		interrupts = <0x0 0xaa 0x8>;
		isp_frame_done_b = <0x142>;
		jpgenc_done = <0x123>;
		kp_base = <0x18840000 0x9 0xffff0000>;
		mboxes = <0x35 0x0 0x0 0x4 0x35 0x2 0x0 0x5 0x35 0x3 0x0 0x4 0x35 0x4 0x0 0x4 0x35 0x6 0x0 0x3 0x35 0x7 0xffffffff 0x2 0x36 0x8 0x0 0x4 0x36 0x9 0x0 0x4 0x36 0xa 0x0 0x1 0x35 0xb 0x0 0x1 0x35 0xc 0x0 0x1 0x35 0xd 0x0 0x1 0x35 0xe 0x0 0x1 0x35 0xf 0xffffffff 0x1>;
		mcucfg_base = <0x10040000 0xe 0xffff0000>;
		mdp_ccorr0 = <0x33>;
		mdp_ccorr0_frame_done = <0x15>;
		mdp_ccorr0_sof = <0x1>;
		mdp_color0 = <0x32>;
		mdp_rdma0 = <0x2c>;
		mdp_rdma0_frame_done = <0x14>;
		mdp_rdma0_rst_done = <0x97>;
		mdp_rdma0_sof = <0x0>;
		mdp_rsz0 = <0x2d>;
		mdp_rsz0_frame_done = <0x16>;
		mdp_rsz0_sof = <0x2>;
		mdp_rsz1 = <0x2e>;
		mdp_rsz1_frame_done = <0x17>;
		mdp_rsz1_sof = <0x3>;
		mdp_tdshp0 = <0x31>;
		mdp_tdshp0_frame_done = <0x1a>;
		mdp_tdshp0_sof = <0x6>;
		mdp_wdma0 = <0x2f>;
		mdp_wdma_frame_done = <0x19>;
		mdp_wdma_rst_done = <0x94>;
		mdp_wdma_sof = <0x4>;
		mdp_wrot0 = <0x30>;
		mdp_wrot0_rst_done = <0x95>;
		mdp_wrot0_sof = <0x5>;
		mdp_wrot0_write_frame_done = <0x18>;
		mediatek,mailbox-gce = <0x35>;
		mm_mutex = <0x34>;
		mm_na_base = <0x14020000 0x3 0xffff0000>;
		mmsys_config = <0x2b>;
		mmsys_config_base = <0x14000000 0x1 0xffff0000>;
		msdc2_base = <0x17020000 0x14 0xffff0000>;
		msdc3_base = <0x18000000 0x16 0xffff0000>;
		phandle = <0xb8>;
		pwm_sw_base = <0x1100e000 0x63 0xffff0000>;
		reg = <0x0 0x10238000 0x0 0x4000>;
		rsc_frame_done = <0x116>;
		scp_base = <0x10030000 0xd 0xffff0000>;
		scp_sram_base = <0x10000000 0xa 0xffff0000>;
		secure_thread = <0x6 0x8>;
		seninf_0_fifo_full = <0x147>;
		seninf_1_fifo_full = <0x148>;
		seninf_2_fifo_full = <0x149>;
		seninf_3_fifo_full = <0x14a>;
		seninf_4_fifo_full = <0x14b>;
		seninf_5_fifo_full = <0x14c>;
		seninf_6_fifo_full = <0x14d>;
		seninf_7_fifo_full = <0x14e>;
		sram_share_cnt = <0x1>;
		sram_share_engine = <0xd>;
		sram_share_event = <0x2c6>;
		stream_done_0 = <0x82>;
		stream_done_1 = <0x83>;
		stream_done_2 = <0x84>;
		stream_done_3 = <0x85>;
		stream_done_4 = <0x86>;
		stream_done_5 = <0x87>;
		stream_done_6 = <0x88>;
		stream_done_7 = <0x89>;
		stream_done_8 = <0x8a>;
		stream_done_9 = <0x8b>;
		topckgen_base = <0x18830000 0x8 0xffff0000>;
		tsf_done = <0x146>;
		usb0_base = <0x10200000 0x10 0xffff0000>;
		usb_sif_base = <0x10280000 0x11 0xffff0000>;
		vdec1_base = <0x17030000 0x15 0xffff0000>;
		vdec2_base = <0x18040000 0x19 0xffff0000>;
		vdec3_base = <0x18050000 0x1a 0xffff0000>;
		vdec_base = <0x17010000 0x13 0xffff0000>;
		vdec_gcon_base = <0x18800000 0x5 0xffff0000>;
		venc_128byte_cnt_done = <0x125>;
		venc_frame_done = <0x121>;
		venc_gcon_base = <0x18810000 0x6 0xffff0000>;
		venc_mb_done = <0x124>;
		venc_pause_done = <0x122>;
		wmf_frame_done = <0x115>;
	};

	gce_mbox@10238000 {
		#gce-event-cells = <0x1>;
		#gce-subsys-cells = <0x2>;
		#mbox-cells = <0x3>;
		clock-names = "gce", "gce-timer";
		clocks = <0x26 0x9 0x26 0x18>;
		compatible = "mediatek,mt6768-gce";
		default_tokens = [02 bc 02 bd 02 be 02 bf 02 c0 02 c6 02 c7];
		interrupts = <0x0 0xaa 0x8>;
		phandle = <0x35>;
		reg = <0x0 0x10238000 0x0 0x4000>;
	};

	gce_mbox_bdg {
		#gce-event-cells = <0x1>;
		#gce-subsys-cells = <0x2>;
		#mbox-cells = <0x3>;
		compatible = "mediatek,mailbox-gce-bdg";
		mboxes = <0x37 0x14 0x0 0x2 0x37 0x15 0x0 0x1>;
		phandle = <0x37>;
	};

	gce_mbox_svp@10238000 {
		#mbox-cells = <0x3>;
		clock-names = "gce", "gce-timer";
		clocks = <0x26 0x9 0x26 0x18>;
		compatible = "mediatek,mailbox-gce-svp";
		interrupts = <0x0 0xaa 0x8 0x0 0xab 0x8>;
		phandle = <0x36>;
		reg = <0x0 0x10238000 0x0 0x4000>;
	};

	ged {
		compatible = "mediatek,ged";
		gpufreq-supply = <0x62>;
		phandle = <0x5f>;
	};

	gic500@0c000000 {
		compatible = "mediatek,gic500";
		reg = <0x0 0xc000000 0x0 0x400000>;
	};

	gic_cpu@0c400000 {
		compatible = "mediatek,gic_cpu";
		reg = <0x0 0xc400000 0x0 0x40000>;
	};

	gpio {
		compatible = "mediatek,gpio_usage_mapping";
		phandle = <0xfe>;
	};

	gpio@10005000 {
		compatible = "mediatek,gpio", "syscon";
		phandle = <0x16>;
		reg = <0x0 0x10005000 0x0 0x1000>;
	};

	gpufreq {
		clock-names = "clk_mux", "clk_main_parent", "clk_sub_parent", "subsys_mfg_cg", "mtcmos_mfg_async", "mtcmos_mfg", "mtcmos_mfg_core0", "mtcmos_mfg_core1";
		clocks = <0x14 0x54 0x14 0x26 0x14 0x6 0x60 0x0 0x27 0x9 0x27 0x4 0x27 0x7 0x27 0x8>;
		compatible = "mediatek,mt6768-gpufreq";
		nvmem-cell-names = "efuse_segment_cell";
		nvmem-cells = <0x61>;
		phandle = <0x62>;
	};

	hacc@1000a000 {
		compatible = "mediatek,hacc";
		interrupts = <0x0 0xcb 0x8>;
		reg = <0x0 0x1000a000 0x0 0x1000>;
	};

	hwrng {
		compatible = "mediatek,mt67xx-rng";
		phandle = <0xb1>;
	};

	i2c0@11007000 {
		aed = <0x1a>;
		clock-div = <0x5>;
		clock-names = "main", "dma";
		clocks = <0x26 0xb 0x26 0x26>;
		compatible = "mediatek,i2c";
		eh_cfg = <0x30>;
		gpio_start = <0x10002a00>;
		id = <0x0>;
		interrupts = <0x0 0x69 0x8>;
		mem_len = <0x200>;
		phandle = <0xc1>;
		pu_cfg = <0x70>;
		reg = <0x0 0x11007000 0x0 0x1000 0x0 0x11000080 0x0 0x80>;
		rsel_cfg = <0x90>;
		scl-gpio-id = <0x53>;
		sda-gpio-id = <0x52>;
	};

	i2c1@11008000 {
		aed = <0x1a>;
		clock-div = <0x5>;
		clock-names = "main", "dma";
		clocks = <0x26 0xb 0x26 0x26>;
		compatible = "mediatek,i2c";
		eh_cfg = <0x30>;
		gpio_start = <0x10002a00>;
		id = <0x1>;
		interrupts = <0x0 0x6a 0x8>;
		mem_len = <0x200>;
		phandle = <0xc2>;
		pu_cfg = <0x70>;
		reg = <0x0 0x11008000 0x0 0x1000 0x0 0x11000100 0x0 0x80>;
		rsel_cfg = <0x90>;
		scl-gpio-id = <0x54>;
		sda-gpio-id = <0x51>;
	};

	i2c2@11009000 {
		aed = <0x1a>;
		ch_offset_ccu = <0x200>;
		ch_offset_default = <0x100>;
		clock-div = <0x5>;
		clock-names = "main", "dma";
		clocks = <0x26 0xb 0x26 0x26>;
		compatible = "mediatek,i2c";
		eh_cfg = <0x40>;
		gpio_start = <0x10002800>;
		id = <0x2>;
		interrupts = <0x0 0x6b 0x8>;
		mem_len = <0x200>;
		phandle = <0xc3>;
		pu_cfg = <0xa0>;
		reg = <0x0 0x11009000 0x0 0x1000 0x0 0x11000180 0x0 0x180>;
		rsel_cfg = <0xf0>;
		scl-gpio-id = <0x67>;
		sda-gpio-id = <0x68>;
	};

	i2c3@1100f000 {
		aed = <0x1a>;
		ch_offset_ccu = <0x200>;
		ch_offset_default = <0x100>;
		clock-div = <0x5>;
		clock-names = "main", "dma";
		clocks = <0x26 0xb 0x26 0x26>;
		compatible = "mediatek,i2c";
		eh_cfg = <0x30>;
		gpio_start = <0x10002600>;
		id = <0x3>;
		interrupts = <0x0 0x6c 0x8>;
		mem_len = <0x200>;
		phandle = <0xc4>;
		pu_cfg = <0x60>;
		reg = <0x0 0x1100f000 0x0 0x1000 0x0 0x11000300 0x0 0x100>;
		rsel_cfg = <0x90>;
		scl-gpio-id = <0x32>;
		sda-gpio-id = <0x33>;
	};

	i2c4@11011000 {
		aed = <0x1a>;
		ch_offset_ccu = <0x200>;
		ch_offset_default = <0x100>;
		clock-div = <0x5>;
		clock-names = "main", "dma";
		clocks = <0x26 0xb 0x26 0x26>;
		compatible = "mediatek,i2c";
		eh_cfg = <0x40>;
		gpio_start = <0x10002800>;
		id = <0x4>;
		interrupts = <0x0 0x6d 0x8>;
		mem_len = <0x200>;
		phandle = <0xc5>;
		pu_cfg = <0xa0>;
		reg = <0x0 0x11011000 0x0 0x1000 0x0 0x11000400 0x0 0x180>;
		rsel_cfg = <0xf0>;
		scl-gpio-id = <0x69>;
		sda-gpio-id = <0x6a>;
	};

	i2c5@11016000 {
		aed = <0x1a>;
		clock-div = <0x5>;
		clock-names = "main", "dma";
		clocks = <0x26 0xb 0x26 0x26>;
		compatible = "mediatek,i2c";
		eh_cfg = <0x30>;
		gpio_start = <0x10002600>;
		id = <0x5>;
		interrupts = <0x0 0x93 0x8>;
		mem_len = <0x200>;
		phandle = <0xc6>;
		pu_cfg = <0x60>;
		reg = <0x0 0x11016000 0x0 0x1000 0x0 0x11000580 0x0 0x80>;
		rsel_cfg = <0x90>;
		scl-gpio-id = <0x30>;
		sda-gpio-id = <0x31>;
	};

	i2c6@1100d000 {
		aed = <0x1a>;
		clock-div = <0x5>;
		clock-names = "main", "dma";
		clocks = <0x26 0xb 0x26 0x26>;
		compatible = "mediatek,i2c";
		eh_cfg = <0x30>;
		gpio_start = <0x10002000>;
		id = <0x6>;
		interrupts = <0x0 0x94 0x8>;
		mem_len = <0x200>;
		phandle = <0xc7>;
		pu_cfg = <0x60>;
		reg = <0x0 0x1100d000 0x0 0x1000 0x0 0x11000600 0x0 0x80>;
		rsel_cfg = <0x90>;
		scl-gpio-id = <0x59>;
		sda-gpio-id = <0x5a>;

		aw883xx_smartpa@34 {
			#sound-dai-cells = <0x0>;
			compatible = "awinic,aw883xx_smartpa";
			phandle = <0x5d>;
			re-max = <0x9c40>;
			re-min = <0x3e8>;
			reg = <0x34>;
			reset-gpio = <0x20 0x11 0x0>;
			sound-channel = <0x0>;
			status = "okay";
		};

		aw883xx_smartpa@35 {
			#sound-dai-cells = <0x0>;
			compatible = "awinic,aw883xx_smartpa";
			phandle = <0x5e>;
			re-max = <0x9c40>;
			re-min = <0x3e8>;
			reg = <0x35>;
			reset-gpio = <0x20 0x13 0x0>;
			sound-channel = <0x1>;
			status = "okay";
		};
	};

	i2c7@11004000 {
		aed = <0x1a>;
		clock-div = <0x5>;
		clock-names = "main", "dma";
		clocks = <0x26 0xb 0x26 0x26>;
		compatible = "mediatek,i2c";
		eh_cfg = <0x30>;
		gpio_start = <0x10002600>;
		id = <0x7>;
		interrupts = <0x0 0x6e 0x8>;
		mem_len = <0x200>;
		phandle = <0xc8>;
		pu_cfg = <0x60>;
		reg = <0x0 0x11004000 0x0 0x1000 0x0 0x11000680 0x0 0x180>;
		rsel_cfg = <0x90>;
		scl-gpio-id = <0xaf>;
		sda-gpio-id = <0xb0>;
	};

	i2c8@11005000 {
		aed = <0x1a>;
		clock-div = <0x5>;
		clock-names = "main", "dma";
		clocks = <0x26 0xb 0x26 0x26>;
		compatible = "mediatek,i2c";
		id = <0x8>;
		interrupts = <0x0 0x6f 0x8>;
		phandle = <0xc9>;
		reg = <0x0 0x11005000 0x0 0x1000 0x0 0x11000800 0x0 0x180>;
	};

	i2c_common {
		check_max_freq = [01];
		cnt_constraint = [01];
		compatible = "mediatek,i2c_common";
		control_irq_sel = [01];
		dma_support = [03];
		ext_time_config = [18 01];
		idvfs = [01];
		phandle = <0xc0>;
		set_dt_div = [01];
		set_ltiming = [01];
		ver = [02];
	};

	imgsys_config@15020000 {
		clock-names = "ISP_SCP_SYS_DIS", "ISP_SCP_SYS_ISP", "ISP_SCP_SYS_CAM", "ISP_CLK_IMG_DIP", "ISP_CLK_CAM", "ISP_CLK_CAMTG", "ISP_CLK_CAM_SENINF", "ISP_CLK_CAMSV0", "ISP_CLK_CAMSV1", "ISP_CLK_CAMSV2";
		clocks = <0x27 0x3 0x27 0x5 0x27 0xa 0x25 0x1 0x64 0x2 0x64 0x3 0x64 0x4 0x64 0x5 0x64 0x6 0x64 0x7>;
		compatible = "mediatek,imgsys", "syscon";
		phandle = <0xe0>;
		reg = <0x0 0x15020000 0x0 0x1000>;
	};

	imp_iic@11017000 {
		compatible = "mediatek,imp_iic";
		reg = <0x0 0x11017000 0x0 0x1000>;
	};

	infra_dbgsystop_cpu0@0e000000 {
		compatible = "mediatek,infra_dbgsystop_cpu0";
		reg = <0x0 0xe000000 0x0 0x100000>;
	};

	infra_dbgsystop_cpu1@0e100000 {
		compatible = "mediatek,infra_dbgsystop_cpu1";
		reg = <0x0 0xe100000 0x0 0x100000>;
	};

	infra_dbgsystop_cpu2@0e200000 {
		compatible = "mediatek,infra_dbgsystop_cpu2";
		reg = <0x0 0xe200000 0x0 0x100000>;
	};

	infra_dbgsystop_cpu3@0e300000 {
		compatible = "mediatek,infra_dbgsystop_cpu3";
		reg = <0x0 0xe300000 0x0 0x100000>;
	};

	infra_dbgsystop_cpu4@0e400000 {
		compatible = "mediatek,infra_dbgsystop_cpu4";
		reg = <0x0 0xe400000 0x0 0x100000>;
	};

	infra_dbgsystop_cpu5@0e500000 {
		compatible = "mediatek,infra_dbgsystop_cpu5";
		reg = <0x0 0xe500000 0x0 0x100000>;
	};

	infra_dbgsystop_cpu6@0e600000 {
		compatible = "mediatek,infra_dbgsystop_cpu6";
		reg = <0x0 0xe600000 0x0 0x100000>;
	};

	infra_dbgsystop_cpu7@0e700000 {
		compatible = "mediatek,infra_dbgsystop_cpu7";
		reg = <0x0 0xe700000 0x0 0x100000>;
	};

	infra_mbist@1020d000 {
		compatible = "mediatek,infra_mbist";
		reg = <0x0 0x1020d000 0x0 0x1000>;
	};

	infracfg@1020e000 {
		compatible = "mediatek,infracfg";
		reg = <0x0 0x1020e000 0x0 0x1000>;
	};

	infracfg_ao@10001000 {
		#clock-cells = <0x1>;
		compatible = "mediatek,common-infracfg_ao", "mediatek,infracfg_ao", "syscon";
		interrupts = <0x0 0x47 0x1>;
		phandle = <0x26>;
		reg = <0x0 0x10001000 0x0 0x1000>;
	};

	interrupt-controller {
		#address-cells = <0x2>;
		#interrupt-cells = <0x3>;
		#redistributor-regions = <0x1>;
		#size-cells = <0x2>;
		compatible = "arm,gic-v3";
		interrupt-controller;
		interrupt-parent = <0x13>;
		interrupts = <0x1 0x9 0x4>;
		phandle = <0x13>;
		reg = <0x0 0xc000000 0x0 0x40000 0x0 0xc040000 0x0 0x200000 0x0 0xc53a650 0x0 0x50>;
	};

	intpol-controller@0 {
		#interrupt-cells = <0x3>;
		compatible = "mediatek,mt6577-sysirq";
		interrupt-controller;
		interrupt-parent = <0x13>;
		phandle = <0x1>;
		reg = <0x0 0xc53a650 0x0 0x50>;
	};

	io_cfg_bl@10002600 {
		compatible = "mediatek,io_cfg_bl";
		phandle = <0x1a>;
		reg = <0x0 0x10002600 0x0 0x200>;
	};

	io_cfg_lb@10002400 {
		compatible = "mediatek,io_cfg_lb";
		phandle = <0x19>;
		reg = <0x0 0x10002400 0x0 0x200>;
	};

	io_cfg_lm@10002200 {
		compatible = "mediatek,io_cfg_lm";
		phandle = <0x18>;
		reg = <0x0 0x10002200 0x0 0x200>;
	};

	io_cfg_lt@10002000 {
		compatible = "mediatek,io_cfg_lt";
		phandle = <0x17>;
		reg = <0x0 0x10002000 0x0 0x200>;
	};

	io_cfg_rb@10002a00 {
		compatible = "mediatek,io_cfg_rb";
		phandle = <0x1c>;
		reg = <0x0 0x10002a00 0x0 0x200>;
	};

	io_cfg_rm@10002800 {
		compatible = "mediatek,io_cfg_rm";
		phandle = <0x1b>;
		reg = <0x0 0x10002800 0x0 0x200>;
	};

	io_cfg_rt@10002c00 {
		compatible = "mediatek,io_cfg_rt";
		phandle = <0x1d>;
		reg = <0x0 0x10002c00 0x0 0x200>;
	};

	io_cfg_tl@10002e00 {
		compatible = "mediatek,io_cfg_tl";
		phandle = <0x1e>;
		reg = <0x0 0x10002e00 0x0 0x200>;
	};

	iocfg_0@10002000 {
		compatible = "mediatek,iocfg_0";
		reg = <0x0 0x10002000 0x0 0x200>;
	};

	iocfg_1@10002200 {
		compatible = "mediatek,iocfg_1";
		reg = <0x0 0x10002200 0x0 0x200>;
	};

	iocfg_2@10002400 {
		compatible = "mediatek,iocfg_2";
		reg = <0x0 0x10002400 0x0 0x200>;
	};

	iocfg_3@10002600 {
		compatible = "mediatek,iocfg_3";
		reg = <0x0 0x10002600 0x0 0x200>;
	};

	iocfg_4@10002800 {
		compatible = "mediatek,iocfg_4";
		reg = <0x0 0x10002800 0x0 0x200>;
	};

	iocfg_5@10002a00 {
		compatible = "mediatek,iocfg_5";
		reg = <0x0 0x10002a00 0x0 0x200>;
	};

	irq_nfc {
		compatible = "mediatek,irq_nfc-eint";
		phandle = <0xfc>;
	};

	irtx_pwm {
		compatible = "mediatek,irtx-pwm";
		phandle = <0xf7>;
		pwm_ch = <0x0>;
		pwm_data_invert = <0x0>;
	};

	kd_camera_hw1@1a040000 {
		clock-names = "CLK_TOP_CAMTG_SEL", "CLK_TOP_CAMTG1_SEL", "CLK_TOP_CAMTG2_SEL", "CLK_TOP_CAMTG3_SEL", "CLK_MCLK_6M", "CLK_MCLK_12M", "CLK_MCLK_13M", "CLK_MCLK_48M", "CLK_MCLK_52M", "CLK_MCLK_24M", "CLK_MCLK_26M", "CLK_CAM_SENINF_CG", "CLK_MIPI_C0_26M_CG", "CLK_MIPI_C1_26M_CG", "CLK_MIPI_ANA_0A_CG", "CLK_MIPI_ANA_0B_CG", "CLK_MIPI_ANA_1A_CG", "CLK_MIPI_ANA_1B_CG", "CLK_MIPI_ANA_2A_CG", "CLK_MIPI_ANA_2B_CG", "CLK_TOP_CAMTM_SEL_CG", "CLK_TOP_CAMTM_208_CG", "CLK_SCP_SYS_CAM";
		clocks = <0x14 0x56 0x14 0x57 0x14 0x58 0x14 0x59 0x14 0x14 0x14 0x13 0x14 0x1d 0x14 0x11 0x14 0x1c 0x14 0x12 0x15 0x64 0x4 0x45 0xe 0x45 0x12 0x6b 0x0 0x6c 0x0 0x6d 0x0 0x6e 0x0 0x6f 0x0 0x70 0x0 0x14 0x6d 0x14 0x1a 0x27 0xa>;
		compatible = "mediatek,camera_hw";
		phandle = <0xe7>;
		reg = <0x0 0x1a040000 0x0 0x1000>;
	};

	kp@10010000 {
		clock-names = "kpd";
		clocks = <0x15>;
		compatible = "mediatek,kp";
		interrupts = <0x0 0x49 0x2>;
		kpd-bootmode = <0x22>;
		mediatek,boot_mode = <0x1>;
		phandle = <0xac>;
		reg = <0x0 0x10010000 0x0 0x1000>;
	};

	ktf-cmdq-test {
		compatible = "mediatek,ktf-cmdq-test";
		gce-event-names = "disp_rdma0_sof", "disp_rdsz0_sof", "mdp_rdma0_sof";
		gce-events = <0x35 0x9 0x35 0x11 0x35 0x0>;
		mboxes = <0x35 0x8 0x0 0x1 0x35 0x9 0xffffffff 0x1 0x35 0xa 0x0 0x1>;
		mediatek,gce-subsys = <0x63 0x1>;
		mediatek,mailbox-gce = <0x35>;
		mmsys_config = <0x2b>;
		token_gpr_set4 = [02 c0];
		token_user0 = [02 89];
	};

	lastbus@10001000 {
		compatible = "mediatek,lastbus-v1";
		reg = <0x0 0x10001000 0x0 0x1000 0x0 0x10003000 0x0 0x1000>;
	};

	lk_charger {
		ac_charger_current = <0x1f47d0>;
		ac_charger_input_current = <0x30d400>;
		charging_host_charger_current = <0x16e360>;
		compatible = "mediatek,lk_charger";
		enable_anime;
		enable_pd20_reset;
		fast_charge_voltage = <0x2dc6c0>;
		max_charger_voltage = <0x632ea0>;
		non_std_ac_charger_current = <0x7a120>;
		pd_charger_current = <0x7a120>;
		phandle = <0xf0>;
		power_path_support;
		ta_ac_charger_current = <0x2dc6c0>;
		temp_t1_threshold = <0x0>;
		temp_t3_threshold = <0x2d>;
		temp_t4_threshold = <0x32>;
		usb_charger_current = <0x7a120>;
	};

	m4u@10205000 {
		cell-index = <0x0>;
		clock-names = "ISP_CLK_IMG_DIP";
		clocks = <0x25 0x1>;
		compatible = "mediatek,m4u";
		interrupts = <0x0 0xae 0x8>;
		reg = <0x0 0x10205000 0x0 0x1000>;
	};

	mali@13040000 {
		compatible = "mediatek,mali", "arm,mali-valhall";
		ged-supply = <0x5f>;
		interrupt-names = "GPU", "MMU", "JOB", "EVENT", "PWR";
		interrupts = <0x0 0x112 0x8 0x0 0x113 0x8 0x0 0x114 0x8 0x0 0x115 0x8 0x0 0x116 0x8>;
		reg = <0x0 0x13040000 0x0 0x4000>;
	};

	mbist@17040000 {
		compatible = "mediatek,mbist";
		reg = <0x0 0x17040000 0x0 0x10000>;
	};

	mbist@17050000 {
		compatible = "mediatek,mbist";
		reg = <0x0 0x17050000 0x0 0x10000>;
	};

	mbist@17060000 {
		compatible = "mediatek,mbist";
		reg = <0x0 0x17060000 0x0 0x10000>;
	};

	mbist@17070000 {
		compatible = "mediatek,mbist";
		reg = <0x0 0x17070000 0x0 0x10000>;
	};

	mbist_ao@10013000 {
		compatible = "mediatek,mbist_ao";
		reg = <0x0 0x10013000 0x0 0x1000>;
	};

	mcdi@00110100 {
		compatible = "mediatek,mt6768-mcdi";
		mediatek,enabled = <0x1>;
		phandle = <0x79>;
		reg = <0x0 0x110100 0x0 0x800 0x0 0xc53a000 0x0 0x1000>;
	};

	mcucfg@0c530000 {
		compatible = "mediatek,mcucfg";
		phandle = <0xb0>;
		reg = <0x0 0xc530000 0x0 0x10000>;
	};

	mcucfg_mp0_counter@0c530000 {
		compatible = "mediatek,mcucfg_mp0_counter";
		reg = <0x0 0xc530000 0x0 0x10000>;
	};

	mcupm_reg@10216000 {
		compatible = "mediatek,mcupm_reg";
		reg = <0x0 0x10216000 0x0 0x1000>;
	};

	mcupm_sram0@10217000 {
		compatible = "mediatek,mcupm_sram0";
		reg = <0x0 0x10217000 0x0 0x1000>;
	};

	mcupm_sram1@10218000 {
		compatible = "mediatek,mcupm_sram1";
		reg = <0x0 0x10218000 0x0 0x1000>;
	};

	mcupm_sram2@10211000 {
		compatible = "mediatek,mcupm_sram2";
		reg = <0x0 0x10211000 0x0 0x1000>;
	};

	mcupm_sram3@10213000 {
		compatible = "mediatek,mcupm_sram3";
		reg = <0x0 0x10213000 0x0 0x1000>;
	};

	md1_sim1_hot_plug_eint {
		phandle = <0xff>;
	};

	md1_sim2_hot_plug_eint {
		phandle = <0x100>;
	};

	md_auxadc {
		compatible = "mediatek,md_auxadc";
		io-channel-names = "md-channel";
		io-channels = <0x2a 0x2>;
		phandle = <0xb5>;
	};

	md_ccif0@1020a000 {
		compatible = "mediatek,md_ccif0";
		reg = <0x0 0x1020a000 0x0 0x1000>;
	};

	md_ccif1@1020c000 {
		compatible = "mediatek,md_ccif1";
		reg = <0x0 0x1020c000 0x0 0x1000>;
	};

	md_ccif2@1023d000 {
		compatible = "mediatek,md_ccif2";
		reg = <0x0 0x1023d000 0x0 0x1000>;
	};

	md_ccif3@1023f000 {
		compatible = "mediatek,md_ccif3";
		reg = <0x0 0x1023f000 0x0 0x1000>;
	};

	mdcldmain@1021c000 {
		compatible = "mediatek,mdcldmain";
		reg = <0x0 0x1021c000 0x0 0x400>;
	};

	mdcldmain_ao@10015000 {
		compatible = "mediatek,mdcldmain_ao";
		reg = <0x0 0x10015000 0x0 0x400>;
	};

	mdcldmamisc@1021c000 {
		compatible = "mediatek,mdcldmamisc";
		reg = <0x0 0x1021c000 0x0 0x1000>;
	};

	mdcldmamisc@1021c900 {
		compatible = "mediatek,mdcldmamisc";
		reg = <0x0 0x1021c900 0x0 0x400>;
	};

	mdcldmamisc_ao@10015800 {
		compatible = "mediatek,mdcldmamisc_ao";
		reg = <0x0 0x10015800 0x0 0x400>;
	};

	mdcldmaout@1021c400 {
		compatible = "mediatek,mdcldmaout";
		reg = <0x0 0x1021c400 0x0 0x400>;
	};

	mdcldmaout_ao@10015400 {
		compatible = "mediatek,mdcldmaout_ao";
		reg = <0x0 0x10015400 0x0 0x400>;
	};

	mddriver@10014000 {
		_vcore-supply = <0x29>;
		_vmodem-supply = <0x28>;
		ccci-infracfg = <0x26>;
		clock-names = "scp-sys-md1-main", "infra-cldma-bclk", "infra-ccif-ap", "infra-ccif-md", "infra-ccif1-ap", "infra-ccif1-md", "infra-ccif2-ap", "infra-ccif2-md";
		clocks = <0x27 0x0 0x26 0x32 0x26 0x29 0x26 0x2c 0x26 0x23 0x26 0x24 0x26 0x51 0x26 0x52>;
		compatible = "mediatek,mddriver", "mediatek,mddriver-mt6768";
		interrupts = <0x0 0xb4 0x4 0x0 0xa4 0x8 0x0 0xa5 0x8 0x0 0x4b 0x2>;
		mediatek,ap_plat_info = <0x1a70>;
		mediatek,cldma_capability = <0x6>;
		mediatek,md_generation = <0x1895>;
		mediatek,md_id = <0x0>;
		mediatek,mdhif_type = <0x3>;
		mediatek,offset_apon_md1 = <0x1c24>;
		phandle = <0xb4>;
		reg = <0x0 0x10014000 0x0 0x1000 0x0 0x1021b000 0x0 0x1000 0x0 0x10209000 0x0 0x1000 0x0 0x1020a000 0x0 0x1000>;
	};

	mdp_ccorr0@14005000 {
		clock-names = "MDP_CCORR";
		clocks = <0x2b 0x1>;
		compatible = "mediatek,mdp_ccorr0";
		interrupts = <0x0 0xef 0x8>;
		phandle = <0x33>;
		reg = <0x0 0x14005000 0x0 0x1000>;
	};

	mdp_rdma0@14004000 {
		clock-names = "MDP_RDMA0";
		clocks = <0x2b 0x0>;
		compatible = "mediatek,mdp_rdma0";
		interrupts = <0x0 0xe0 0x8>;
		phandle = <0x2c>;
		reg = <0x0 0x14004000 0x0 0x1000>;
	};

	mdp_rsz0@14006000 {
		clock-names = "MDP_RSZ0";
		clocks = <0x2b 0x2>;
		compatible = "mediatek,mdp_rsz0";
		interrupts = <0x0 0xe1 0x8>;
		phandle = <0x2d>;
		reg = <0x0 0x14006000 0x0 0x1000>;
	};

	mdp_rsz1@14007000 {
		clock-names = "MDP_RSZ1";
		clocks = <0x2b 0x3>;
		compatible = "mediatek,mdp_rsz1";
		interrupts = <0x0 0xe2 0x8>;
		phandle = <0x2e>;
		reg = <0x0 0x14007000 0x0 0x1000>;
	};

	mdp_tdshp0@1400a000 {
		clock-names = "MDP_TDSHP";
		clocks = <0x2b 0x4>;
		compatible = "mediatek,mdp_tdshp0";
		phandle = <0x31>;
		reg = <0x0 0x1400a000 0x0 0x1000>;
	};

	mdp_wdma0@14008000 {
		clock-names = "MDP_WDMA";
		clocks = <0x2b 0x6>;
		compatible = "mediatek,mdp_wdma0";
		interrupts = <0x0 0xe5 0x8>;
		phandle = <0x2f>;
		reg = <0x0 0x14008000 0x0 0x1000>;
	};

	mdp_wrot0@14009000 {
		clock-names = "MDP_WROT0";
		clocks = <0x2b 0x5>;
		compatible = "mediatek,mdp_wrot0";
		interrupts = <0x0 0xe4 0x8>;
		phandle = <0x30>;
		reg = <0x0 0x14009000 0x0 0x1000>;
	};

	memory {
		device_type = "memory";
		reg = <0x0 0x40000000 0x0 0x3e605000>;
	};

	memory-ssmr-features {
		2d_fr-size = <0x0 0x0>;
		compatible = "mediatek,memory-ssmr-features";
		iris-recognition-size = <0x0 0x10000000>;
		phandle = <0xec>;
		prot-region-based-size = <0x0 0x8000000>;
		sdsp-firmware-size = <0x0 0x1000000>;
		sdsp-tee-sharedmem-size = <0x0 0x1000000>;
		svp-region-based-size = <0x0 0x10000000>;
		ta-elf-size = <0x0 0x1000000>;
		ta-stack-heap-size = <0x0 0x6000000>;
		tui-size = <0x0 0x4000000>;
		wfd-size = <0x0 0x5000000>;
	};

	mfg_cfg@13000000 {
		#clock-cells = <0x1>;
		compatible = "mediatek,mfgcfg", "syscon";
		phandle = <0x60>;
		reg = <0x0 0x13000000 0x0 0x1000>;
	};

	mipi_rx_ana_csi0a@11c10000 {
		#clock-cells = <0x1>;
		compatible = "mediatek,mipi_rx_ana_csi0a", "syscon";
		phandle = <0x6b>;
		reg = <0x0 0x11c10000 0x0 0x1000>;
	};

	mipi_rx_ana_csi0b@11c11000 {
		#clock-cells = <0x1>;
		compatible = "mediatek,mipi_rx_ana_csi0b", "syscon";
		phandle = <0x6c>;
		reg = <0x0 0x11c11000 0x0 0x1000>;
	};

	mipi_rx_ana_csi1a@11c12000 {
		#clock-cells = <0x1>;
		compatible = "mediatek,mipi_rx_ana_csi1a", "syscon";
		phandle = <0x6d>;
		reg = <0x0 0x11c12000 0x0 0x1000>;
	};

	mipi_rx_ana_csi1b@11c13000 {
		#clock-cells = <0x1>;
		compatible = "mediatek,mipi_rx_ana_csi1b", "syscon";
		phandle = <0x6e>;
		reg = <0x0 0x11c13000 0x0 0x1000>;
	};

	mipi_rx_ana_csi2a@11c14000 {
		#clock-cells = <0x1>;
		compatible = "mediatek,mipi_rx_ana_csi2a", "syscon";
		phandle = <0x6f>;
		reg = <0x0 0x11c14000 0x0 0x1000>;
	};

	mipi_rx_ana_csi2b@11c15000 {
		#clock-cells = <0x1>;
		compatible = "mediatek,mipi_rx_ana_csi2b", "syscon";
		phandle = <0x70>;
		reg = <0x0 0x11c15000 0x0 0x1000>;
	};

	mipi_tx0@11c80000 {
		compatible = "mediatek,mipi_tx0";
		reg = <0x0 0x11c80000 0x0 0x10000>;
	};

	mm_mutex@14016000 {
		compatible = "mediatek,mm_mutex";
		reg = <0x0 0x14016000 0x0 0x1000>;
	};

	mmc@11230000 {
		bus-width = <0x8>;
		cap-mmc-highspeed;
		clock-names = "source", "hclk", "source_cg", "crypto_clk";
		clocks = <0x14 0x3c 0x26 0x1c 0x26 0x4c 0x26 0x44>;
		compatible = "mediatek,mt6768-mmc";
		host-function = <0x0>;
		host-index = <0x0>;
		hs400-ds-delay = <0x12814>;
		interrupts = <0x0 0x64 0x8>;
		max-frequency = <0xbebc200>;
		mediatek,cqhci;
		mmc-ddr-1_8v;
		mmc-hs200-1_8v;
		mmc-hs400-1_8v;
		no-sd;
		no-sdio;
		non-removable;
		phandle = <0xd1>;
		pinctrl-0 = <0x3a>;
		pinctrl-1 = <0x3b>;
		pinctrl-names = "default", "state_uhs";
		reg = <0x0 0x11230000 0x0 0x10000 0x0 0x11cd0000 0x0 0x1000>;
		status = "okay";
		vmmc-supply = <0x3c>;
	};

	mmc@11240000 {
		bus-width = <0x4>;
		cap-sd-highspeed;
		cd-gpios = <0x20 0x39 0x0>;
		clock-names = "source", "hclk", "source_cg";
		clocks = <0x14 0x3d 0x26 0x1d 0x26 0x4d>;
		compatible = "mediatek,mt6768-mmc";
		host-function = <0x1>;
		host-index = <0x1>;
		interrupts = <0x0 0x65 0x8>;
		max-frequency = <0xbebc200>;
		no-mmc;
		no-sdio;
		phandle = <0xd2>;
		pinctrl-0 = <0x3d>;
		pinctrl-1 = <0x3e>;
		pinctrl-2 = <0x3f>;
		pinctrl-names = "default", "state_uhs", "pull_down";
		reg = <0x0 0x11240000 0x0 0x10000 0x0 0x11c90000 0x0 0x1000>;
		sd-uhs-ddr50;
		sd-uhs-sdr104;
		sd-uhs-sdr12;
		sd-uhs-sdr25;
		sd-uhs-sdr50;
		status = "okay";
		vmmc-supply = <0x40>;
		vqmmc-supply = <0x41>;
	};

	mmdvfs_pmqos {
		cam_freq = "cam_step0", "cam_step1", "cam_step2";
		cam_step0 = <0x222 0x1 0x2 0x7>;
		cam_step1 = <0x138 0x1 0x2 0x4>;
		cam_step2 = <0xe4 0x1 0x2 0x5>;
		clock-names = "mmdvfs_clk_mm_sel_ck", "mmdvfs_clk_venc_sel_ck", "mmdvfs_clk_cam_sel_ck", "mmdvfs_clk_mmpll_ck", "mmdvfs_clk_univpll1_d2_ck", "mmdvfs_clk_mmpll_d2_ck", "mmdvfs_clk_univpll_d3_ck", "mmdvfs_clk_syspll_d2_ck";
		clocks = <0x14 0x52 0x14 0x6e 0x14 0x6f 0x14 0x21 0x14 0x17 0x14 0x22 0x14 0x19 0x14 0x1>;
		compatible = "mediatek,mmdvfs_pmqos";
		disp_freq = "mm_step0", "mm_step1", "mm_step2";
		img_freq = "mm_step0", "mm_step1", "mm_step2";
		mdp_freq = "mm_step0", "mm_step1", "mm_step2";
		mm_step0 = <0x1c9 0x1 0x0 0x3>;
		mm_step1 = <0x138 0x1 0x0 0x4>;
		mm_step2 = <0xe4 0x1 0x0 0x5>;
		vdec_freq = "mm_step0", "mm_step1", "mm_step2";
		venc_freq = "venc_step0", "venc_step1", "venc_step2";
		venc_step0 = <0x1c9 0x1 0x1 0x3>;
		venc_step1 = <0x1a0 0x1 0x1 0x6>;
		venc_step2 = <0x138 0x1 0x1 0x4>;
		vopp_steps = <0x0 0x1 0x3>;
	};

	mmsys_config@14000000 {
		#clock-cells = <0x1>;
		clock-names = "CAM_MDP", "IMG_DL_RELAY", "IMG_DL_ASYNC_TOP";
		clocks = <0x2b 0x17 0x2b 0x1c 0x2b 0x1d>;
		compatible = "mediatek,mmsys_config", "syscon";
		interrupts = <0x0 0xf0 0x8>;
		phandle = <0x2b>;
		reg = <0x0 0x14000000 0x0 0x1000>;
	};

	mobicore {
		compatible = "trustonic,mobicore";
		interrupts = <0x0 0x129 0x1>;
	};

	modem_temp_share@10018000 {
		compatible = "mediatek,modem_temp_share";
		reg = <0x0 0x10018000 0x0 0x1000>;
	};

	mrdump_ext_rst {
		compatible = "mediatek, mrdump_ext_rst-eint";
		mode = "IRQ";
		phandle = <0xad>;
		status = "okay";
	};

	msdc0_top@11cd0000 {
		compatible = "mediatek,msdc0_top";
		reg = <0x0 0x11cd0000 0x0 0x1000>;
	};

	msdc1_ins {
		phandle = <0xef>;
	};

	msdc1_top@11c90000 {
		compatible = "mediatek,msdc1_top";
		reg = <0x0 0x11c90000 0x0 0x1000>;
	};

	msdc@11230000 {
		compatible = "mediatek,msdc";
		interrupts = <0x0 0x64 0x8>;
		phandle = <0xda>;
		reg = <0x0 0x11230000 0x0 0x10000>;
	};

	msdc@11240000 {
		compatible = "mediatek,msdc";
		interrupts = <0x0 0x65 0x8>;
		phandle = <0xdb>;
		reg = <0x0 0x11240000 0x0 0x10000>;
	};

	mt6358_gauge {
		alias_name = "MT6358";
		bootmode = <0x22>;
		compatible = "mediatek,mt6358_gauge";
		gauge_name = "gauge";
		io-channel-names = "batteryID-channel";
		io-channels = <0x2a 0x3>;
	};

	mt6358_snd {
		compatible = "mediatek,mt6358-sound";
		mediatek,pwrap-regmap = <0x23>;
		phandle = <0x5b>;
	};

	mt6370_pmu_dts {
		#interrupt-cells = <0x1>;
		interrupt-controller;
		mt6370,intr_gpio = <0x20 0x3 0x0>;
		mt6370,intr_gpio_num = <0x3>;
		phandle = <0x101>;

		bled {
			compatible = "mediatek,mt6370_pmu_bled";
			interrupt-names = "bled_ocp";
			mt,bl_ocp_level = <0x2>;
			mt,bl_ovp_level = <0x3>;
			mt,bled_curr_scale = <0x0>;
			mt,bled_flash_ramp = <0x1>;
			mt,bled_name = "mt6370_pmu_bled";
			mt,bled_ramptime = <0x3>;
			mt,chan_en = <0xf>;
			mt,map_linear;
			mt,max_bled_brightness = <0x200>;
			mt,pwm_avg_cycle = <0x0>;
			mt,pwm_deglitch = <0x1>;
			mt,pwm_fsample = <0x2>;
			mt,pwm_hys = <0x0>;
			mt,pwm_hys_en = <0x1>;
			mt,pwm_lpf_coef = <0x0>;
			mt,use_pwm;
		};

		charger {
			aicr = <0x7a120>;
			bc12_sel = <0x0>;
			bootmode = <0x22>;
			charger = <0x72>;
			charger_name = "primary_chg";
			compatible = "mediatek,mt6370_pmu_charger";
			cv = <0x426030>;
			dc_wdt = <0x3d0900>;
			enable_otg_wdt;
			enable_te;
			enable_wdt;
			ichg = <0x1e8480>;
			ieoc = <0x249f0>;
			interrupt-names = "chg_mivr", "chg_aiclmeasi", "attachi", "ovpctrl_uvp_d_evt", "chg_wdtmri", "chg_vbusov", "chg_tmri", "chg_treg", "dcdti";
			ircmp_resistor = <0x61a8>;
			ircmp_vclamp = <0x7d00>;
			lbp_dt = <0x1>;
			lbp_hys_sel = <0x1>;
			load_switch_name = "primary_load_switch";
			mivr = <0x432380>;
			phandle = <0x72>;
			safety_timer = <0xc>;

			usb-otg-vbus {
				phandle = <0x102>;
				regulator-compatible = "usb-otg-vbus";
				regulator-max-microamp = <0x2dc6c0>;
				regulator-max-microvolt = <0x588040>;
				regulator-min-microamp = <0x7a120>;
				regulator-min-microvolt = <0x426030>;
				regulator-name = "usb-otg-vbus";
			};
		};

		core {
			compatible = "mediatek,mt6370_pmu_core";
			i2cstmr_rst_tmr = <0x0>;
			int_deg = <0x0>;
			int_wdt = <0x0>;
			interrupt-names = "otp", "vdda_ovp", "vdda_uv";
			mrstb_en;
			mrstb_tmr = <0x3>;
		};

		dsv {
			compatible = "mediatek,mt6370_pmu_dsv";
			db_delay = <0x3>;
			db_ext_en = <0x0>;
			db_freq_pm = <0x0>;
			db_periodic_fix = <0x0>;
			db_periodic_mode = <0x0>;
			db_single_pin = <0x0>;
			db_startup = <0x0>;
			db_vbst = <0x1644>;
			db_vneg_20ms = <0x1>;
			db_vneg_disc = <0x0>;
			db_vneg_slew = <0x1>;
			db_vpos_20ms = <0x1>;
			db_vpos_disc = <0x1>;
			db_vpos_slew = <0x1>;
			interrupt-names = "dsv_vneg_ocp", "dsv_vpos_ocp", "dsv_bst_ocp", "dsv_vneg_scp", "dsv_vpos_scp";

			mt6370_dsvn {
				regulator-max-microvolt = <0x5b8d80>;
				regulator-min-microvolt = <0x3d0900>;
				regulator-name = "dsv_neg";
			};

			mt6370_dsvp {
				regulator-max-microvolt = <0x5b8d80>;
				regulator-min-microvolt = <0x3d0900>;
				regulator-name = "dsv_pos";
			};
		};

		ldo {
			compatible = "mediatek,mt6370_pmu_ldo";
			interrupt-names = "ldo_oc";
			ldo_oms = <0x1>;
			ldo_vrc_lt = <0x1>;

			mt6370_ldo {
				regulator-max-microvolt = <0x3d0900>;
				regulator-min-microvolt = <0x186a00>;
				regulator-name = "irtx_ldo";
			};
		};

		mt6370_pmu_fled1 {
			compatible = "mediatek,mt6370_pmu_fled1";
			fled_enable = <0x1>;
			interrupt-names = "fled_lvf", "fled2_short", "fled1_short";
			strobe_cur = <0x124f80>;
			strobe_timeout = <0x960>;
			torch_cur = <0x493e0>;
		};

		mt6370_pmu_fled2 {
			compatible = "mediatek,mt6370_pmu_fled2";
			fled_enable = <0x1>;
			strobe_cur = <0xf4240>;
			strobe_timeout = <0x4b0>;
			torch_cur = <0x30d40>;
		};

		rgbled {
			compatible = "mediatek,mt6370_pmu_rgbled";
			interrupt-names = "isink4_short", "isink3_short", "isink2_short", "isink1_short", "isink4_open", "isink3_open", "isink2_open", "isink1_open";
			mt,led_default_trigger = "cc_mode", "cc_mode", "cc_mode", "none";
			mt,led_name = "mt6370_pmu_led1", "mt6370_pmu_led2", "mt6370_pmu_led3", "mt6370_pmu_led4";
		};
	};

	mt6370_pmu_eint {
		phandle = <0xf5>;
	};

	mt6768-afe-pcm@11220000 {
		apmixed = <0x45>;
		clock-names = "aud_afe_clk", "aud_dac_clk", "aud_dac_predis_clk", "aud_adc_clk", "aud_apll22m_clk", "aud_apll24m_clk", "aud_apll1_tuner_clk", "aud_tml_clk", "aud_infra_axi_clk", "aud_infra_26m_clk", "top_mux_audio", "top_mux_audio_int", "top_sys_pll1_d4", "top_mux_aud_1", "top_apll1_ck", "top_mux_aud_eng1", "top_apll1_d8", "top_i2s0_m_sel", "top_i2s1_m_sel", "top_i2s2_m_sel", "top_i2s3_m_sel", "top_apll12_div0", "top_apll12_div1", "top_apll12_div2", "top_apll12_div3", "apmixed_apll1", "top_clk26m_clk";
		clocks = <0x46 0x0 0x46 0x5 0x46 0x6 0x46 0x4 0x46 0x1 0x46 0x2 0x46 0x3 0x46 0x7 0x26 0x2b 0x26 0x33 0x14 0x5f 0x14 0x60 0x14 0x3 0x14 0x61 0x14 0x29 0x14 0x62 0x14 0x2c 0x14 0x82 0x14 0x83 0x14 0x84 0x14 0x85 0x14 0x70 0x14 0x71 0x14 0x72 0x14 0x73 0x45 0x8 0x15>;
		compatible = "mediatek,mt6768-sound";
		interrupts = <0x0 0xa9 0x8>;
		phandle = <0x5c>;
		pinctrl-0 = <0x47>;
		pinctrl-1 = <0x48>;
		pinctrl-10 = <0x51>;
		pinctrl-11 = <0x52>;
		pinctrl-12 = <0x53>;
		pinctrl-13 = <0x54>;
		pinctrl-14 = <0x55>;
		pinctrl-15 = <0x56>;
		pinctrl-16 = <0x57>;
		pinctrl-17 = <0x58>;
		pinctrl-18 = <0x59>;
		pinctrl-19 = <0x5a>;
		pinctrl-2 = <0x49>;
		pinctrl-3 = <0x4a>;
		pinctrl-4 = <0x4b>;
		pinctrl-5 = <0x4c>;
		pinctrl-6 = <0x4d>;
		pinctrl-7 = <0x4e>;
		pinctrl-8 = <0x4f>;
		pinctrl-9 = <0x50>;
		pinctrl-names = "aud_clk_mosi_off", "aud_clk_mosi_on", "aud_clk_miso_off", "aud_clk_miso_on", "aud_dat_mosi_off", "aud_dat_mosi_on", "aud_dat_miso_off", "aud_dat_miso_on", "aud_gpio_i2s0_off", "aud_gpio_i2s0_on", "aud_gpio_i2s1_off", "aud_gpio_i2s1_on", "aud_gpio_i2s2_off", "aud_gpio_i2s2_on", "aud_gpio_i2s3_off", "aud_gpio_i2s3_on", "vow_dat_miso_off", "vow_dat_miso_on", "vow_clk_miso_off", "vow_clk_miso_on";
		reg = <0x0 0x11220000 0x0 0x1000>;
		topckgen = <0x14>;
	};

	mt_charger {
		bootmode = <0x22>;
		compatible = "mediatek,mt-charger";
		phandle = <0xee>;
	};

	mt_cpufreq {
		compatible = "mediatek,mt-cpufreq";
		phandle = <0xb7>;
	};

	mt_soc_playback_offload {
		compatible = "mediatek,mt_soc_offload_common";
	};

	mtk-btcvsd-snd@18050000 {
		compatible = "mediatek,mtk-btcvsd-snd";
		disable_write_silence = <0x1>;
		interrupts = <0x0 0x11b 0x8>;
		mediatek,infracfg = <0x26>;
		mediatek,offset = <0xf00 0x800 0x140 0x144 0x148>;
		reg = <0x0 0x18050000 0x0 0x1000 0x0 0x18080000 0x0 0x10000>;
	};

	mtkfb@0 {
		compatible = "mediatek,mtkfb";
		phandle = <0xde>;
	};

	nebula {
		#address-cells = <0x2>;
		#size-cells = <0x2>;
		compatible = "android,nebula-smc-v1";
		ranges;
		tee-id = <0x1>;
		tee-name = "nebula";

		nebula-gz-log {
			compatible = "android,nebula-gz-log-v1";
		};

		nebula-irq {
			compatible = "android,nebula-irq-v1";
			ppi-interrupt-parent = <0x13>;
		};

		nebula-virtio {
			compatible = "android,nebula-virtio-v1";
		};
	};

	nfc {
		compatible = "mediatek,nfc-gpio-v2";
		gpio-irq = <0x9>;
		gpio-irq-std = <0x20 0x9 0x0>;
		gpio-rst = <0x9f>;
		gpio-rst-std = <0x20 0x9f 0x0>;
		phandle = <0xfb>;
	};

	nfi@11018000 {
		compatible = "mediatek,nfi";
		reg = <0x0 0x11018000 0x0 0x1000>;
	};

	nfiecc@11019000 {
		compatible = "mediatek,nfiecc";
		reg = <0x0 0x11019000 0x0 0x1000>;
	};

	odm {
		compatible = "simple-bus";
		phandle = <0xeb>;
	};

	opp_table0 {
		compatible = "operating-points-v2";
		opp-shared;
		phandle = <0x2>;

		opp0 {
			opp-hz = <0x0 0x1dcd6500>;
			opp-microvolt = <0x9eb10>;
		};

		opp1 {
			opp-hz = <0x0 0x2e224d80>;
			opp-microvolt = <0xa4cb8>;
		};

		opp10 {
			opp-hz = <0x0 0x4ef9e540>;
			opp-microvolt = <0xcdfe6>;
		};

		opp11 {
			opp-hz = <0x0 0x51f4d5c0>;
			opp-microvolt = <0xd10ba>;
		};

		opp12 {
			opp-hz = <0x0 0x566d3e80>;
			opp-microvolt = <0xd7262>;
		};

		opp13 {
			opp-hz = <0x0 0x59682f00>;
			opp-microvolt = <0xda336>;
		};

		opp14 {
			opp-hz = <0x0 0x60db8840>;
			opp-microvolt = <0xe35b2>;
		};

		opp15 {
			opp-hz = <0x0 0x6553f100>;
			opp-microvolt = <0xeafc4>;
		};

		opp2 {
			opp-hz = <0x0 0x32a9f880>;
			opp-microvolt = <0xaae60>;
		};

		opp3 {
			opp-hz = <0x0 0x35a4e900>;
			opp-microvolt = <0xaf79e>;
		};

		opp4 {
			opp-hz = <0x0 0x389fd980>;
			opp-microvolt = <0xb2872>;
		};

		opp5 {
			opp-hz = <0x0 0x3b8b87c0>;
			opp-microvolt = <0xb5946>;
		};

		opp6 {
			opp-hz = <0x0 0x3e95ba80>;
			opp-microvolt = <0xba284>;
		};

		opp7 {
			opp-hz = <0x0 0x4190ab00>;
			opp-microvolt = <0xbd358>;
		};

		opp8 {
			opp-hz = <0x0 0x460913c0>;
			opp-microvolt = <0xc3500>;
		};

		opp9 {
			opp-hz = <0x0 0x4bfef4c0>;
			opp-microvolt = <0xcaf12>;
		};
	};

	opp_table1 {
		compatible = "operating-points-v2";
		opp-shared;
		phandle = <0xa>;

		opp0 {
			opp-hz = <0x0 0x32a9f880>;
			opp-microvolt = <0xa4cb8>;
		};

		opp1 {
			opp-hz = <0x0 0x362e3d40>;
			opp-microvolt = <0xaae60>;
		};

		opp10 {
			opp-hz = <0x0 0x65ec8780>;
			opp-microvolt = <0xf4240>;
		};

		opp11 {
			opp-hz = <0x0 0x6b49d200>;
			opp-microvolt = <0xfbc52>;
		};

		opp12 {
			opp-hz = <0x0 0x6e44c280>;
			opp-microvolt = <0x100590>;
		};

		opp13 {
			opp-hz = <0x0 0x713fb300>;
			opp-microvolt = <0x103664>;
		};

		opp14 {
			opp-hz = <0x0 0x743aa380>;
			opp-microvolt = <0x106738>;
		};

		opp15 {
			opp-hz = <0x0 0x77359400>;
			opp-microvolt = <0x10980c>;
		};

		opp2 {
			opp-hz = <0x0 0x3b7c4580>;
			opp-microvolt = <0xb2872>;
		};

		opp3 {
			opp-hz = <0x0 0x40ca4dc0>;
			opp-microvolt = <0xbbaee>;
		};

		opp4 {
			opp-hz = <0x0 0x46185600>;
			opp-microvolt = <0xc3500>;
		};

		opp5 {
			opp-hz = <0x0 0x4d3021c0>;
			opp-microvolt = <0xcdfe6>;
		};

		opp6 {
			opp-hz = <0x0 0x50b46680>;
			opp-microvolt = <0xd418e>;
		};

		opp7 {
			opp-hz = <0x0 0x56026ec0>;
			opp-microvolt = <0xdbba0>;
		};

		opp8 {
			opp-hz = <0x0 0x5b507700>;
			opp-microvolt = <0xe35b2>;
		};

		opp9 {
			opp-hz = <0x0 0x609e7f40>;
			opp-microvolt = <0xec82e>;
		};
	};

	pd_adapter {
		adapter_name = "pd_adapter";
		compatible = "mediatek,pd_adapter";
		phandle = <0xf2>;
		status = "disabled";
	};

	pericfg@10003000 {
		#clock-cells = <0x1>;
		compatible = "mediatek,pericfg", "syscon";
		phandle = <0x43>;
		reg = <0x0 0x10003000 0x0 0x1000>;
	};

	pinctrl {
		#gpio-cells = <0x2>;
		#interrupt-cells = <0x4>;
		compatible = "mediatek,mt6768-pinctrl";
		gpio-controller;
		gpio-ranges = <0x20 0x0 0x0 0xba>;
		interrupt-controller;
		interrupts = <0x0 0xba 0x4>;
		phandle = <0x20>;
		pins-are-numbered;
		reg_base_eint = <0x1f>;
		reg_bases = <0x16 0x17 0x18 0x19 0x1a 0x1b 0x1c 0x1d 0x1e>;

		aud_clk_miso_off {
			phandle = <0x49>;

			pins_cmd0_dat {
				pinmux = <0x8c00 0x8d00>;
			};
		};

		aud_clk_miso_on {
			phandle = <0x4a>;

			pins_cmd0_dat {
				input-schmitt-enable;
				pinmux = <0x8c01>;
			};

			pins_cmd1_dat {
				input-schmitt-enable;
				pinmux = <0x8d01>;
			};
		};

		aud_clk_mosi_off {
			phandle = <0x47>;

			pins_cmd0_dat {
				pinmux = <0x8800 0x8900>;
			};
		};

		aud_clk_mosi_on {
			phandle = <0x48>;

			pins_cmd0_dat {
				input-schmitt-enable;
				pinmux = <0x8801>;
			};

			pins_cmd1_dat {
				input-schmitt-enable;
				pinmux = <0x8901>;
			};
		};

		aud_dat_miso_off {
			phandle = <0x4d>;

			pins_cmd0_dat {
				bias-disable;
				input-enable;
				pinmux = <0x8c00>;
				slew-rate = <0x0>;
			};

			pins_cmd1_dat {
				bias-disable;
				input-enable;
				pinmux = <0x8d00>;
				slew-rate = <0x0>;
			};

			pins_cmd2_dat {
				bias-disable;
				input-enable;
				pinmux = <0x8e00>;
				slew-rate = <0x0>;
			};

			pins_cmd3_dat {
				bias-disable;
				input-enable;
				pinmux = <0x8f00>;
				slew-rate = <0x0>;
			};
		};

		aud_dat_miso_on {
			phandle = <0x4e>;

			pins_cmd0_dat {
				input-schmitt-enable;
				pinmux = <0x8c01>;
			};

			pins_cmd1_dat {
				input-schmitt-enable;
				pinmux = <0x8d01>;
			};

			pins_cmd2_dat {
				input-schmitt-enable;
				pinmux = <0x8e01>;
			};

			pins_cmd3_dat {
				input-schmitt-enable;
				pinmux = <0x8f01>;
			};
		};

		aud_dat_mosi_off {
			phandle = <0x4b>;

			pins_cmd0_dat {
				bias-disable;
				input-enable;
				pinmux = <0x8800>;
				slew-rate = <0x0>;
			};

			pins_cmd1_dat {
				bias-disable;
				input-enable;
				pinmux = <0x8900>;
				slew-rate = <0x0>;
			};

			pins_cmd2_dat {
				bias-disable;
				input-enable;
				pinmux = <0x8a00>;
				slew-rate = <0x0>;
			};

			pins_cmd3_dat {
				bias-pull-down;
				input-enable;
				pinmux = <0x8b00>;
				slew-rate = <0x0>;
			};
		};

		aud_dat_mosi_on {
			phandle = <0x4c>;

			pins_cmd0_dat {
				input-schmitt-enable;
				pinmux = <0x8801>;
			};

			pins_cmd1_dat {
				input-schmitt-enable;
				pinmux = <0x8901>;
			};

			pins_cmd2_dat {
				input-schmitt-enable;
				pinmux = <0x8a01>;
			};

			pins_cmd3_dat {
				input-schmitt-enable;
				pinmux = <0x8b01>;
			};
		};

		aud_gpio_i2s0_off {
			phandle = <0x4f>;

			pins_cmd_dat {
				pinmux = <0x2800>;
			};
		};

		aud_gpio_i2s0_on {
			phandle = <0x50>;

			pins_cmd_dat {
				pinmux = <0x2802>;
			};
		};

		aud_gpio_i2s1_off {
			phandle = <0x51>;
		};

		aud_gpio_i2s1_on {
			phandle = <0x52>;
		};

		aud_gpio_i2s2_off {
			phandle = <0x53>;
		};

		aud_gpio_i2s2_on {
			phandle = <0x54>;
		};

		aud_gpio_i2s3_off {
			phandle = <0x55>;

			pins_cmd_dat {
				pinmux = <0x2500 0x2600 0x2400>;
			};
		};

		aud_gpio_i2s3_on {
			phandle = <0x56>;

			pins_cmd_dat {
				pinmux = <0x2502 0x2602 0x2402>;
			};
		};

		mmc0@0 {
			phandle = <0x3b>;

			pins_clk {
				drive-strength = <0x4>;
				pinmux = <0x7c01>;
			};

			pins_cmd_dat {
				drive-strength = <0x4>;
				input-enable;
				pinmux = <0x7b01 0x8001 0x7d01 0x8401 0x7e01 0x8101 0x7f01 0x8201 0x7a01>;
			};

			pins_ds {
				drive-strength = <0x4>;
				pinmux = <0x8301>;
			};

			pins_rst {
				drive-strength = <0x4>;
				pinmux = <0x8501>;
			};
		};

		mmc0default {
			phandle = <0x3a>;

			pins_clk {
				bias-pull-down = <0x66>;
				drive-strength = <0x4>;
				pinmux = <0x7c01>;
			};

			pins_cmd_dat {
				bias-pull-up = <0x65>;
				drive-strength = <0x4>;
				input-enable;
				pinmux = <0x7b01 0x8001 0x7d01 0x8401 0x7e01 0x8101 0x7f01 0x8201 0x7a01>;
			};

			pins_ds {
				bias-pull-down = <0x66>;
				drive-strength = <0x4>;
				pinmux = <0x8301>;
			};

			pins_rst {
				bias-pull-up = <0x65>;
				drive-strength = <0x4>;
				pinmux = <0x8501>;
			};
		};

		mmc1@0 {
			phandle = <0x3e>;

			pins_clk {
				drive-strength = <0x3>;
				pinmux = <0xab01>;
			};

			pins_cmd_dat {
				drive-strength = <0x3>;
				input-enable;
				pinmux = <0xa401 0xa301 0xa201 0xa101 0xaa01>;
			};
		};

		mmc1@1 {
			phandle = <0x3f>;

			pins_clk {
				bias-pull-down = <0x66>;
				drive-strength = <0x3>;
				pinmux = <0xab01>;
			};

			pins_cmd_dat {
				bias-pull-down = <0x66>;
				drive-strength = <0x3>;
				input-enable;
				pinmux = <0xa401 0xa301 0xa201 0xa101 0xaa01>;
			};
		};

		mmc1default {
			phandle = <0x3d>;

			pins_clk {
				bias-pull-down = <0x66>;
				drive-strength = <0x3>;
				pinmux = <0xab01>;
			};

			pins_cmd_dat {
				bias-pull-up = <0x65>;
				drive-strength = <0x3>;
				input-enable;
				pinmux = <0xa401 0xa301 0xa201 0xa101 0xaa01>;
			};

			pins_insert {
				bias-pull-up;
				pinmux = <0x3900>;
			};
		};

		vow_clk_miso_off {
			phandle = <0x59>;

			pins_cmd3_dat {
				pinmux = <0x8f00>;
			};
		};

		vow_clk_miso_on {
			phandle = <0x5a>;

			pins_cmd3_dat {
				pinmux = <0x8f04>;
			};
		};

		vow_dat_miso_off {
			phandle = <0x57>;

			pins_cmd1_dat {
				pinmux = <0x8e00>;
			};
		};

		vow_dat_miso_on {
			phandle = <0x58>;

			pins_cmd1_dat {
				pinmux = <0x8e04>;
			};
		};
	};

	pmic_clock_buffer_ctrl {
		compatible = "mediatek,pmic_clock_buffer";
		mediatek,clkbuf-config = <0x2 0x1 0x1 0x2 0x0 0x0 0x0>;
		mediatek,clkbuf-driving-current = <0x1 0x1 0x1 0x1 0x1 0x1 0x1>;
		mediatek,clkbuf-quantity = <0x7>;
		phandle = <0xf8>;
	};

	pmu {
		compatible = "arm,armv8-pmuv3";
		interrupt-parent = <0x13>;
		interrupts = <0x1 0x7 0x8>;
	};

	psci {
		compatible = "arm,psci-1.0";
		method = "smc";
	};

	pwm@11006000 {
		clock-names = "PWM1-main", "PWM2-main", "PWM3-main", "PWM4-main", "PWM5-main", "PWM6-main", "PWM-HCLK-main", "PWM-main";
		clocks = <0x26 0x10 0x26 0x11 0x26 0x12 0x26 0x13 0x26 0x14 0x26 0x30 0x26 0xf 0x26 0x15>;
		compatible = "mediatek,pwm";
		interrupts = <0x0 0x62 0x8>;
		reg = <0x0 0x11006000 0x0 0x1000>;
	};

	pwrap@1000d000 {
		clock-names = "spi", "wrap";
		clocks = <0x15 0x15>;
		compatible = "mediatek,mt6768-pwrap";
		interrupts = <0x0 0xc2 0x4>;
		phandle = <0x23>;
		reg = <0x0 0x1000d000 0x0 0x1000>;
		reg-names = "pwrap";

		mt6358-pmic {
			#interrupt-cells = <0x2>;
			compatible = "mediatek,mt6358-pmic";
			interrupt-controller;
			interrupt-names = "vproc11_oc", "vproc12_oc", "vcore_oc", "vgpu_oc", "vmodem_oc", "vdram1_oc", "vs1_oc", "vs2_oc", "vpa_oc", "vcore_preoc", "vfe28_oc", "vxo22_oc", "vrf18_oc", "vrf12_oc", "vefuse_oc", "vcn33_oc", "vcn28_oc", "vcn18_oc", "vcama1_oc", "vcama2_oc", "vcamd_oc", "vcamio_oc", "vldo28_oc", "va12_oc", "vaux18_oc", "vaud28_oc", "vio28_oc", "vio18_oc", "vsram_proc11_oc", "vsram_proc12_oc", "vsram_others_oc", "vsram_gpu_oc", "vdram2_oc", "vmc_oc", "vmch_oc", "vemc_oc", "vsim1_oc", "vsim2_oc", "vibr_oc", "vusb_oc", "vbif28_oc", "pwrkey", "homekey", "pwrkey_r", "homekey_r", "ni_lbat_int", "chrdet", "chrdet_edge", "vcdt_hv_det", "rtc", "fg_bat0_h", "fg_bat0_l", "fg_cur_h", "fg_cur_l", "fg_zcv", "fg_bat1_h", "fg_bat1_l", "fg_n_charge_l", "fg_iavg_h", "fg_iavg_l", "fg_time_h", "fg_discharge", "fg_charge", "baton_lv", "baton_ht", "baton_bat_in", "baton_bat_out", "bif", "bat_h", "bat_l", "bat2_h", "bat2_l", "bat_temp_h", "bat_temp_l", "auxadc_imp", "nag_c_dltv", "audio", "accdet", "accdet_eint0", "accdet_eint1", "spi_cmd_alert";
			interrupt-parent = <0x20>;
			interrupts = <0x90 0x4 0x90 0x0>;
			mediatek,num-pmic-irqs = <0x91>;
			mediatek,pmic-irqs = <0x0 0x0 0x1 0x0 0x2 0x0 0x3 0x0 0x4 0x0 0x5 0x0 0x6 0x0 0x7 0x0 0x8 0x0 0x9 0x0 0x10 0x1 0x11 0x1 0x12 0x1 0x13 0x1 0x14 0x1 0x15 0x1 0x16 0x1 0x17 0x1 0x18 0x1 0x19 0x1 0x1a 0x1 0x1b 0x1 0x1c 0x1 0x1d 0x1 0x1e 0x1 0x1f 0x1 0x20 0x1 0x21 0x1 0x22 0x1 0x23 0x1 0x24 0x1 0x25 0x1 0x26 0x1 0x27 0x1 0x28 0x1 0x29 0x1 0x2a 0x1 0x2b 0x1 0x2c 0x1 0x2d 0x1 0x2e 0x1 0x30 0x2 0x31 0x2 0x32 0x2 0x33 0x2 0x34 0x2 0x35 0x2 0x36 0x2 0x37 0x2 0x40 0x3 0x50 0x4 0x51 0x4 0x52 0x4 0x53 0x4 0x54 0x4 0x55 0x4 0x56 0x4 0x57 0x4 0x58 0x4 0x59 0x4 0x5a 0x4 0x5b 0x4 0x5c 0x4 0x60 0x4 0x61 0x4 0x62 0x4 0x63 0x4 0x64 0x4 0x70 0x5 0x71 0x5 0x72 0x5 0x73 0x5 0x74 0x5 0x75 0x5 0x76 0x5 0x77 0x5 0x80 0x6 0x85 0x6 0x86 0x6 0x87 0x6 0x90 0x7>;
			phandle = <0x7e>;
			status = "okay";

			mt-pmic {
				compatible = "mediatek,mt-pmic";
				interrupt-names = "pwrkey", "pwrkey_r", "homekey", "homekey_r", "bat_h", "bat_l", "fg_cur_h", "fg_cur_l";
				interrupts = <0x30 0x4 0x32 0x4 0x31 0x4 0x33 0x4 0x70 0x4 0x71 0x4 0x52 0x4 0x53 0x4>;
				phandle = <0x7f>;
			};

			mt6358_misc {
				apply-lpsd-solution;
				base = <0x580>;
				compatible = "mediatek,mt6358-misc";
				dcxo-switch;
				phandle = <0xaa>;
			};

			mt6358_rtc {
				apply-lpsd-solution;
				base = <0x580>;
				bootmode = <0x22>;
				compatible = "mediatek,mt6358-rtc";
				interrupt-names = "rtc";
				interrupts = <0x40 0x0>;
				phandle = <0xa9>;
			};

			mt6358regulator {
				compatible = "mediatek,mt6358-regulator";
				phandle = <0x81>;

				VMCH_EINT_HIGH {
					phandle = <0xa8>;
					regulator-enable-ramp-delay = <0x3c>;
					regulator-max-microvolt = <0x325aa0>;
					regulator-min-microvolt = <0x2c4020>;
					regulator-name = "mt6358_vmch_eint_high";
				};

				VMCH_EINT_LOW {
					phandle = <0x40>;
					regulator-enable-ramp-delay = <0x3c>;
					regulator-max-microvolt = <0x325aa0>;
					regulator-min-microvolt = <0x2c4020>;
					regulator-name = "mt6358_vmch_eint_low";
				};

				buck_vcore {
					phandle = <0x29>;
					regulator-enable-ramp-delay = <0xc8>;
					regulator-max-microvolt = <0x13bdb6>;
					regulator-min-microvolt = <0x7a120>;
					regulator-name = "vcore";
				};

				buck_vdram1 {
					phandle = <0x82>;
					regulator-enable-ramp-delay = <0x0>;
					regulator-max-microvolt = <0x1fda4c>;
					regulator-min-microvolt = <0x7a120>;
					regulator-name = "vdram1";
				};

				buck_vgpu {
					phandle = <0x86>;
					regulator-enable-ramp-delay = <0xc8>;
					regulator-max-microvolt = <0x13bdb6>;
					regulator-min-microvolt = <0x7a120>;
					regulator-name = "vgpu";
				};

				buck_vmodem {
					phandle = <0x28>;
					regulator-enable-ramp-delay = <0x384>;
					regulator-max-microvolt = <0x13bdb6>;
					regulator-min-microvolt = <0x7a120>;
					regulator-name = "vmodem";
				};

				buck_vpa {
					phandle = <0x83>;
					regulator-enable-ramp-delay = <0xfa>;
					regulator-max-microvolt = <0x37b1d0>;
					regulator-min-microvolt = <0x7a120>;
					regulator-name = "vpa";
				};

				buck_vproc11 {
					phandle = <0x84>;
					regulator-enable-ramp-delay = <0xc8>;
					regulator-max-microvolt = <0x13bdb6>;
					regulator-min-microvolt = <0x7a120>;
					regulator-name = "vproc11";
				};

				buck_vproc12 {
					phandle = <0x85>;
					regulator-enable-ramp-delay = <0xc8>;
					regulator-max-microvolt = <0x13bdb6>;
					regulator-min-microvolt = <0x7a120>;
					regulator-name = "vproc12";
				};

				buck_vs1 {
					phandle = <0x88>;
					regulator-enable-ramp-delay = <0x0>;
					regulator-max-microvolt = <0x277b6c>;
					regulator-min-microvolt = <0xf4240>;
					regulator-name = "vs1";
				};

				buck_vs2 {
					phandle = <0x87>;
					regulator-enable-ramp-delay = <0x0>;
					regulator-max-microvolt = <0x1fda4c>;
					regulator-min-microvolt = <0x7a120>;
					regulator-name = "vs2";
				};

				ldo_va09 {
					phandle = <0xa7>;
					regulator-boot-on;
					regulator-enable-ramp-delay = <0x108>;
					regulator-max-microvolt = <0xdbba0>;
					regulator-min-microvolt = <0xdbba0>;
					regulator-name = "va09";
				};

				ldo_va12 {
					phandle = <0x9f>;
					regulator-enable-ramp-delay = <0x10e>;
					regulator-max-microvolt = <0x124f80>;
					regulator-min-microvolt = <0x124f80>;
					regulator-name = "va12";
				};

				ldo_vaud28 {
					phandle = <0xa5>;
					regulator-enable-ramp-delay = <0x10e>;
					regulator-max-microvolt = <0x2ab980>;
					regulator-min-microvolt = <0x2ab980>;
					regulator-name = "vaud28";
				};

				ldo_vaux18 {
					phandle = <0x99>;
					regulator-enable-ramp-delay = <0x10e>;
					regulator-max-microvolt = <0x1b7740>;
					regulator-min-microvolt = <0x1b7740>;
					regulator-name = "vaux18";
				};

				ldo_vbif28 {
					phandle = <0x9b>;
					regulator-enable-ramp-delay = <0x10e>;
					regulator-max-microvolt = <0x2ab980>;
					regulator-min-microvolt = <0x2ab980>;
					regulator-name = "vbif28";
				};

				ldo_vcama1 {
					phandle = <0x9d>;
					regulator-enable-ramp-delay = <0x10e>;
					regulator-max-microvolt = <0x2dc6c0>;
					regulator-min-microvolt = <0x1b7740>;
					regulator-name = "vcama1";
				};

				ldo_vcama2 {
					phandle = <0xa3>;
					regulator-enable-ramp-delay = <0x10e>;
					regulator-max-microvolt = <0x2dc6c0>;
					regulator-min-microvolt = <0x1b7740>;
					regulator-name = "vcama2";
				};

				ldo_vcamd {
					phandle = <0x90>;
					regulator-enable-ramp-delay = <0x10e>;
					regulator-max-microvolt = <0x1b7740>;
					regulator-min-microvolt = <0xdbba0>;
					regulator-name = "vcamd";
				};

				ldo_vcamio {
					phandle = <0x8f>;
					regulator-enable-ramp-delay = <0x10e>;
					regulator-max-microvolt = <0x1b7740>;
					regulator-min-microvolt = <0x1b7740>;
					regulator-name = "vcamio";
				};

				ldo_vcn18 {
					phandle = <0x91>;
					regulator-enable-ramp-delay = <0x10e>;
					regulator-max-microvolt = <0x1b7740>;
					regulator-min-microvolt = <0x1b7740>;
					regulator-name = "vcn18";
				};

				ldo_vcn28 {
					phandle = <0x94>;
					regulator-enable-ramp-delay = <0x10e>;
					regulator-max-microvolt = <0x2ab980>;
					regulator-min-microvolt = <0x2ab980>;
					regulator-name = "vcn28";
				};

				ldo_vcn33_bt {
					phandle = <0xa1>;
					regulator-enable-ramp-delay = <0x10e>;
					regulator-max-microvolt = <0x3567e0>;
					regulator-min-microvolt = <0x325aa0>;
					regulator-name = "vcn33_bt";
				};

				ldo_vcn33_wifi {
					phandle = <0xa2>;
					regulator-enable-ramp-delay = <0x10e>;
					regulator-max-microvolt = <0x3567e0>;
					regulator-min-microvolt = <0x325aa0>;
					regulator-name = "vcn33_wifi";
				};

				ldo_vdram2 {
					phandle = <0x89>;
					regulator-enable-ramp-delay = <0xce4>;
					regulator-max-microvolt = <0x1b7740>;
					regulator-min-microvolt = <0x927c0>;
					regulator-name = "vdram2";
				};

				ldo_vefuse {
					phandle = <0x98>;
					regulator-enable-ramp-delay = <0x10e>;
					regulator-max-microvolt = <0x1cfde0>;
					regulator-min-microvolt = <0x19f0a0>;
					regulator-name = "vefuse";
				};

				ldo_vemc {
					phandle = <0x3c>;
					regulator-enable-ramp-delay = <0x3c>;
					regulator-max-microvolt = <0x325aa0>;
					regulator-min-microvolt = <0x2c4020>;
					regulator-name = "vemc";
				};

				ldo_vfe28 {
					phandle = <0x92>;
					regulator-enable-ramp-delay = <0x10e>;
					regulator-max-microvolt = <0x2ab980>;
					regulator-min-microvolt = <0x2ab980>;
					regulator-name = "vfe28";
				};

				ldo_vibr {
					phandle = <0x8b>;
					regulator-enable-ramp-delay = <0x3c>;
					regulator-max-microvolt = <0x325aa0>;
					regulator-min-microvolt = <0x124f80>;
					regulator-name = "vibr";
				};

				ldo_vio18 {
					phandle = <0x8d>;
					regulator-always-on;
					regulator-enable-ramp-delay = <0xa8c>;
					regulator-max-microvolt = <0x1b7740>;
					regulator-min-microvolt = <0x1b7740>;
					regulator-name = "vio18";
				};

				ldo_vio28 {
					phandle = <0x9e>;
					regulator-always-on;
					regulator-enable-ramp-delay = <0x10e>;
					regulator-max-microvolt = <0x2ab980>;
					regulator-min-microvolt = <0x2ab980>;
					regulator-name = "vio28";
				};

				ldo_vldo28 {
					phandle = <0xa4>;
					regulator-enable-ramp-delay = <0x10e>;
					regulator-max-microvolt = <0x2dc6c0>;
					regulator-min-microvolt = <0x2ab980>;
					regulator-name = "vldo28";
				};

				ldo_vmc {
					phandle = <0x41>;
					regulator-enable-ramp-delay = <0x3c>;
					regulator-max-microvolt = <0x325aa0>;
					regulator-min-microvolt = <0x1b7740>;
					regulator-name = "vmc";
				};

				ldo_vmch {
					phandle = <0x9a>;
					regulator-enable-ramp-delay = <0x3c>;
					regulator-max-microvolt = <0x325aa0>;
					regulator-min-microvolt = <0x2c4020>;
					regulator-name = "vmch";
				};

				ldo_vrf12 {
					phandle = <0x8c>;
					regulator-enable-ramp-delay = <0x78>;
					regulator-max-microvolt = <0x124f80>;
					regulator-min-microvolt = <0x124f80>;
					regulator-name = "vrf12";
				};

				ldo_vrf18 {
					phandle = <0xa0>;
					regulator-enable-ramp-delay = <0x78>;
					regulator-max-microvolt = <0x1b7740>;
					regulator-min-microvolt = <0x1b7740>;
					regulator-name = "vrf18";
				};

				ldo_vsim1 {
					phandle = <0x8a>;
					regulator-enable-ramp-delay = <0x21c>;
					regulator-max-microvolt = <0x2f4d60>;
					regulator-min-microvolt = <0x19f0a0>;
					regulator-name = "vsim1";
				};

				ldo_vsim2 {
					phandle = <0xa6>;
					regulator-enable-ramp-delay = <0x21c>;
					regulator-max-microvolt = <0x2f4d60>;
					regulator-min-microvolt = <0x19f0a0>;
					regulator-name = "vsim2";
				};

				ldo_vsram_gpu {
					phandle = <0x96>;
					regulator-enable-ramp-delay = <0xf0>;
					regulator-max-microvolt = <0x13bdb6>;
					regulator-min-microvolt = <0x7a120>;
					regulator-name = "vsram_gpu";
				};

				ldo_vsram_others {
					phandle = <0x95>;
					regulator-enable-ramp-delay = <0xf0>;
					regulator-max-microvolt = <0x13bdb6>;
					regulator-min-microvolt = <0x7a120>;
					regulator-name = "vsram_others";
				};

				ldo_vsram_proc11 {
					phandle = <0x93>;
					regulator-enable-ramp-delay = <0xf0>;
					regulator-max-microvolt = <0x13bdb6>;
					regulator-min-microvolt = <0x7a120>;
					regulator-name = "vsram_proc11";
				};

				ldo_vsram_proc12 {
					phandle = <0x9c>;
					regulator-enable-ramp-delay = <0xf0>;
					regulator-max-microvolt = <0x13bdb6>;
					regulator-min-microvolt = <0x7a120>;
					regulator-name = "vsram_proc12";
				};

				ldo_vusb {
					phandle = <0x8e>;
					regulator-enable-ramp-delay = <0x10e>;
					regulator-max-microvolt = <0x2f4d60>;
					regulator-min-microvolt = <0x2dc6c0>;
					regulator-name = "vusb";
				};

				ldo_vxo22 {
					phandle = <0x97>;
					regulator-enable-ramp-delay = <0x78>;
					regulator-max-microvolt = <0x2191c0>;
					regulator-min-microvolt = <0x2191c0>;
					regulator-name = "vxo22";
				};
			};

			mt635x-auxadc {
				#io-channel-cells = <0x1>;
				compatible = "mediatek,mt6358-auxadc";
				phandle = <0x21>;

				accdet {
					channel = <0x9>;
				};

				bat_temp {
					channel = <0x3>;
					resistance-ratio = <0x2 0x1>;
				};

				batadc {
					avg-num = <0x80>;
					channel = <0x0>;
					resistance-ratio = <0x3 0x1>;
				};

				chip_temp {
					channel = <0x5>;
				};

				dcxo_temp {
					avg-num = <0x10>;
					channel = <0xd>;
				};

				dcxo_volt {
					channel = <0xa>;
					resistance-ratio = <0x3 0x2>;
				};

				hpofs_cal {
					avg-num = <0x100>;
					channel = <0xc>;
				};

				tsx_temp {
					avg-num = <0x80>;
					channel = <0xb>;
				};

				vbif {
					channel = <0xe>;
					resistance-ratio = <0x2 0x1>;
				};

				vcdt {
					channel = <0x2>;
				};

				vcore_temp {
					channel = <0x6>;
				};

				vgpu_temp {
					channel = <0x8>;
				};

				vproc_temp {
					channel = <0x7>;
				};
			};

			mtk_ts_pmic {
				#interconnect-cells = <0x1>;
				compatible = "mediatek,mtk_ts_pmic";
				interconnects = <0x21 0x1>;
				io-channel-names = "pmic_chip_temp", "pmic_buck1_temp", "pmic_buck2_temp";
				io-channels = <0x21 0x5 0x21 0x6 0x21 0x7>;
				phandle = <0x80>;
			};
		};
	};

	pwrap_md32@10448000 {
		compatible = "mediatek,pwrap_md32";
		reg = <0x0 0x10448000 0x0 0x1000>;
	};

	pwrap_mpu@1000d000 {
		compatible = "mediatek,pwrap_mpu";
		reg = <0x0 0x1000d000 0x0 0x1000>;
	};

	pwrap_p2p@1005cb000 {
		compatible = "mediatek,pwrap_p2p";
		reg = <0x0 0x105cb000 0x0 0x1000>;
	};

	pwraphal@ {
		compatible = "mediatek,pwraph";
		mediatek,pwrap-regmap = <0x23>;
		phandle = <0xab>;
	};

	radio_md_cfg {
		compatible = "mediatek,radio_md_cfg";
		phandle = <0xed>;
	};

	reserve@16030000 {
		compatible = "mediatek,reserve";
		reg = <0x0 0x16030000 0x0 0x10000>;
	};

	reserved-memory {
		#address-cells = <0x2>;
		#size-cells = <0x2>;
		phandle = <0x76>;
		ranges;

		consys-reserve-memory {
			alignment = <0x0 0x1000000>;
			alloc-ranges = <0x0 0x40000000 0x0 0x80000000>;
			compatible = "mediatek,consys-reserve-memory";
			no-map;
			phandle = <0x42>;
			size = <0x0 0x400000>;
		};

		ion-carveout-heap {
			alignment = <0x0 0x1000>;
			alloc-ranges = <0x0 0xc0000000 0x4 0x0>;
			compatible = "mediatek,ion-carveout-heap";
			no-map;
			size = <0x0 0x9000>;
		};

		reserve-memory-scp_share {
			alignment = <0x0 0x1000000>;
			alloc-ranges = <0x0 0x40000000 0x0 0x50000000>;
			compatible = "mediatek,reserve-memory-scp_share";
			no-map;
			size = <0x0 0x300000>;
		};

		reserve-memory-sspm_share {
			alignment = <0x0 0x10000>;
			alloc-ranges = <0x0 0x40000000 0x0 0x60000000>;
			compatible = "mediatek,reserve-memory-sspm_share";
			no-map;
			size = <0x0 0x510000>;
			status = "okay";
		};

		ssmr-reserved-cma_memory {
			alignment = <0x0 0x1000000>;
			alloc-range = <0x0 0xc0000000 0x0 0x10000000>;
			compatible = "shared-dma-pool";
			phandle = <0x71>;
			reusable;
			size = <0x0 0x10000000>;
		};

		wifi-reserve-memory {
			alignment = <0x0 0x1000000>;
			alloc-ranges = <0x0 0x40000000 0x0 0x80000000>;
			compatible = "shared-dma-pool";
			no-map;
			phandle = <0x6a>;
			size = <0x0 0x300000>;
		};
	};

	rt-pd-manager {
		compatible = "mediatek,rt-pd-manager";
	};

	rt1711_type_c_port0 {
		phandle = <0x104>;
		rt-tcpc,name = "type_c_port0";
		rt-tcpc,notifier_supply_num = <0x3>;
		rt-tcpc,role_def = <0x5>;
		rt-tcpc,rp_level = <0x0>;
		rt-tcpc,vconn_supply = <0x1>;
		rt1711pd,intr_gpio = <0x20 0x29 0x0>;
		rt1711pd,intr_gpio_num = <0x29>;

		displayport {
			1st_connection = "dfp_d";
			2nd_connection = "dfp_d";
			signal,dp_v13;
			typec,receptacle;

			dfp_d {
				pin_assignment,mode_c;
				pin_assignment,mode_d;
				pin_assignment,mode_e;
			};

			ufp_d {
			};
		};

		dpm_caps {
			attemp_discover_cable;
			attemp_discover_id;
			attemp_enter_dp_mode;
			dr_check = <0x0>;
			local_dr_data;
			local_dr_power;
			local_no_suspend;
			local_usb_comm;
			local_vconn_supply;
			pr_check = <0x0>;
		};

		pd-data {
			bat,nr = <0x1>;
			pd,charging_policy = <0x31>;
			pd,country_nr = <0x0>;
			pd,id-vdo-data = <0xd14029cf 0x0 0x17110000 0x41800000 0x0 0x21800000>;
			pd,id-vdo-size = <0x6>;
			pd,mfrs = "RichtekTCPC";
			pd,pid = <0x1711>;
			pd,sink-pdo-data = <0x190c8>;
			pd,sink-pdo-size = <0x1>;
			pd,source-cap-ext = <0x171129cf 0x0 0x0 0x0 0x0 0x2000000>;
			pd,source-pdo-data = <0x19032>;
			pd,source-pdo-size = <0x1>;
			pd,vid = <0x29cf>;

			bat-info0 {
				bat,design_cap = <0xbb8>;
				bat,mfrs = "bat1";
				bat,pid = <0x1711>;
				bat,vid = <0x29cf>;
			};
		};
	};

	rt9465_slave_chr {
		compatible = "richtek,rt9465";
		phandle = <0xf4>;
	};

	scp@10500000 {
		compatible = "mediatek,scp";
		core_1 = "enable";
		interrupts = <0x0 0xcd 0x4>;
		reg = <0x0 0x10500000 0x0 0x80000 0x0 0x105c0000 0x0 0x3000 0x0 0x105c4000 0x0 0x1000 0x0 0x105d4000 0x0 0x6000>;
		scp_feature_tbl = <0x0 0x5 0x1 0x164 0x2 0x3e 0x3 0x2f 0x4 0x1a 0x5 0x0 0x6 0x6e 0x7 0x0 0x8 0x8d 0x9 0xa 0xa 0x2b 0xb 0x2b 0xc 0x16>;
		scp_mem_key = "mediatek,reserve-memory-scp_share";
		scp_mem_tbl = <0x1 0x100000 0x3 0x1000 0x4 0x180000>;
		scp_mpuRegionId = <0x1c>;
		scp_sramSize = <0x80000>;
		status = "okay";
	};

	scp_dvfs {
		clock-names = "clk_mux", "clk_pll_0", "clk_pll_1", "clk_pll_2", "clk_pll_3", "clk_pll_4", "clk_pll_5", "clk_pll_6";
		clocks = <0x14 0x53 0x15 0x14 0xe 0x14 0x1a 0x14 0x2 0x14 0x17 0x14 0x6 0x14 0x19>;
		compatible = "mediatek,scp_dvfs";
		dvfs-opp = <0x9eb10 0xdbba0 0xff 0x0 0x0 0xa5 0x1 0x9eb10 0xdbba0 0xff 0x0 0x0 0xfa 0x2 0xaae60 0xdbba0 0xff 0x2 0x8 0x14a 0x4 0xc3500 0xdbba0 0xff 0x3 0xc 0x1a0 0x6>;
		dvfsrc-opp-num = <0x3>;
		gpio = <0x16 0x1>;
		gpio-feature = "gpio-mode";
		gpio-feature-cfg = <0x1>;
		gpio-mode-reg = <0x430 0x7 0x8 0x1>;
	};

	scp_infra@10001000 {
		compatible = "mediatek,scpinfra";
		phandle = <0xbc>;
		reg = <0x0 0x10001000 0x0 0x1000>;
	};

	scpsys@10001000 {
		#clock-cells = <0x1>;
		compatible = "mediatek,scpsys", "syscon";
		phandle = <0x27>;
		reg = <0x0 0x10001000 0x0 0x1000 0x0 0x10006000 0x0 0x1000 0x0 0x14002000 0x0 0x1000 0x0 0x1020e000 0x0 0x1000 0x0 0x18004000 0x0 0x1000 0x0 0x18002000 0x0 0x1000 0x0 0x10000000 0x0 0x1000 0x0 0x16000000 0x0 0x1000 0x0 0x16025000 0x0 0x1000>;
	};

	security_ao@1001a000 {
		compatible = "mediatek,security_ao";
		reg = <0x0 0x1001a000 0x0 0x1000>;
	};

	seninf1@1a040000 {
		compatible = "mediatek,seninf1";
		reg = <0x0 0x1a040000 0x0 0x1000>;
	};

	seninf2@1a041000 {
		compatible = "mediatek,seninf2";
		reg = <0x0 0x1a041000 0x0 0x1000>;
	};

	seninf3@1a042000 {
		compatible = "mediatek,seninf3";
		reg = <0x0 0x1a042000 0x0 0x1000>;
	};

	seninf4@1a043000 {
		compatible = "mediatek,seninf4";
		reg = <0x0 0x1a043000 0x0 0x1000>;
	};

	serial@11002000 {
		clock-names = "baud", "bus";
		clocks = <0x15 0x26 0x16>;
		compatible = "mediatek,mt6577-uart";
		dma-names = "tx", "rx";
		dmas = <0x39 0x0 0x39 0x1>;
		interrupts = <0x0 0x70 0x8>;
		phandle = <0xbe>;
		reg = <0x0 0x11002000 0x0 0x1000>;
	};

	serial@11003000 {
		clock-names = "baud", "bus";
		clocks = <0x15 0x26 0x17>;
		compatible = "mediatek,mt6577-uart";
		dma-names = "tx", "rx";
		dmas = <0x39 0x2 0x39 0x3>;
		interrupts = <0x0 0x71 0x8>;
		phandle = <0xbf>;
		reg = <0x0 0x11003000 0x0 0x1000>;
	};

	sleep@10006000 {
		compatible = "mediatek,sleep";
		interrupts = <0x0 0xc3 0x8>;
		phandle = <0x7a>;
		reg = <0x0 0x10006000 0x0 0x1000>;
	};

	sleep_reg_md@1000f000 {
		compatible = "mediatek,sleep_reg_md";
		reg = <0x0 0x1000f000 0x0 0x1000>;
	};

	smart_pa {
		phandle = <0xfd>;
	};

	smi_common@14002000 {
		clock-names = "scp-dis", "mm-comm0", "mm-comm1", "mm-common";
		clocks = <0x27 0x3 0x2b 0x15 0x2b 0x16 0x2b 0x13>;
		compatible = "mediatek,smi_common";
		mediatek,smi-id = <0x5>;
		mmsys_config = <0x2b>;
		reg = <0x0 0x14002000 0x0 0x1000>;
	};

	smi_larb0@14003000 {
		clock-names = "scp-dis", "mm-larb0";
		clocks = <0x27 0x3 0x2b 0x14>;
		compatible = "mediatek,smi_larb0", "mediatek,smi_larb";
		mediatek,smi-id = <0x0>;
		phandle = <0x63>;
		reg = <0x0 0x14003000 0x0 0x1000>;
	};

	smi_larb1@16010000 {
		clock-names = "scp-vdec", "mm-vdec", "vdec-larb1";
		clocks = <0x27 0xc 0x2b 0x1b 0x67 0x3>;
		compatible = "mediatek,smi_larb1", "mediatek,smi_larb";
		interrupts = <0x0 0xf7 0x8>;
		mediatek,smi-id = <0x1>;
		phandle = <0x65>;
		reg = <0x0 0x16010000 0x0 0x1000>;
	};

	smi_larb2@15021000 {
		clock-names = "scp-isp", "mm-img", "img-larb2";
		clocks = <0x27 0x5 0x2b 0x18 0x25 0x0>;
		compatible = "mediatek,smi_larb2", "mediatek,smi_larb";
		mediatek,smi-id = <0x2>;
		phandle = <0xe1>;
		reg = <0x0 0x15021000 0x0 0x1000>;
	};

	smi_larb3@1a002000 {
		clock-names = "scp-cam", "mm-cam", "cam-larb3";
		clocks = <0x27 0xa 0x2b 0x19 0x64 0x0>;
		compatible = "mediatek,smi_larb3", "mediatek,smi_larb";
		mediatek,smi-id = <0x3>;
		phandle = <0xe6>;
		reg = <0x0 0x1a002000 0x0 0x1000>;
	};

	smi_larb4@17010000 {
		clock-names = "scp-venc", "mm-venc", "venc-venc", "venc-jpgenc";
		clocks = <0x27 0xb 0x2b 0x1a 0x69 0x1 0x69 0x2>;
		compatible = "mediatek,smi_larb4", "mediatek,smi_larb";
		mediatek,smi-id = <0x4>;
		phandle = <0x68>;
		reg = <0x0 0x17010000 0x0 0x1000>;
	};

	snd_scp_spk {
		compatible = "mediatek,snd_scp_spk";
		phandle = <0xdd>;
	};

	sound {
		compatible = "mediatek,mt6768-mt6358-sound";
		mediatek,audio-codec = <0x5b>;
		mediatek,platform = <0x5c>;
		mtk_spk_i2s_in = <0x2>;
		mtk_spk_i2s_out = <0x1>;
		phandle = <0xdc>;

		mediatek,speaker-codec {
			sound-dai = <0x5d 0x5e>;
		};
	};

	spi0@1100a000 {
		clock-names = "parent-clk", "sel-clk", "spi-clk";
		clocks = <0x14 0xb 0x14 0x5b 0x26 0x1b>;
		compatible = "mediatek,mt6765-spi";
		interrupts = <0x0 0x8a 0x8>;
		mediatek,pad-select = <0x0>;
		phandle = <0xca>;
		reg = <0x0 0x1100a000 0x0 0x1000>;
	};

	spi1@11010000 {
		clock-names = "parent-clk", "sel-clk", "spi-clk";
		clocks = <0x14 0xb 0x14 0x5b 0x26 0x34>;
		compatible = "mediatek,mt6765-spi";
		interrupts = <0x0 0x8b 0x8>;
		mediatek,pad-select = <0x0>;
		phandle = <0xd4>;
		reg = <0x0 0x11010000 0x0 0x1000>;
	};

	spi2@11012000 {
		clock-names = "parent-clk", "sel-clk", "spi-clk";
		clocks = <0x14 0xb 0x14 0x5b 0x26 0x37>;
		compatible = "mediatek,mt6765-spi";
		interrupts = <0x0 0x91 0x8>;
		mediatek,pad-select = <0x0>;
		phandle = <0xd5>;
		reg = <0x0 0x11012000 0x0 0x1000>;
	};

	spi3@11013000 {
		clock-names = "parent-clk", "sel-clk", "spi-clk";
		clocks = <0x14 0xb 0x14 0x5b 0x26 0x38>;
		compatible = "mediatek,mt6765-spi";
		interrupts = <0x0 0x92 0x8>;
		mediatek,pad-select = <0x0>;
		phandle = <0xd6>;
		reg = <0x0 0x11013000 0x0 0x1000>;
	};

	spi4@11014000 {
		clock-names = "parent-clk", "sel-clk", "spi-clk";
		clocks = <0x14 0xb 0x14 0x5b 0x26 0x41>;
		compatible = "mediatek,mt6765-spi";
		interrupts = <0x0 0x74 0x8>;
		mediatek,pad-select = <0x0>;
		phandle = <0xd7>;
		reg = <0x0 0x11014000 0x0 0x1000>;
	};

	spi5@11015000 {
		clock-names = "parent-clk", "sel-clk", "spi-clk";
		clocks = <0x14 0xb 0x14 0x5b 0x26 0x42>;
		compatible = "mediatek,mt6765-spi";
		interrupts = <0x0 0x75 0x8>;
		mediatek,pad-select = <0x0>;
		phandle = <0xd8>;
		reg = <0x0 0x11015000 0x0 0x1000>;
	};

	sramrom@10214000 {
		compatible = "mediatek,sramrom";
		reg = <0x0 0x10214000 0x0 0x1000>;
	};

	ssmr {
		compatible = "mediatek,trusted_mem";
		memory-region = <0x71>;
	};

	sspm@10440000 {
		compatible = "mediatek,sspm";
		interrupt-names = "ipc", "mbox0", "mbox1", "mbox2", "mbox3", "mbox4";
		interrupts = <0x0 0xd7 0x4 0x0 0xda 0x4 0x0 0xdb 0x4 0x0 0xdc 0x4 0x0 0xdd 0x4 0x0 0xde 0x4>;
		reg = <0x0 0x10400000 0x0 0x28000 0x0 0x10440000 0x0 0x10000 0x0 0x10450000 0x0 0x100 0x0 0x10451000 0x0 0x8 0x0 0x10460000 0x0 0x100 0x0 0x10461000 0x0 0x8 0x0 0x10470000 0x0 0x100 0x0 0x10471000 0x0 0x8 0x0 0x10480000 0x0 0x100 0x0 0x10481000 0x0 0x8 0x0 0x10490000 0x0 0x100 0x0 0x10491000 0x0 0x8>;
		reg-names = "sspm_base", "cfgreg", "mbox0_base", "mbox0_ctrl", "mbox1_base", "mbox1_ctrl", "mbox2_base", "mbox2_ctrl", "mbox3_base", "mbox3_ctrl", "mbox4_base", "mbox4_ctrl";
		sspm_mem_key = "mediatek,reserve-memory-sspm_share";
		sspm_mem_tbl = <0x0 0x100100 0x1 0x300 0x2 0xc00 0x3 0x1800 0x4 0x1000 0x5 0x1800 0x6 0x400000 0x7 0x9000 0x8 0x1000>;
	};

	sys_cirq@10204000 {
		compatible = "mediatek,sys_cirq";
		interrupts = <0x0 0x127 0x8>;
		mediatek,cirq_num = <0xe8>;
		mediatek,spi_start_offset = <0x40>;
		reg = <0x0 0x10204000 0x0 0x1000>;
	};

	syscon@15020000 {
		#clock-cells = <0x1>;
		compatible = "mediatek,mt6768-imgsys", "syscon";
		phandle = <0x25>;
		reg = <0x0 0x15020000 0x0 0x1000>;
	};

	systimer@10017000 {
		clocks = <0x24>;
		compatible = "mediatek,mt6768-timer", "mediatek,mt6765-timer", "mediatek,sys_timer";
		interrupts = <0x0 0xcf 0x4>;
		phandle = <0xaf>;
		reg = <0x0 0x10017000 0x0 0x1000>;
		reg-names = "sys_timer_base";
	};

	tcpc_pd_eint {
		phandle = <0xf6>;
	};

	tee_sanity {
		compatible = "mediatek,tee_sanity";
		interrupts = <0x0 0x12a 0x1>;
	};

	therm_ctrl@1100b000 {
		clock-names = "therm-main";
		clocks = <0x26 0xa>;
		compatible = "mediatek,therm_ctrl";
		interrupts = <0x0 0x63 0x8>;
		reg = <0x0 0x1100b000 0x0 0x1000>;
	};

	thermal-sensor1 {
		compatible = "mediatek,mtboard-thermistor1";
		io-channel-names = "thermistor-ch0";
		io-channels = <0x2a 0x0>;
		phandle = <0xcc>;
	};

	thermal-sensor2 {
		compatible = "mediatek,mtboard-thermistor2";
		io-channel-names = "thermistor-ch1";
		io-channels = <0x2a 0x1>;
		phandle = <0xcd>;
	};

	thermal-sensor3 {
		compatible = "mediatek,mtboard-thermistor3";
		io-channel-names = "thermistor-ch2";
		io-channels = <0x2a 0x2>;
		phandle = <0xce>;
	};

	thermal-sensor4 {
		compatible = "mediatek,mtboard-thermistor4";
		io-channel-names = "thermistor-ch4";
		io-channels = <0x2a 0x4>;
		phandle = <0xcf>;
	};

	timer {
		clock-frequency = <0xc65d40>;
		compatible = "arm,armv8-timer";
		interrupt-parent = <0x13>;
		interrupts = <0x1 0xd 0x8 0x1 0xe 0x8 0x1 0xb 0x8 0x1 0xa 0x8>;
		phandle = <0x78>;
	};

	topckgen@10000000 {
		#clock-cells = <0x1>;
		compatible = "mediatek,topckgen", "syscon";
		phandle = <0x14>;
		reg = <0x0 0x10000000 0x0 0x1000>;
	};

	topckgen_ao@1001b000 {
		compatible = "mediatek,topckgen_ao";
		reg = <0x0 0x1001b000 0x0 0x1000>;
	};

	topmisc@10011000 {
		compatible = "mediatek,topmisc";
		reg = <0x0 0x10011000 0x0 0x1000>;
	};

	toprgu@10007000 {
		#reset-cells = <0x1>;
		compatible = "mediatek,mt6768-wdt", "mediatek,mt6589-wdt", "mediatek,toprgu", "syscon", "simple-mfd";
		interrupts = <0x0 0x9c 0x8>;
		mediatek,rg_dfd_timeout = <0xa0>;
		phandle = <0x7b>;
		reg = <0x0 0x10007000 0x0 0x1000>;

		reboot-mode {
			compatible = "syscon-reboot-mode";
			mask = <0xf>;
			mode-bootloader = <0x3>;
			mode-charger = <0x1>;
			mode-ddr-reserve = <0x6>;
			mode-dm-verity-dev-corrupt = <0x4>;
			mode-kpoc = <0x5>;
			mode-meta = <0x7>;
			mode-recovery = <0x2>;
			mode-rpmbpk = <0x8>;
			offset = <0x24>;
		};
	};

	touch {
		compatible = "goodix,touch";
		phandle = <0xf9>;
	};

	trng@1020f000 {
		compatible = "mediatek,trng";
		interrupts = <0x0 0xb0 0x8>;
		reg = <0x0 0x1020f000 0x0 0x1000>;
	};

	trusty {
		#address-cells = <0x2>;
		#size-cells = <0x2>;
		compatible = "android,trusty-smc-v1";
		ranges;
		tee-id = <0x0>;
		tee-name = "trusty";

		gz-main {
			compatible = "mediatek,trusty-gz";
		};

		mtee {
			compatible = "mediatek,trusty-mtee-v1";
		};

		trusty-gz-log {
			compatible = "android,trusty-gz-log-v1";
		};

		trusty-irq {
			compatible = "android,trusty-irq-v1";
			ppi-interrupt-parent = <0x13>;
		};

		trusty-virtio {
			compatible = "android,trusty-virtio-v1";
		};
	};

	type_c_port0 {
		charger = <0x72>;
		mt-tcpc,name = "type_c_port0";
		mt-tcpc,notifier_supply_num = <0x3>;
		mt-tcpc,role_def = <0x5>;
		mt-tcpc,rp_level = <0x1>;
		mt-tcpc,vconn_supply = <0x1>;
		mt6370pd,intr_gpio = <0x20 0x18 0x0>;
		mt6370pd,intr_gpio_num = <0x18>;
		phandle = <0x103>;

		displayport {
			1st_connection = "dfp_d";
			2nd_connection = "dfp_d";
			signal,dp_v13;
			typec,receptacle;

			dfp_d {
				pin_assignment,mode_c;
				pin_assignment,mode_d;
				pin_assignment,mode_e;
			};

			ufp_d {
			};
		};

		dpm_caps {
			attemp_discover_cable;
			attemp_discover_id;
			attemp_enter_dp_mode;
			dr_check = <0x0>;
			local_dr_data;
			local_dr_power;
			local_no_suspend;
			local_usb_comm;
			local_vconn_supply;
			pr_check = <0x0>;
		};

		pd-data {
			bat,nr = <0x1>;
			pd,charging_policy = <0x31>;
			pd,country_nr = <0x0>;
			pd,id-vdo-data = <0xd14029cf 0x0 0x50810000 0x41800000 0x0 0x21800000>;
			pd,id-vdo-size = <0x6>;
			pd,mfrs = "RichtekTCPC";
			pd,pid = <0x5081>;
			pd,sink-pdo-data = <0x190c8>;
			pd,sink-pdo-size = <0x1>;
			pd,source-cap-ext = <0x508129cf 0x0 0x0 0x0 0x0 0x7000000>;
			pd,source-pdo-data = <0x19096>;
			pd,source-pdo-size = <0x1>;
			pd,vid = <0x29cf>;

			bat-info0 {
				bat,design_cap = <0xbb8>;
				bat,mfrs = "bat1";
				bat,pid = <0x5081>;
				bat,vid = <0x29cf>;
			};
		};
	};

	usb-phy@11210000 {
		#address-cells = <0x2>;
		#size-cells = <0x2>;
		compatible = "mediatek,generic-tphy-v1";
		phandle = <0xd9>;
		ranges;
		reg = <0x0 0x11cc0000 0x0 0x800>;
		status = "okay";

		usb-phy@11210000 {
			#phy-cells = <0x1>;
			clock-names = "ref";
			clocks = <0x15>;
			mediatek,eye-disc = <0x8>;
			mediatek,eye-rev6 = <0x1>;
			mediatek,eye-term = <0x2>;
			mediatek,eye-vrt = <0x7>;
			mediatek,host-eye-disc = <0x8>;
			mediatek,host-eye-rev6 = <0x3>;
			mediatek,host-eye-term = <0x7>;
			mediatek,host-eye-vrt = <0x6>;
			phandle = <0x44>;
			reg = <0x0 0x11cc0800 0x0 0x100>;
			status = "okay";
		};
	};

	usb0@11200000 {
		clock-names = "usb0", "usb0_clk_top_sel", "usb0_clk_univpll3_d4";
		clocks = <0x26 0x8 0x14 0x66 0x14 0x20>;
		compatible = "mediatek,mt6768-usb20";
		dr_mode = "otg";
		interrupt-names = "mc";
		interrupts = <0x0 0x61 0x8>;
		mode = <0x2>;
		multipoint = <0x1>;
		num_eps = <0x10>;
		pericfg = <0x43>;
		phandle = <0x73>;
		phys = <0x44 0x3>;
		reg = <0x0 0x11200000 0x0 0x10000 0x0 0x11cc0000 0x0 0x10000>;
		usb-role-switch;
		usb_phy_reset_switch = <0x1>;
	};

	usb1p_sif@11210000 {
		compatible = "mediatek,usb1p_sif";
		reg = <0x0 0x11210000 0x0 0x10000>;
	};

	utos {
		compatible = "microtrust,utos";
		interrupts = <0x0 0x12b 0x1 0x0 0x12c 0x1>;
	};

	utos_tester {
		compatible = "microtrust,tester-v1";
	};

	vcodec_dec@16000000 {
		#clock-cells = <0x1>;
		clock-names = "MT_SCP_SYS_DIS", "MT_SCP_SYS_VDE", "MT_CG_VDEC";
		clocks = <0x27 0x3 0x27 0xc 0x67 0x0>;
		compatible = "mediatek,mt6768-vcodec-dec";
		interrupts = <0x0 0xf6 0x8>;
		mediatek,larb = <0x65>;
		mediatek,vcu = <0x66>;
		phandle = <0xe2>;
		reg = <0x0 0x16000000 0x0 0x1000 0x0 0x16020000 0x0 0x400 0x0 0x16025000 0x0 0x1000>;
	};

	vcodec_enc@17000000 {
		#clock-cells = <0x1>;
		clock-names = "MT_SCP_SYS_DIS", "MT_SCP_SYS_VEN", "MT_CG_VENC";
		clocks = <0x27 0x3 0x27 0xb 0x69 0x1>;
		compatible = "mediatek,mt6768-vcodec-enc", "syscon";
		interrupts = <0x0 0xf3 0x8>;
		mediatek,larb = <0x68>;
		mediatek,vcu = <0x66>;
		phandle = <0xe3>;
		reg = <0x0 0x17000000 0x0 0x1000 0x0 0x17020000 0x0 0x1000>;
	};

	vcu@16000000 {
		compatible = "mediatek-vcu";
		gce-event-names = "venc_eof", "venc_cmdq_pause_done", "venc_mb_done", "venc_128B_cnt_done";
		gce-events = <0x35 0x121 0x35 0x122 0x35 0x124 0x35 0x125>;
		mboxes = <0x35 0x1 0x0 0x1 0x35 0x5 0x0 0x1>;
		mediatek,mailbox-gce = <0x35>;
		mediatek,vcuid = <0x0>;
		mediatek,vcuname = "vcu";
		phandle = <0x66>;
		reg = <0x0 0x16000000 0x0 0x40000 0x0 0x17020000 0x0 0x10000 0x0 0x19002000 0x0 0x1000>;
	};

	vdec@16020000 {
		compatible = "mediatek,vdec";
		interrupts = <0x0 0xf6 0x8>;
		reg = <0x0 0x16020000 0x0 0x10000>;
	};

	vdec_gcon@16000000 {
		#clock-cells = <0x1>;
		compatible = "mediatek,vdec_gcon", "syscon";
		phandle = <0x67>;
		reg = <0x0 0x16000000 0x0 0x1000 0x0 0x16020000 0x0 0x400 0x0 0x16025000 0x0 0x1000>;
	};

	vdec_mbist_ctrl@16001000 {
		compatible = "mediatek,vdec_mbist_ctrl";
		reg = <0x0 0x16001000 0x0 0x1000>;
	};

	venc@17020000 {
		compatible = "mediatek,venc";
		interrupts = <0x0 0xf3 0x8>;
		reg = <0x0 0x17020000 0x0 0x10000>;
	};

	venc_gcon@17000000 {
		#clock-cells = <0x1>;
		compatible = "mediatek,venc_gcon", "syscon";
		phandle = <0x69>;
		reg = <0x0 0x17000000 0x0 0x1000 0x0 0x17020000 0x0 0x1000>;
	};

	venc_jpg@17030000 {
		clock-names = "MT_CG_VENC_JPGENC";
		clocks = <0x69 0x2>;
		compatible = "mediatek,venc_jpg";
		interrupts = <0x0 0xf5 0x8>;
		reg = <0x0 0x17030000 0x0 0x10000>;
	};

	wifi@18000000 {
		compatible = "mediatek,wifi";
		interrupts = <0x0 0x11d 0x8>;
		memory-region = <0x6a>;
		phandle = <0xe4>;
		reg = <0x0 0x18000000 0x0 0x100000>;
	};
};
